VERSION ""

NS_ :

BS_:

BU_: ETH

BO_ 1328 VCSEC_alertLog: 8 Vector__XXX
 SG_ VCSEC_alertID M : 0|10@1+ (1,0) [0|0] "" Vector__XXX
 SG_ VCSEC_alertState : 15|1@1+ (1,0) [0|0] "" Vector__XXX
 SG_ VCSEC_a000_alertDataW0 m0 : 16|16@1+ (1,0) [0|0] "" Vector__XXX
 SG_ VCSEC_a001_InternalWatchdog m1 : 16|1@1+ (1,0) [0|0] "" Vector__XXX
 SG_ VCSEC_a002_CPUUndervoltage m2 : 16|1@1+ (1,0) [0|0] "" Vector__XXX
 SG_ VCSEC_a003_AssertID m3 : 16|16@1+ (1,0) [0|0] "" Vector__XXX
 SG_ VCSEC_a005_busID0 m5 : 16|4@1+ (1,0) [0|0] "" Vector__XXX
 SG_ VCSEC_a006_busID m6 : 16|4@1+ (1,0) [0|0] "" Vector__XXX
 SG_ VCSEC_a010_UnderVoltageDetected m10 : 16|1@1+ (1,0) [0|0] "" Vector__XXX
 SG_ VCSEC_a012_ClockError m12 : 16|1@1+ (1,0) [0|0] "" Vector__XXX
 SG_ VCSEC_a013_LogQueueFull m13 : 16|1@1+ (1,0) [0|0] "" Vector__XXX
 SG_ VCSEC_a015_NVMMMemOverflow m15 : 16|1@1+ (1,0) [0|0] "" Vector__XXX
 SG_ VCSEC_a016_NVMMRecordID m16 : 16|16@1+ (1,0) [0|0] "" Vector__XXX
 SG_ VCSEC_a017_NVMMLifetimeEraseCycles m17 : 16|32@1+ (1,0) [0|0] "" Vector__XXX
 SG_ VCSEC_a021_Task1msLate m21 : 16|1@1+ (1,0) [0|0] "" Vector__XXX
 SG_ VCSEC_a022_TaskInitErrorCount m22 : 16|8@1+ (1,0) [0|0] "" Vector__XXX
 SG_ VCSEC_a030_logId m30 : 16|4@1+ (1,0) [0|0] "" Vector__XXX
 SG_ VCSEC_a031_uds_bytes_0 m31 : 16|8@1+ (1,0) [0|0] "" Vector__XXX
 SG_ VCSEC_a041_CPULoadTotal m41 : 16|8@1+ (1,0) [0|0] "" Vector__XXX
 SG_ VCSEC_a042_Usage1msTask m42 : 16|8@1+ (1,0) [0|0] "" Vector__XXX
 SG_ VCSEC_a043_CallTrace0 m43 : 16|24@1+ (1,0) [0|0] "" Vector__XXX
 SG_ VCSEC_a044_CallTrace0 m44 : 16|24@1+ (1,0) [0|0] "" Vector__XXX
 SG_ VCSEC_a045_CallTrace0 m45 : 16|24@1+ (1,0) [0|0] "" Vector__XXX
 SG_ VCSEC_a046_CallTrace0 m46 : 16|24@1+ (1,0) [0|0] "" Vector__XXX
 SG_ VCSEC_a057_VEH_cpControl m57 : 16|1@1+ (1,0) [0|0] "" Vector__XXX
 SG_ VCSEC_a058_voltageDrop m58 : 16|12@1+ (0.005443676098,0) [0|0] "" Vector__XXX
 SG_ VCSEC_a059_voltageDrop m59 : 16|12@1+ (0.005443676098,0) [0|0] "" Vector__XXX
 SG_ VCSEC_a060_lockoutDisabled m60 : 16|1@1+ (1,0) [0|0] "" Vector__XXX
 SG_ VCSEC_a063_switchChannel m63 : 16|8@1+ (1,0) [0|0] "" Vector__XXX
 SG_ VCSEC_a064_busBitField m64 : 16|8@1+ (1,0) [0|0] "" Vector__XXX
 SG_ VCSEC_a082_RIPC_epbPrivateState m82 : 16|1@1+ (1,0) [0|0] "" Vector__XXX
 SG_ VCSEC_a083_LIPC_epbPrivateState m83 : 16|1@1+ (1,0) [0|0] "" Vector__XXX
 SG_ VCSEC_a084_CH_StatusC m84 : 16|1@1+ (1,0) [0|0] "" Vector__XXX
 SG_ VCSEC_a085_PARTY_buttonStatus m85 : 16|1@1+ (1,0) [0|0] "" Vector__XXX
 SG_ VCSEC_a086_VEH_LVBMS_statusHigh m86 : 16|1@1+ (1,0) [0|0] "" Vector__XXX
 SG_ VCSEC_a087_VEH_temperature m87 : 16|1@1+ (1,0) [0|0] "" Vector__XXX
 SG_ VCSEC_a088_VEH_temperature m88 : 16|1@1+ (1,0) [0|0] "" Vector__XXX
 SG_ VCSEC_a089_PARTY_party1 m89 : 16|1@1+ (1,0) [0|0] "" Vector__XXX
 SG_ VCSEC_a090_VEH_chNm m90 : 16|1@1+ (1,0) [0|0] "" Vector__XXX
 SG_ VCSEC_a091_VEH_faultsAndExtras m91 : 16|1@1+ (1,0) [0|0] "" Vector__XXX
 SG_ VCSEC_a092_VEH_restraintStatus m92 : 16|1@1+ (1,0) [0|0] "" Vector__XXX
 SG_ VCSEC_a093_VEH_restraintStatus m93 : 16|1@1+ (1,0) [0|0] "" Vector__XXX
 SG_ VCSEC_a094_VEH_sysStatus m94 : 16|1@1+ (1,0) [0|0] "" Vector__XXX
 SG_ VCSEC_a095_PT_ptNm m95 : 16|1@1+ (1,0) [0|0] "" Vector__XXX
 SG_ VCSEC_a096_VEH_status m96 : 16|1@1+ (1,0) [0|0] "" Vector__XXX
 SG_ VCSEC_a097_VEH_HVStatus m97 : 16|1@1+ (1,0) [0|0] "" Vector__XXX
 SG_ VCSEC_a098_CH_torque m98 : 16|1@1+ (1,0) [0|0] "" Vector__XXX
 SG_ VCSEC_a099_VEH_oocStatus m99 : 16|1@1+ (1,0) [0|0] "" Vector__XXX
 SG_ VCSEC_a100_VEH m100 : 16|1@1+ (1,0) [0|0] "" Vector__XXX
 SG_ VCSEC_a101_VEH_state m101 : 16|1@1+ (1,0) [0|0] "" Vector__XXX
 SG_ VCSEC_a102_VEH_faultsAndExtras m102 : 16|1@1+ (1,0) [0|0] "" Vector__XXX
 SG_ VCSEC_a103_VEH_hvsNm m103 : 16|1@1+ (1,0) [0|0] "" Vector__XXX
 SG_ VCSEC_a104_VEH_chNm m104 : 16|1@1+ (1,0) [0|0] "" Vector__XXX
 SG_ VCSEC_a105_VEH_states m105 : 16|1@1+ (1,0) [0|0] "" Vector__XXX
 SG_ VCSEC_a106_VEH_dcdcStatus m106 : 16|1@1+ (1,0) [0|0] "" Vector__XXX
 SG_ VCSEC_a107_VEH_hvsNm m107 : 16|1@1+ (1,0) [0|0] "" Vector__XXX
 SG_ VCSEC_a108_VEH_hvStatus m108 : 16|1@1+ (1,0) [0|0] "" Vector__XXX
 SG_ VCSEC_a109_PARTY_status m109 : 16|1@1+ (1,0) [0|0] "" Vector__XXX
 SG_ VCSEC_a110_VEH_carState m110 : 16|1@1+ (1,0) [0|0] "" Vector__XXX
 SG_ VCSEC_a111_VEH_internalStatus m111 : 16|1@1+ (1,0) [0|0] "" Vector__XXX
 SG_ VCSEC_a112_VEH_internalStatus m112 : 16|1@1+ (1,0) [0|0] "" Vector__XXX
 SG_ VCSEC_a113_VEH_ethNm m113 : 16|1@1+ (1,0) [0|0] "" Vector__XXX
 SG_ VCSEC_a114_PARTY_status m114 : 16|1@1+ (1,0) [0|0] "" Vector__XXX
 SG_ VCSEC_a115_VEH_vehNm m115 : 16|1@1+ (1,0) [0|0] "" Vector__XXX
 SG_ VCSEC_a116_PARTY_epbmStatus m116 : 16|1@1+ (1,0) [0|0] "" Vector__XXX
 SG_ VCSEC_a117_BDY_epbmStatus m117 : 16|1@1+ (1,0) [0|0] "" Vector__XXX
 SG_ VCSEC_a118_VEH_vehNm m118 : 16|1@1+ (1,0) [0|0] "" Vector__XXX
 SG_ VCSEC_a119_VEH_steerAngle m119 : 16|1@1+ (1,0) [0|0] "" Vector__XXX
 SG_ VCSEC_a120_PARTY_chassisCntl m120 : 16|1@1+ (1,0) [0|0] "" Vector__XXX
 SG_ VCSEC_a121_VEH_status m121 : 16|1@1+ (1,0) [0|0] "" Vector__XXX
 SG_ VCSEC_a133_alarmTriggerReason m133 : 16|4@1+ (1,0) [0|0] "" Vector__XXX
 SG_ VCSEC_a140_keyDidNotIdentify m140 : 16|1@1+ (1,0) [0|0] "" Vector__XXX
 SG_ VCSEC_a142_endDiscoverable m142 : 16|1@1+ (1,0) [0|0] "" Vector__XXX
 SG_ VCSEC_a143_endDiscoverable m143 : 16|1@1+ (1,0) [0|0] "" Vector__XXX
 SG_ VCSEC_a144_endDiscoverable m144 : 16|1@1+ (1,0) [0|0] "" Vector__XXX
 SG_ VCSEC_a145_endDiscoverable m145 : 16|1@1+ (1,0) [0|0] "" Vector__XXX
 SG_ VCSEC_a158_transportError m158 : 16|1@1+ (1,0) [0|0] "" Vector__XXX
 SG_ VCSEC_a159_transportError m159 : 16|1@1+ (1,0) [0|0] "" Vector__XXX
 SG_ VCSEC_a161_transportError m161 : 16|1@1+ (1,0) [0|0] "" Vector__XXX
 SG_ VCSEC_a162_transportError m162 : 16|1@1+ (1,0) [0|0] "" Vector__XXX
 SG_ VCSEC_a166_resetCount m166 : 16|8@1+ (1,0) [0|0] "" Vector__XXX
 SG_ VCSEC_a167_resetCount m167 : 16|8@1+ (1,0) [0|0] "" Vector__XXX
 SG_ VCSEC_a168_resetCount m168 : 16|8@1+ (1,0) [0|0] "" Vector__XXX
 SG_ VCSEC_a169_resetCount m169 : 16|8@1+ (1,0) [0|0] "" Vector__XXX
 SG_ VCSEC_a170_resetCount m170 : 16|8@1+ (1,0) [0|0] "" Vector__XXX
 SG_ VCSEC_a172_resetSource m172 : 16|4@1+ (1,0) [0|0] "" Vector__XXX
 SG_ VCSEC_a173_resetSource m173 : 16|4@1+ (1,0) [0|0] "" Vector__XXX
 SG_ VCSEC_a174_resetSource m174 : 16|4@1+ (1,0) [0|0] "" Vector__XXX
 SG_ VCSEC_a175_resetSource m175 : 16|4@1+ (1,0) [0|0] "" Vector__XXX
 SG_ VCSEC_a177_newWhitelistSlot m177 : 16|5@1+ (1,0) [0|0] "" Vector__XXX
 SG_ VCSEC_a178_publicKey m178 : 16|32@1+ (1,0) [0|0] "" Vector__XXX
 SG_ VCSEC_a179_fromRole m179 : 16|4@1+ (1,0) [0|0] "" Vector__XXX
 SG_ VCSEC_a180_permission m180 : 16|32@1+ (1,0) [0|0] "" Vector__XXX
 SG_ VCSEC_a181_channel m181 : 16|8@1+ (1,0) [0|0] "" Vector__XXX
 SG_ VCSEC_a182_cryptoTaskStackUsage m182 : 16|8@1+ (1,0) [0|0] "" Vector__XXX
 SG_ VCSEC_a191_clearWlist m191 : 16|1@1+ (1,0) [0|0] "" Vector__XXX
 SG_ VCSEC_a192_clearWlist m192 : 16|1@1+ (1,0) [0|0] "" Vector__XXX
 SG_ VCSEC_a193_clearWlist m193 : 16|1@1+ (1,0) [0|0] "" Vector__XXX
 SG_ VCSEC_a194_clearWlist m194 : 16|1@1+ (1,0) [0|0] "" Vector__XXX
 SG_ VCSEC_a197_connectionChannel m197 : 16|4@1+ (1,0) [0|0] "" Vector__XXX
 SG_ VCSEC_a205_connectionChannel m205 : 16|4@1+ (1,0) [0|0] "" Vector__XXX
 SG_ VCSEC_a206_assertCause m206 : 16|4@1+ (1,0) [0|0] "" Vector__XXX
 SG_ VCSEC_a207_assertCause m207 : 16|4@1+ (1,0) [0|0] "" Vector__XXX
 SG_ VCSEC_a208_assertCause m208 : 16|4@1+ (1,0) [0|0] "" Vector__XXX
 SG_ VCSEC_a209_assertCause m209 : 16|4@1+ (1,0) [0|0] "" Vector__XXX
 SG_ VCSEC_a210_whiteListChannel m210 : 16|5@1+ (1,0) [0|0] "" Vector__XXX
 SG_ VCSEC_a211_handlePulled m211 : 16|4@1+ (1,0) [0|0] "" Vector__XXX
 SG_ VCSEC_a212_snifferChannelMissing m212 : 16|2@1+ (1,0) [0|0] "" Vector__XXX
 SG_ VCSEC_a215_taskDisconnectReason m215 : 16|3@1+ (1,0) [0|0] "" Vector__XXX
 SG_ VCSEC_a216_taskDisconnectReason m216 : 16|3@1+ (1,0) [0|0] "" Vector__XXX
 SG_ VCSEC_a217_taskDisconnectReason m217 : 16|3@1+ (1,0) [0|0] "" Vector__XXX
 SG_ VCSEC_a218_taskDisconnectReason m218 : 16|3@1+ (1,0) [0|0] "" Vector__XXX
 SG_ VCSEC_a219_pairingRemovedSensor0 m219 : 16|1@1+ (1,0) [0|0] "" Vector__XXX
 SG_ VCSEC_a221_countryCode m221 : 16|16@1+ (1,0) [0|0] "" Vector__XXX
 SG_ VCSEC_a235_FPCountHighThreshLeft m235 : 16|4@1+ (1,0) [0|0] "" Vector__XXX
 SG_ VCSEC_a236_connectionChannel m236 : 16|4@1+ (1,0) [0|0] "" Vector__XXX
 SG_ VCSEC_a237_connectionChannel m237 : 16|4@1+ (1,0) [0|0] "" Vector__XXX
 SG_ VCSEC_a238_prevLocationSensor0 m238 : 16|3@1+ (1,0) [0|0] "" Vector__XXX
 SG_ VCSEC_a239_connectionReasonSensor0 m239 : 16|3@1+ (1,0) [0|0] "" Vector__XXX
 SG_ VCSEC_a241_currentCRC m241 : 16|32@1+ (1,0) [0|0] "" Vector__XXX
 SG_ VCSEC_a242_currentCRC m242 : 16|32@1+ (1,0) [0|0] "" Vector__XXX
 SG_ VCSEC_a243_currentCRC m243 : 16|32@1+ (1,0) [0|0] "" Vector__XXX
 SG_ VCSEC_a244_currentCRC m244 : 16|32@1+ (1,0) [0|0] "" Vector__XXX
 SG_ VCSEC_a245_reason m245 : 16|4@1+ (1,0) [0|0] "" Vector__XXX
 SG_ VCSEC_a246_reason m246 : 16|4@1+ (1,0) [0|0] "" Vector__XXX
 SG_ VCSEC_a247_reason m247 : 16|4@1+ (1,0) [0|0] "" Vector__XXX
 SG_ VCSEC_a248_reason m248 : 16|4@1+ (1,0) [0|0] "" Vector__XXX
 SG_ VCSEC_a249_currentCRC m249 : 16|32@1+ (1,0) [0|0] "" Vector__XXX
 SG_ VCSEC_a250_currentCRC m250 : 16|32@1+ (1,0) [0|0] "" Vector__XXX
 SG_ VCSEC_a251_currentCRC m251 : 16|32@1+ (1,0) [0|0] "" Vector__XXX
 SG_ VCSEC_a252_currentCRC m252 : 16|32@1+ (1,0) [0|0] "" Vector__XXX
 SG_ VCSEC_a253_lowBatterySensor0 m253 : 16|1@1+ (1,0) [0|0] "" Vector__XXX
 SG_ VCSEC_a254_updatedWhitelistSlot m254 : 16|5@1+ (1,0) [0|0] "" Vector__XXX
 SG_ VCSEC_a255_permission m255 : 16|20@1+ (1,0) [0|0] "" Vector__XXX
 SG_ VCSEC_a256_whitelistOperation m256 : 16|4@1+ (1,0) [0|0] "" Vector__XXX
 SG_ VCSEC_a257_whitelistSlot m257 : 16|5@1+ (1,0) [0|0] "" Vector__XXX
 SG_ VCSEC_a258_whitelistSlot m258 : 16|5@1+ (1,0) [0|0] "" Vector__XXX
 SG_ VCSEC_a261_factoryLearnState m261 : 16|3@1+ (1,0) [0|0] "" Vector__XXX
 SG_ VCSEC_a262_channel m262 : 16|5@1+ (1,0) [0|0] "" Vector__XXX
 SG_ VCSEC_a264_channel m264 : 16|8@1+ (1,0) [0|0] "" Vector__XXX
 SG_ VCSEC_a265_channel m265 : 16|8@1+ (1,0) [0|0] "" Vector__XXX
 SG_ VCSEC_a266_pressure m266 : 16|8@1+ (0.025,0) [0|0] "" Vector__XXX
 SG_ VCSEC_a267_pressure m267 : 16|8@1+ (0.025,0) [0|0] "" Vector__XXX
 SG_ VCSEC_a268_pressure m268 : 16|8@1+ (0.025,0) [0|0] "" Vector__XXX
 SG_ VCSEC_a269_pressure m269 : 16|8@1+ (0.025,0) [0|0] "" Vector__XXX
 SG_ VCSEC_a270_pressure m270 : 16|8@1+ (0.025,0) [0|0] "" Vector__XXX
 SG_ VCSEC_a271_pressure m271 : 16|8@1+ (0.025,0) [0|0] "" Vector__XXX
 SG_ VCSEC_a272_pressure m272 : 16|8@1+ (0.025,0) [0|0] "" Vector__XXX
 SG_ VCSEC_a273_pressure m273 : 16|8@1+ (0.025,0) [0|0] "" Vector__XXX
 SG_ VCSEC_a274_highThreshLeftPresent m274 : 16|1@1+ (1,0) [0|0] "" Vector__XXX
 SG_ VCSEC_a300_publicKey m300 : 16|32@1+ (1,0) [0|0] "" Vector__XXX
 SG_ VCSEC_a301_numberOfMessagesHeard m301 : 16|32@1+ (1,0) [0|0] "" Vector__XXX
 SG_ VCSEC_a303_reason m303 : 16|4@1+ (1,0) [0|0] "" Vector__XXX
 SG_ VCSEC_a304_whitelistChannel m304 : 16|5@1+ (1,0) [0|0] "" Vector__XXX
 SG_ VCSEC_a305_opcode m305 : 16|8@1+ (1,0) [0|0] "" Vector__XXX
 SG_ VCSEC_a306_whitelistChannel m306 : 16|5@1+ (1,0) [0|0] "" Vector__XXX
 SG_ VCSEC_a307_connectionChannel m307 : 16|8@1+ (1,0) [0|0] "" Vector__XXX
 SG_ VCSEC_a308_whitelistChannel m308 : 16|5@1+ (1,0) [0|0] "" Vector__XXX
 SG_ VCSEC_a309_inServiceAccessMode m309 : 16|1@1+ (1,0) [0|0] "" Vector__XXX
 SG_ VCSEC_a310_filteredFalsePositiveRSSI m310 : 16|8@1- (1,0) [0|0] "" Vector__XXX
 SG_ VCSEC_a311_whitelistChannel m311 : 16|5@1+ (1,0) [0|0] "" Vector__XXX
 SG_ VCSEC_a312_wlChannel m312 : 16|5@1+ (1,0) [0|0] "" Vector__XXX
 SG_ VCSEC_a315_event m315 : 16|6@1+ (1,0) [0|0] "" Vector__XXX
 SG_ VCSEC_a316_macAddressType m316 : 16|2@1+ (1,0) [0|0] "" Vector__XXX
 SG_ VCSEC_a435_NFCAndPhoneOnLeftSide m435 : 16|1@1+ (1,0) [0|0] "" Vector__XXX
 SG_ VCSEC_a436_currentUHFHardware m436 : 16|8@1+ (1,0) [0|0] "" Vector__XXX
 SG_ VCSEC_a455_pressure m455 : 16|8@1+ (0.025,0) [0|0] "" Vector__XXX
 SG_ VCSEC_a456_pressure m456 : 16|8@1+ (0.025,0) [0|0] "" Vector__XXX
 SG_ VCSEC_a457_pressure m457 : 16|8@1+ (0.025,0) [0|0] "" Vector__XXX
 SG_ VCSEC_a458_pressure m458 : 16|8@1+ (0.025,0) [0|0] "" Vector__XXX
 SG_ VCSEC_a459_failureReason m459 : 16|3@1+ (1,0) [0|0] "" Vector__XXX
 SG_ VCSEC_a460_failureReason m460 : 16|3@1+ (1,0) [0|0] "" Vector__XXX
 SG_ VCSEC_a461_failureReason m461 : 16|3@1+ (1,0) [0|0] "" Vector__XXX
 SG_ VCSEC_a462_failureReason m462 : 16|3@1+ (1,0) [0|0] "" Vector__XXX
 SG_ VCSEC_a472_unixtimestamp m472 : 16|32@1+ (1,0) [0|0] "" Vector__XXX
 SG_ VCSEC_a473_unixtimestamp m473 : 16|32@1+ (1,0) [0|0] "" Vector__XXX
 SG_ VCSEC_a474_timeSinceBLESwitchEnableInSeconds m474 : 16|18@1- (1,0) [0|0] "" Vector__XXX
 SG_ VCSEC_a475_timeSinceBeaconInSeconds m475 : 16|18@1- (1,0) [0|0] "" Vector__XXX
 SG_ VCSEC_a476_timeSinceForegroundInSeconds m476 : 16|18@1- (1,0) [0|0] "" Vector__XXX
 SG_ VCSEC_a477_unixtimestamp m477 : 16|32@1+ (1,0) [0|0] "" Vector__XXX
 SG_ VCSEC_a478_isDev0Bonded m478 : 16|1@1+ (1,0) [0|0] "" Vector__XXX
 SG_ VCSEC_a479_NIStateLeft0 m479 : 16|5@1+ (1,0) [0|0] "" Vector__XXX
 SG_ VCSEC_a480_NIStateLeft1 m480 : 16|5@1+ (1,0) [0|0] "" Vector__XXX
 SG_ VCSEC_a481_NIStateLeft2 m481 : 16|5@1+ (1,0) [0|0] "" Vector__XXX
 SG_ VCSEC_a483_initialTripMean m483 : 16|14@1- (0.01,0) [0|0] "" Vector__XXX
 SG_ VCSEC_a487_identifyTypeFailed m487 : 16|1@1+ (1,0) [0|0] "" Vector__XXX
 SG_ VCSEC_a495_iBeaconState m495 : 16|2@1+ (1,0) [0|0] "" Vector__XXX
 SG_ VCSEC_a496_hasBluetoothScanPermission m496 : 16|1@1+ (1,0) [0|0] "" Vector__XXX
 SG_ VCSEC_a499_assertSource m499 : 16|1@1+ (1,0) [0|0] "" Vector__XXX
 SG_ VCSEC_a500_assertSource m500 : 16|1@1+ (1,0) [0|0] "" Vector__XXX
 SG_ VCSEC_a501_assertSource m501 : 16|1@1+ (1,0) [0|0] "" Vector__XXX
 SG_ VCSEC_a502_assertSource m502 : 16|1@1+ (1,0) [0|0] "" Vector__XXX
 SG_ VCSEC_a517_pressure m517 : 16|9@1+ (0.025,0) [0|0] "" Vector__XXX
 SG_ VCSEC_a518_pressure m518 : 16|9@1+ (0.025,0) [0|0] "" Vector__XXX
 SG_ VCSEC_a519_pressure m519 : 16|9@1+ (0.025,0) [0|0] "" Vector__XXX
 SG_ VCSEC_a520_pressure m520 : 16|9@1+ (0.025,0) [0|0] "" Vector__XXX
 SG_ VCSEC_a002_PowerOnReset m2 : 17|1@1+ (1,0) [0|0] "" Vector__XXX
 SG_ VCSEC_a010_UnderVoltageTimeout m10 : 17|1@1+ (1,0) [0|0] "" Vector__XXX
 SG_ VCSEC_a012_FlashError m12 : 17|1@1+ (1,0) [0|0] "" Vector__XXX
 SG_ VCSEC_a013_ClearQueueFull m13 : 17|1@1+ (1,0) [0|0] "" Vector__XXX
 SG_ VCSEC_a015_NVMMFilesystemError m15 : 17|1@1+ (1,0) [0|0] "" Vector__XXX
 SG_ VCSEC_a021_Task1msStarved m21 : 17|1@1+ (1,0) [0|0] "" Vector__XXX
 SG_ VCSEC_a060_resetUnlocked m60 : 17|1@1+ (1,0) [0|0] "" Vector__XXX
 SG_ VCSEC_a082_RIPC_remoteHSD m82 : 17|1@1+ (1,0) [0|0] "" Vector__XXX
 SG_ VCSEC_a083_LIPC_remoteHSD m83 : 17|1@1+ (1,0) [0|0] "" Vector__XXX
 SG_ VCSEC_a086_VEH_LVBMS_statusLow m86 : 17|1@1+ (1,0) [0|0] "" Vector__XXX
 SG_ VCSEC_a087_VEH_thermalControl m87 : 17|1@1+ (1,0) [0|0] "" Vector__XXX
 SG_ VCSEC_a088_VEH_thermalControl m88 : 17|1@1+ (1,0) [0|0] "" Vector__XXX
 SG_ VCSEC_a089_PARTY_status m89 : 17|1@1+ (1,0) [0|0] "" Vector__XXX
 SG_ VCSEC_a090_VEH_state m90 : 17|1@1+ (1,0) [0|0] "" Vector__XXX
 SG_ VCSEC_a091_VEH_info m91 : 17|1@1+ (1,0) [0|0] "" Vector__XXX
 SG_ VCSEC_a092_VEH_switchStatus m92 : 17|1@1+ (1,0) [0|0] "" Vector__XXX
 SG_ VCSEC_a093_VEH_switchStatus m93 : 17|1@1+ (1,0) [0|0] "" Vector__XXX
 SG_ VCSEC_a094_PARTY_sysStatus m94 : 17|1@1+ (1,0) [0|0] "" Vector__XXX
 SG_ VCSEC_a095_PT_status m95 : 17|1@1+ (1,0) [0|0] "" Vector__XXX
 SG_ VCSEC_a096_CH_status m96 : 17|1@1+ (1,0) [0|0] "" Vector__XXX
 SG_ VCSEC_a097_VEH_state m97 : 17|1@1+ (1,0) [0|0] "" Vector__XXX
 SG_ VCSEC_a098_VEH_hvStatus m98 : 17|1@1+ (1,0) [0|0] "" Vector__XXX
 SG_ VCSEC_a100_PARTY m100 : 17|1@1+ (1,0) [0|0] "" Vector__XXX
 SG_ VCSEC_a101_PARTY_locState m101 : 17|1@1+ (1,0) [0|0] "" Vector__XXX
 SG_ VCSEC_a102_VEH_feedbackStatus m102 : 17|1@1+ (1,0) [0|0] "" Vector__XXX
 SG_ VCSEC_a103_VEH_vehNm m103 : 17|1@1+ (1,0) [0|0] "" Vector__XXX
 SG_ VCSEC_a104_VEH_bodyControls m104 : 17|1@1+ (1,0) [0|0] "" Vector__XXX
 SG_ VCSEC_a105_VEH_chNm m105 : 17|1@1+ (1,0) [0|0] "" Vector__XXX
 SG_ VCSEC_a106_VEH_thermalControl m106 : 17|1@1+ (1,0) [0|0] "" Vector__XXX
 SG_ VCSEC_a107_VEH_vehNm m107 : 17|1@1+ (1,0) [0|0] "" Vector__XXX
 SG_ VCSEC_a108_VEH_temperature m108 : 17|1@1+ (1,0) [0|0] "" Vector__XXX
 SG_ VCSEC_a109_PARTY_inertial2 m109 : 17|1@1+ (1,0) [0|0] "" Vector__XXX
 SG_ VCSEC_a110_VEH_carConfig m110 : 17|1@1+ (1,0) [0|0] "" Vector__XXX
 SG_ VCSEC_a111_VEH_status m111 : 17|1@1+ (1,0) [0|0] "" Vector__XXX
 SG_ VCSEC_a112_VEH_status m112 : 17|1@1+ (1,0) [0|0] "" Vector__XXX
 SG_ VCSEC_a113_VEH_hvacRequest m113 : 17|1@1+ (1,0) [0|0] "" Vector__XXX
 SG_ VCSEC_a114_PARTY_wheelSpeeds m114 : 17|1@1+ (1,0) [0|0] "" Vector__XXX
 SG_ VCSEC_a115_VEH_authentication m115 : 17|1@1+ (1,0) [0|0] "" Vector__XXX
 SG_ VCSEC_a116_VEH_vehNm m116 : 17|1@1+ (1,0) [0|0] "" Vector__XXX
 SG_ VCSEC_a117_BDY_restraintStatus m117 : 17|1@1+ (1,0) [0|0] "" Vector__XXX
 SG_ VCSEC_a118_VEH_lighting m118 : 17|1@1+ (1,0) [0|0] "" Vector__XXX
 SG_ VCSEC_a119_VEH_leftStalk m119 : 17|1@1+ (1,0) [0|0] "" Vector__XXX
 SG_ VCSEC_a120_VEH_systemStatus m120 : 17|1@1+ (1,0) [0|0] "" Vector__XXX
 SG_ VCSEC_a121_VEH_occupancy m121 : 17|1@1+ (1,0) [0|0] "" Vector__XXX
 SG_ VCSEC_a140_keyNotPairedToTheCar m140 : 17|1@1+ (1,0) [0|0] "" Vector__XXX
 SG_ VCSEC_a142_discoDoneEvent m142 : 17|1@1+ (1,0) [0|0] "" Vector__XXX
 SG_ VCSEC_a143_discoDoneEvent m143 : 17|1@1+ (1,0) [0|0] "" Vector__XXX
 SG_ VCSEC_a144_discoDoneEvent m144 : 17|1@1+ (1,0) [0|0] "" Vector__XXX
 SG_ VCSEC_a145_discoDoneEvent m145 : 17|1@1+ (1,0) [0|0] "" Vector__XXX
 SG_ VCSEC_a158_incompleteHeader m158 : 17|1@1+ (1,0) [0|0] "" Vector__XXX
 SG_ VCSEC_a159_incompleteHeader m159 : 17|1@1+ (1,0) [0|0] "" Vector__XXX
 SG_ VCSEC_a161_incompleteHeader m161 : 17|1@1+ (1,0) [0|0] "" Vector__XXX
 SG_ VCSEC_a162_incompleteHeader m162 : 17|1@1+ (1,0) [0|0] "" Vector__XXX
 SG_ VCSEC_a191_WlistingDevice m191 : 17|1@1+ (1,0) [0|0] "" Vector__XXX
 SG_ VCSEC_a192_WlistingDevice m192 : 17|1@1+ (1,0) [0|0] "" Vector__XXX
 SG_ VCSEC_a193_WlistingDevice m193 : 17|1@1+ (1,0) [0|0] "" Vector__XXX
 SG_ VCSEC_a194_WlistingDevice m194 : 17|1@1+ (1,0) [0|0] "" Vector__XXX
 SG_ VCSEC_a219_pairingRemovedSensor1 m219 : 17|1@1+ (1,0) [0|0] "" Vector__XXX
 SG_ VCSEC_a253_lowBatterySensor1 m253 : 17|1@1+ (1,0) [0|0] "" Vector__XXX
 SG_ VCSEC_a274_highThreshRightPresent m274 : 17|1@1+ (1,0) [0|0] "" Vector__XXX
 SG_ VCSEC_a309_inFactoryMode m309 : 17|1@1+ (1,0) [0|0] "" Vector__XXX
 SG_ VCSEC_a435_NFCAndPhoneOnRightSide m435 : 17|1@1+ (1,0) [0|0] "" Vector__XXX
 SG_ VCSEC_a478_isDev1Bonded m478 : 17|1@1+ (1,0) [0|0] "" Vector__XXX
 SG_ VCSEC_a487_failedProtoParse m487 : 17|1@1+ (1,0) [0|0] "" Vector__XXX
 SG_ VCSEC_a496_hasBluetoothConnectPermission m496 : 17|1@1+ (1,0) [0|0] "" Vector__XXX
 SG_ VCSEC_a012_SoftwareReset m12 : 18|1@1+ (1,0) [0|0] "" Vector__XXX
 SG_ VCSEC_a015_NVMMRecordIDError m15 : 18|1@1+ (1,0) [0|0] "" Vector__XXX
 SG_ VCSEC_a021_Task1msMissed m21 : 18|1@1+ (1,0) [0|0] "" Vector__XXX
 SG_ VCSEC_a082_RIPC_railStatus m82 : 18|1@1+ (1,0) [0|0] "" Vector__XXX
 SG_ VCSEC_a083_LIPC_railStatus m83 : 18|1@1+ (1,0) [0|0] "" Vector__XXX
 SG_ VCSEC_a086_VEH_status m86 : 18|1@1+ (1,0) [0|0] "" Vector__XXX
 SG_ VCSEC_a087_VEH_torque m87 : 18|1@1+ (1,0) [0|0] "" Vector__XXX
 SG_ VCSEC_a088_VEH_torque m88 : 18|1@1+ (1,0) [0|0] "" Vector__XXX
 SG_ VCSEC_a089_VEH_status m89 : 18|1@1+ (1,0) [0|0] "" Vector__XXX
 SG_ VCSEC_a090_PARTY_eacMonitor m90 : 18|1@1+ (1,0) [0|0] "" Vector__XXX
 SG_ VCSEC_a091_VEH_state m91 : 18|1@1+ (1,0) [0|0] "" Vector__XXX
 SG_ VCSEC_a092_VEH_seatStatus2 m92 : 18|1@1+ (1,0) [0|0] "" Vector__XXX
 SG_ VCSEC_a093_VEH_seatStatus2 m93 : 18|1@1+ (1,0) [0|0] "" Vector__XXX
 SG_ VCSEC_a098_VEH_status m98 : 18|1@1+ (1,0) [0|0] "" Vector__XXX
 SG_ VCSEC_a100_PT m100 : 18|1@1+ (1,0) [0|0] "" Vector__XXX
 SG_ VCSEC_a101_LIPC_externalWatchdogHeartBeat m101 : 18|1@1+ (1,0) [0|0] "" Vector__XXX
 SG_ VCSEC_a102_VEH_sensorStatus m102 : 18|1@1+ (1,0) [0|0] "" Vector__XXX
 SG_ VCSEC_a103_VEH_status m103 : 18|1@1+ (1,0) [0|0] "" Vector__XXX
 SG_ VCSEC_a104_VEH_bodyControls3 m104 : 18|1@1+ (1,0) [0|0] "" Vector__XXX
 SG_ VCSEC_a105_VEH_dampingStates m105 : 18|1@1+ (1,0) [0|0] "" Vector__XXX
 SG_ VCSEC_a106_VEH_dcdcRailStatus m106 : 18|1@1+ (1,0) [0|0] "" Vector__XXX
 SG_ VCSEC_a107_VEH_status m107 : 18|1@1+ (1,0) [0|0] "" Vector__XXX
 SG_ VCSEC_a108_VEH_thermalControl m108 : 18|1@1+ (1,0) [0|0] "" Vector__XXX
 SG_ VCSEC_a109_PARTY_nearDeploy m109 : 18|1@1+ (1,0) [0|0] "" Vector__XXX
 SG_ VCSEC_a110_VEH_time m110 : 18|1@1+ (1,0) [0|0] "" Vector__XXX
 SG_ VCSEC_a111_VEH_vehNm m111 : 18|1@1+ (1,0) [0|0] "" Vector__XXX
 SG_ VCSEC_a112_VEH_vehNm m112 : 18|1@1+ (1,0) [0|0] "" Vector__XXX
 SG_ VCSEC_a113_VEH_chargeRequest m113 : 18|1@1+ (1,0) [0|0] "" Vector__XXX
 SG_ VCSEC_a114_VEH_wheelSpeeds m114 : 18|1@1+ (1,0) [0|0] "" Vector__XXX
 SG_ VCSEC_a115_VEH_BLEResetRequest m115 : 18|1@1+ (1,0) [0|0] "" Vector__XXX
 SG_ VCSEC_a116_VEH_hvacRequest m116 : 18|1@1+ (1,0) [0|0] "" Vector__XXX
 SG_ VCSEC_a117_VEH_prndStatus m117 : 18|1@1+ (1,0) [0|0] "" Vector__XXX
 SG_ VCSEC_a118_VEH_sensors m118 : 18|1@1+ (1,0) [0|0] "" Vector__XXX
 SG_ VCSEC_a119_VEH_rightStalk m119 : 18|1@1+ (1,0) [0|0] "" Vector__XXX
 SG_ VCSEC_a120_CH_chassisCntl m120 : 18|1@1+ (1,0) [0|0] "" Vector__XXX
 SG_ VCSEC_a140_authenticationFailed m140 : 18|1@1+ (1,0) [0|0] "" Vector__XXX
 SG_ VCSEC_a142_discoCmdStatus m142 : 18|1@1+ (1,0) [0|0] "" Vector__XXX
 SG_ VCSEC_a143_discoCmdStatus m143 : 18|1@1+ (1,0) [0|0] "" Vector__XXX
 SG_ VCSEC_a144_discoCmdStatus m144 : 18|1@1+ (1,0) [0|0] "" Vector__XXX
 SG_ VCSEC_a145_discoCmdStatus m145 : 18|1@1+ (1,0) [0|0] "" Vector__XXX
 SG_ VCSEC_a158_unknownHCICode m158 : 18|1@1+ (1,0) [0|0] "" Vector__XXX
 SG_ VCSEC_a159_unknownHCICode m159 : 18|1@1+ (1,0) [0|0] "" Vector__XXX
 SG_ VCSEC_a161_unknownHCICode m161 : 18|1@1+ (1,0) [0|0] "" Vector__XXX
 SG_ VCSEC_a162_unknownHCICode m162 : 18|1@1+ (1,0) [0|0] "" Vector__XXX
 SG_ VCSEC_a191_failedToSendWlist m191 : 18|1@1+ (1,0) [0|0] "" Vector__XXX
 SG_ VCSEC_a192_failedToSendWlist m192 : 18|1@1+ (1,0) [0|0] "" Vector__XXX
 SG_ VCSEC_a193_failedToSendWlist m193 : 18|1@1+ (1,0) [0|0] "" Vector__XXX
 SG_ VCSEC_a194_failedToSendWlist m194 : 18|1@1+ (1,0) [0|0] "" Vector__XXX
 SG_ VCSEC_a212_snifferMIALeft m212 : 18|1@1+ (1,0) [0|0] "" Vector__XXX
 SG_ VCSEC_a219_pairingRemovedSensor2 m219 : 18|1@1+ (1,0) [0|0] "" Vector__XXX
 SG_ VCSEC_a253_lowBatterySensor2 m253 : 18|1@1+ (1,0) [0|0] "" Vector__XXX
 SG_ VCSEC_a274_highThreshCenterPresent m274 : 18|1@1+ (1,0) [0|0] "" Vector__XXX
 SG_ VCSEC_a309_signedCommandsHardlocked m309 : 18|1@1+ (1,0) [0|0] "" Vector__XXX
 SG_ VCSEC_a478_isDev2Bonded m478 : 18|1@1+ (1,0) [0|0] "" Vector__XXX
 SG_ VCSEC_a487_routable m487 : 18|1@1+ (1,0) [0|0] "" Vector__XXX
 SG_ VCSEC_a495_iBeaconState_timeframe m495 : 18|3@1+ (1,0) [0|0] "" Vector__XXX
 SG_ VCSEC_a496_hasAccessFineLocationPermission m496 : 18|1@1+ (1,0) [0|0] "" Vector__XXX
 SG_ VCSEC_a012_CheckstopReset m12 : 19|1@1+ (1,0) [0|0] "" Vector__XXX
 SG_ VCSEC_a021_Task10msLate m21 : 19|1@1+ (1,0) [0|0] "" Vector__XXX
 SG_ VCSEC_a082_RIPC_remoteMux m82 : 19|1@1+ (1,0) [0|0] "" Vector__XXX
 SG_ VCSEC_a083_LIPC_HSDFaults m83 : 19|1@1+ (1,0) [0|0] "" Vector__XXX
 SG_ VCSEC_a086_VEH_12VBatteryStatus m86 : 19|1@1+ (1,0) [0|0] "" Vector__XXX
 SG_ VCSEC_a087_VEH_status m87 : 19|1@1+ (1,0) [0|0] "" Vector__XXX
 SG_ VCSEC_a088_VEH_status m88 : 19|1@1+ (1,0) [0|0] "" Vector__XXX
 SG_ VCSEC_a089_BDY_party1 m89 : 19|1@1+ (1,0) [0|0] "" Vector__XXX
 SG_ VCSEC_a090_CH_eacMonitor m90 : 19|1@1+ (1,0) [0|0] "" Vector__XXX
 SG_ VCSEC_a092_VEH_vehNm m92 : 19|1@1+ (1,0) [0|0] "" Vector__XXX
 SG_ VCSEC_a093_VEH_vehNm m93 : 19|1@1+ (1,0) [0|0] "" Vector__XXX
 SG_ VCSEC_a098_VEH_thermalControl m98 : 19|1@1+ (1,0) [0|0] "" Vector__XXX
 SG_ VCSEC_a100_CH m100 : 19|1@1+ (1,0) [0|0] "" Vector__XXX
 SG_ VCSEC_a101_VEH_locState m101 : 19|1@1+ (1,0) [0|0] "" Vector__XXX
 SG_ VCSEC_a102_VEH_rods m102 : 19|1@1+ (1,0) [0|0] "" Vector__XXX
 SG_ VCSEC_a103_PT_ptNm m103 : 19|1@1+ (1,0) [0|0] "" Vector__XXX
 SG_ VCSEC_a104_BDY_bodyControls3 m104 : 19|1@1+ (1,0) [0|0] "" Vector__XXX
 SG_ VCSEC_a106_CH_dcdcRailStatus m106 : 19|1@1+ (1,0) [0|0] "" Vector__XXX
 SG_ VCSEC_a107_VEH_thermalStatus m107 : 19|1@1+ (1,0) [0|0] "" Vector__XXX
 SG_ VCSEC_a108_VEH_torque m108 : 19|1@1+ (1,0) [0|0] "" Vector__XXX
 SG_ VCSEC_a109_PARTY_collision m109 : 19|1@1+ (1,0) [0|0] "" Vector__XXX
 SG_ VCSEC_a110_VEH_updateStatus m110 : 19|1@1+ (1,0) [0|0] "" Vector__XXX
 SG_ VCSEC_a111_RIPC_LVPowerState m111 : 19|1@1+ (1,0) [0|0] "" Vector__XXX
 SG_ VCSEC_a112_LIPC_LVPowerState m112 : 19|1@1+ (1,0) [0|0] "" Vector__XXX
 SG_ VCSEC_a113_VEH_vehicleControl m113 : 19|1@1+ (1,0) [0|0] "" Vector__XXX
 SG_ VCSEC_a114_CH_wheelSpeeds m114 : 19|1@1+ (1,0) [0|0] "" Vector__XXX
 SG_ VCSEC_a115_VEH_requests m115 : 19|1@1+ (1,0) [0|0] "" Vector__XXX
 SG_ VCSEC_a116_VEH_hvacStatus m116 : 19|1@1+ (1,0) [0|0] "" Vector__XXX
 SG_ VCSEC_a117_PARTY_epbmStatus m117 : 19|1@1+ (1,0) [0|0] "" Vector__XXX
 SG_ VCSEC_a118_VEH_status m118 : 19|1@1+ (1,0) [0|0] "" Vector__XXX
 SG_ VCSEC_a119_PARTY_rightStalk m119 : 19|1@1+ (1,0) [0|0] "" Vector__XXX
 SG_ VCSEC_a120_PARTY_systemStatus m120 : 19|1@1+ (1,0) [0|0] "" Vector__XXX
 SG_ VCSEC_a140_authenticationTimeout m140 : 19|1@1+ (1,0) [0|0] "" Vector__XXX
 SG_ VCSEC_a142_discoDoneEventError m142 : 19|1@1+ (1,0) [0|0] "" Vector__XXX
 SG_ VCSEC_a143_discoDoneEventError m143 : 19|1@1+ (1,0) [0|0] "" Vector__XXX
 SG_ VCSEC_a144_discoDoneEventError m144 : 19|1@1+ (1,0) [0|0] "" Vector__XXX
 SG_ VCSEC_a145_discoDoneEventError m145 : 19|1@1+ (1,0) [0|0] "" Vector__XXX
 SG_ VCSEC_a158_packetTooLong m158 : 19|1@1+ (1,0) [0|0] "" Vector__XXX
 SG_ VCSEC_a159_packetTooLong m159 : 19|1@1+ (1,0) [0|0] "" Vector__XXX
 SG_ VCSEC_a161_packetTooLong m161 : 19|1@1+ (1,0) [0|0] "" Vector__XXX
 SG_ VCSEC_a162_packetTooLong m162 : 19|1@1+ (1,0) [0|0] "" Vector__XXX
 SG_ VCSEC_a212_snifferMIARight m212 : 19|1@1+ (1,0) [0|0] "" Vector__XXX
 SG_ VCSEC_a219_pairingRemovedSensor3 m219 : 19|1@1+ (1,0) [0|0] "" Vector__XXX
 SG_ VCSEC_a238_prevLocationSensor1 m238 : 19|3@1+ (1,0) [0|0] "" Vector__XXX
 SG_ VCSEC_a239_connectionReasonSensor1 m239 : 19|3@1+ (1,0) [0|0] "" Vector__XXX
 SG_ VCSEC_a253_lowBatterySensor3 m253 : 19|1@1+ (1,0) [0|0] "" Vector__XXX
 SG_ VCSEC_a274_highThreshRearPresent m274 : 19|1@1+ (1,0) [0|0] "" Vector__XXX
 SG_ VCSEC_a459_detailedAuthenticationStatus m459 : 19|4@1+ (1,0) [0|0] "" Vector__XXX
 SG_ VCSEC_a460_detailedAuthenticationStatus m460 : 19|4@1+ (1,0) [0|0] "" Vector__XXX
 SG_ VCSEC_a461_detailedAuthenticationStatus m461 : 19|4@1+ (1,0) [0|0] "" Vector__XXX
 SG_ VCSEC_a462_detailedAuthenticationStatus m462 : 19|4@1+ (1,0) [0|0] "" Vector__XXX
 SG_ VCSEC_a487_parsedAs m487 : 19|3@1+ (1,0) [0|0] "" Vector__XXX
 SG_ VCSEC_a496_hasLegacyBluetoothPermission m496 : 19|1@1+ (1,0) [0|0] "" Vector__XXX
 SG_ VCSEC_a005_faults0 m5 : 20|12@1+ (1,0) [0|0] "" Vector__XXX
 SG_ VCSEC_a006_fault m6 : 20|4@1+ (1,0) [0|0] "" Vector__XXX
 SG_ VCSEC_a012_DebugReset m12 : 20|1@1+ (1,0) [0|0] "" Vector__XXX
 SG_ VCSEC_a021_Task10msStarved m21 : 20|1@1+ (1,0) [0|0] "" Vector__XXX
 SG_ VCSEC_a086_VEH_LVPowerState m86 : 20|1@1+ (1,0) [0|0] "" Vector__XXX
 SG_ VCSEC_a087_PARTY_torque m87 : 20|1@1+ (1,0) [0|0] "" Vector__XXX
 SG_ VCSEC_a088_PARTY_torque m88 : 20|1@1+ (1,0) [0|0] "" Vector__XXX
 SG_ VCSEC_a089_BDY_status m89 : 20|1@1+ (1,0) [0|0] "" Vector__XXX
 SG_ VCSEC_a098_VEH_temperature m98 : 20|1@1+ (1,0) [0|0] "" Vector__XXX
 SG_ VCSEC_a100_OBD m100 : 20|1@1+ (1,0) [0|0] "" Vector__XXX
 SG_ VCSEC_a101_BDY_locState m101 : 20|1@1+ (1,0) [0|0] "" Vector__XXX
 SG_ VCSEC_a103_PT_status m103 : 20|1@1+ (1,0) [0|0] "" Vector__XXX
 SG_ VCSEC_a104_VEH_thermalStatus m104 : 20|1@1+ (1,0) [0|0] "" Vector__XXX
 SG_ VCSEC_a106_CH_alertMatrix m106 : 20|1@1+ (1,0) [0|0] "" Vector__XXX
 SG_ VCSEC_a107_VEH_bmbMinMax m107 : 20|1@1+ (1,0) [0|0] "" Vector__XXX
 SG_ VCSEC_a108_VEH_status m108 : 20|1@1+ (1,0) [0|0] "" Vector__XXX
 SG_ VCSEC_a109_VEH_status m109 : 20|1@1+ (1,0) [0|0] "" Vector__XXX
 SG_ VCSEC_a110_VEH_vehNm m110 : 20|1@1+ (1,0) [0|0] "" Vector__XXX
 SG_ VCSEC_a111_RIPC_epbPrivateState m111 : 20|1@1+ (1,0) [0|0] "" Vector__XXX
 SG_ VCSEC_a112_LIPC_epbPrivateState m112 : 20|1@1+ (1,0) [0|0] "" Vector__XXX
 SG_ VCSEC_a113_VEH_vehicleControl2 m113 : 20|1@1+ (1,0) [0|0] "" Vector__XXX
 SG_ VCSEC_a114_PARTY_party3 m114 : 20|1@1+ (1,0) [0|0] "" Vector__XXX
 SG_ VCSEC_a115_VEH_requests2 m115 : 20|1@1+ (1,0) [0|0] "" Vector__XXX
 SG_ VCSEC_a116_VEH_LVPowerState m116 : 20|1@1+ (1,0) [0|0] "" Vector__XXX
 SG_ VCSEC_a117_VEH_vehNm m117 : 20|1@1+ (1,0) [0|0] "" Vector__XXX
 SG_ VCSEC_a118_VEH_okToUseHighPwr m118 : 20|1@1+ (1,0) [0|0] "" Vector__XXX
 SG_ VCSEC_a119_CH_steerAngle m119 : 20|1@1+ (1,0) [0|0] "" Vector__XXX
 SG_ VCSEC_a120_PARTY_torque m120 : 20|1@1+ (1,0) [0|0] "" Vector__XXX
 SG_ VCSEC_a140_cardRmvdB4AuthComplete m140 : 20|1@1+ (1,0) [0|0] "" Vector__XXX
 SG_ VCSEC_a142_endDiscoCmdStatus m142 : 20|1@1+ (1,0) [0|0] "" Vector__XXX
 SG_ VCSEC_a143_endDiscoCmdStatus m143 : 20|1@1+ (1,0) [0|0] "" Vector__XXX
 SG_ VCSEC_a144_endDiscoCmdStatus m144 : 20|1@1+ (1,0) [0|0] "" Vector__XXX
 SG_ VCSEC_a145_endDiscoCmdStatus m145 : 20|1@1+ (1,0) [0|0] "" Vector__XXX
 SG_ VCSEC_a158_packetTooShort m158 : 20|1@1+ (1,0) [0|0] "" Vector__XXX
 SG_ VCSEC_a159_packetTooShort m159 : 20|1@1+ (1,0) [0|0] "" Vector__XXX
 SG_ VCSEC_a161_packetTooShort m161 : 20|1@1+ (1,0) [0|0] "" Vector__XXX
 SG_ VCSEC_a162_packetTooShort m162 : 20|1@1+ (1,0) [0|0] "" Vector__XXX
 SG_ VCSEC_a179_toRole m179 : 20|4@1+ (1,0) [0|0] "" Vector__XXX
 SG_ VCSEC_a197_connHandleMismatch m197 : 20|1@1+ (1,0) [0|0] "" Vector__XXX
 SG_ VCSEC_a211_connectionCount m211 : 20|4@1+ (1,0) [0|0] "" Vector__XXX
 SG_ VCSEC_a212_snifferMIARear m212 : 20|1@1+ (1,0) [0|0] "" Vector__XXX
 SG_ VCSEC_a235_FPCountHighThreshRight m235 : 20|4@1+ (1,0) [0|0] "" Vector__XXX
 SG_ VCSEC_a245_TPMSReason m245 : 20|3@1+ (1,0) [0|0] "" Vector__XXX
 SG_ VCSEC_a246_TPMSReason m246 : 20|3@1+ (1,0) [0|0] "" Vector__XXX
 SG_ VCSEC_a247_TPMSReason m247 : 20|3@1+ (1,0) [0|0] "" Vector__XXX
 SG_ VCSEC_a248_TPMSReason m248 : 20|3@1+ (1,0) [0|0] "" Vector__XXX
 SG_ VCSEC_a274_advPeriod m274 : 20|11@1+ (1,0) [0|0] "" Vector__XXX
 SG_ VCSEC_a496_hasLegacyBluetoothAdminPermission m496 : 20|1@1+ (1,0) [0|0] "" Vector__XXX
 SG_ VCSEC_a012_ExternalReset m12 : 21|1@1+ (1,0) [0|0] "" Vector__XXX
 SG_ VCSEC_a021_Task10msMissed m21 : 21|1@1+ (1,0) [0|0] "" Vector__XXX
 SG_ VCSEC_a086_VEH_lightStatus m86 : 21|1@1+ (1,0) [0|0] "" Vector__XXX
 SG_ VCSEC_a087_PARTY_status m87 : 21|1@1+ (1,0) [0|0] "" Vector__XXX
 SG_ VCSEC_a088_PARTY_status m88 : 21|1@1+ (1,0) [0|0] "" Vector__XXX
 SG_ VCSEC_a089_CH_status m89 : 21|1@1+ (1,0) [0|0] "" Vector__XXX
 SG_ VCSEC_a098_VEH_torque m98 : 21|1@1+ (1,0) [0|0] "" Vector__XXX
 SG_ VCSEC_a103_VEH_evseStatus m103 : 21|1@1+ (1,0) [0|0] "" Vector__XXX
 SG_ VCSEC_a104_CH_control m104 : 21|1@1+ (1,0) [0|0] "" Vector__XXX
 SG_ VCSEC_a107_VEH_powerAvailable m107 : 21|1@1+ (1,0) [0|0] "" Vector__XXX
 SG_ VCSEC_a108_PARTY_torque m108 : 21|1@1+ (1,0) [0|0] "" Vector__XXX
 SG_ VCSEC_a109_VEH_imuOffsets m109 : 21|1@1+ (1,0) [0|0] "" Vector__XXX
 SG_ VCSEC_a110_VEH_mismatchFault m110 : 21|1@1+ (1,0) [0|0] "" Vector__XXX
 SG_ VCSEC_a111_RIPC_railStatus m111 : 21|1@1+ (1,0) [0|0] "" Vector__XXX
 SG_ VCSEC_a112_LIPC_railStatus m112 : 21|1@1+ (1,0) [0|0] "" Vector__XXX
 SG_ VCSEC_a113_VEH_peripheralPowerRequests m113 : 21|1@1+ (1,0) [0|0] "" Vector__XXX
 SG_ VCSEC_a114_VEH_party3 m114 : 21|1@1+ (1,0) [0|0] "" Vector__XXX
 SG_ VCSEC_a115_REM_authentication m115 : 21|1@1+ (1,0) [0|0] "" Vector__XXX
 SG_ VCSEC_a116_VEH_lightStatus m116 : 21|1@1+ (1,0) [0|0] "" Vector__XXX
 SG_ VCSEC_a117_VEH_hvacBlowerFdb m117 : 21|1@1+ (1,0) [0|0] "" Vector__XXX
 SG_ VCSEC_a118_VEH_LVPowerState m118 : 21|1@1+ (1,0) [0|0] "" Vector__XXX
 SG_ VCSEC_a119_PARTY_steerAngle m119 : 21|1@1+ (1,0) [0|0] "" Vector__XXX
 SG_ VCSEC_a120_VEH_torque m120 : 21|1@1+ (1,0) [0|0] "" Vector__XXX
 SG_ VCSEC_a140_cardRmvdB4SndingChalng m140 : 21|1@1+ (1,0) [0|0] "" Vector__XXX
 SG_ VCSEC_a158_endpointStuckRepeating m158 : 21|1@1+ (1,0) [0|0] "" Vector__XXX
 SG_ VCSEC_a159_endpointStuckRepeating m159 : 21|1@1+ (1,0) [0|0] "" Vector__XXX
 SG_ VCSEC_a161_endpointStuckRepeating m161 : 21|1@1+ (1,0) [0|0] "" Vector__XXX
 SG_ VCSEC_a162_endpointStuckRepeating m162 : 21|1@1+ (1,0) [0|0] "" Vector__XXX
 SG_ VCSEC_a177_signingKeySlot m177 : 21|5@1+ (1,0) [0|0] "" Vector__XXX
 SG_ VCSEC_a197_confrmtnTimeout m197 : 21|1@1+ (1,0) [0|0] "" Vector__XXX
 SG_ VCSEC_a212_accessAddressInvalid m212 : 21|1@1+ (1,0) [0|0] "" Vector__XXX
 SG_ VCSEC_a254_signingKeySlot m254 : 21|5@1+ (1,0) [0|0] "" Vector__XXX
 SG_ VCSEC_a312_isKeyfob m312 : 21|1@1+ (1,0) [0|0] "" Vector__XXX
 SG_ VCSEC_a495_CBManagerState m495 : 21|3@1+ (1,0) [0|0] "" Vector__XXX
 SG_ VCSEC_a496_hasUWBRangingPermission m496 : 21|1@1+ (1,0) [0|0] "" Vector__XXX
 SG_ VCSEC_a021_Task100msLate m21 : 22|1@1+ (1,0) [0|0] "" Vector__XXX
 SG_ VCSEC_a086_VEH_systemStatus m86 : 22|1@1+ (1,0) [0|0] "" Vector__XXX
 SG_ VCSEC_a087_PARTY_temperature m87 : 22|1@1+ (1,0) [0|0] "" Vector__XXX
 SG_ VCSEC_a088_PARTY_temperature m88 : 22|1@1+ (1,0) [0|0] "" Vector__XXX
 SG_ VCSEC_a089_CH_party1 m89 : 22|1@1+ (1,0) [0|0] "" Vector__XXX
 SG_ VCSEC_a098_PARTY_status m98 : 22|1@1+ (1,0) [0|0] "" Vector__XXX
 SG_ VCSEC_a104_PARTY_control m104 : 22|1@1+ (1,0) [0|0] "" Vector__XXX
 SG_ VCSEC_a107_PT_ptNm m107 : 22|1@1+ (1,0) [0|0] "" Vector__XXX
 SG_ VCSEC_a108_PARTY_status m108 : 22|1@1+ (1,0) [0|0] "" Vector__XXX
 SG_ VCSEC_a109_PARTY_inertial1 m109 : 22|1@1+ (1,0) [0|0] "" Vector__XXX
 SG_ VCSEC_a110_VEH_vin m110 : 22|1@1+ (1,0) [0|0] "" Vector__XXX
 SG_ VCSEC_a111_RIPC_remoteADC m111 : 22|1@1+ (1,0) [0|0] "" Vector__XXX
 SG_ VCSEC_a112_LIPC_remoteADC m112 : 22|1@1+ (1,0) [0|0] "" Vector__XXX
 SG_ VCSEC_a113_VEH_corianderVehicleControl m113 : 22|1@1+ (1,0) [0|0] "" Vector__XXX
 SG_ VCSEC_a114_VEH_status m114 : 22|1@1+ (1,0) [0|0] "" Vector__XXX
 SG_ VCSEC_a115_UI_corianderVehicleControl m115 : 22|1@1+ (1,0) [0|0] "" Vector__XXX
 SG_ VCSEC_a116_VEH_seatStatus m116 : 22|1@1+ (1,0) [0|0] "" Vector__XXX
 SG_ VCSEC_a117_VEH_LVPowerState m117 : 22|1@1+ (1,0) [0|0] "" Vector__XXX
 SG_ VCSEC_a118_VEH_coolant m118 : 22|1@1+ (1,0) [0|0] "" Vector__XXX
 SG_ VCSEC_a120_PARTY_locStatus m120 : 22|1@1+ (1,0) [0|0] "" Vector__XXX
 SG_ VCSEC_a140_cardRmvdB4SndingReqID m140 : 22|1@1+ (1,0) [0|0] "" Vector__XXX
 SG_ VCSEC_a158_endpointNotAcking m158 : 22|1@1+ (1,0) [0|0] "" Vector__XXX
 SG_ VCSEC_a159_endpointNotAcking m159 : 22|1@1+ (1,0) [0|0] "" Vector__XXX
 SG_ VCSEC_a161_endpointNotAcking m161 : 22|1@1+ (1,0) [0|0] "" Vector__XXX
 SG_ VCSEC_a162_endpointNotAcking m162 : 22|1@1+ (1,0) [0|0] "" Vector__XXX
 SG_ VCSEC_a212_snifferMIAFront m212 : 22|1@1+ (1,0) [0|0] "" Vector__XXX
 SG_ VCSEC_a496_hasBatteryOptimizationEnabled m496 : 22|1@1+ (1,0) [0|0] "" Vector__XXX
 SG_ VCSEC_a021_Task100msStarved m21 : 23|1@1+ (1,0) [0|0] "" Vector__XXX
 SG_ VCSEC_a086_VEH_thermalStatus m86 : 23|1@1+ (1,0) [0|0] "" Vector__XXX
 SG_ VCSEC_a087_PARTY_thermalControl m87 : 23|1@1+ (1,0) [0|0] "" Vector__XXX
 SG_ VCSEC_a088_PARTY_thermalControl m88 : 23|1@1+ (1,0) [0|0] "" Vector__XXX
 SG_ VCSEC_a089_CH_party3 m89 : 23|1@1+ (1,0) [0|0] "" Vector__XXX
 SG_ VCSEC_a098_PARTY_temperature m98 : 23|1@1+ (1,0) [0|0] "" Vector__XXX
 SG_ VCSEC_a104_PARTY_bodyControls m104 : 23|1@1+ (1,0) [0|0] "" Vector__XXX
 SG_ VCSEC_a107_PT_status m107 : 23|1@1+ (1,0) [0|0] "" Vector__XXX
 SG_ VCSEC_a108_PARTY_temperature m108 : 23|1@1+ (1,0) [0|0] "" Vector__XXX
 SG_ VCSEC_a109_BDY_imuOffsets m109 : 23|1@1+ (1,0) [0|0] "" Vector__XXX
 SG_ VCSEC_a110_VEH_bmpDebug m110 : 23|1@1+ (1,0) [0|0] "" Vector__XXX
 SG_ VCSEC_a111_RIPC_switchStatus m111 : 23|1@1+ (1,0) [0|0] "" Vector__XXX
 SG_ VCSEC_a112_LIPC_switchStatus m112 : 23|1@1+ (1,0) [0|0] "" Vector__XXX
 SG_ VCSEC_a113_VEH_solarData m113 : 23|1@1+ (1,0) [0|0] "" Vector__XXX
 SG_ VCSEC_a114_PARTY_wheelRotation m114 : 23|1@1+ (1,0) [0|0] "" Vector__XXX
 SG_ VCSEC_a115_CH_TPMSDisplay m115 : 23|1@1+ (1,0) [0|0] "" Vector__XXX
 SG_ VCSEC_a116_VEH_thsStatus m116 : 23|1@1+ (1,0) [0|0] "" Vector__XXX
 SG_ VCSEC_a117_VEH_restraintStatus m117 : 23|1@1+ (1,0) [0|0] "" Vector__XXX
 SG_ VCSEC_a118_VEH_vehicleStatus m118 : 23|1@1+ (1,0) [0|0] "" Vector__XXX
 SG_ VCSEC_a120_PARTY_speed m120 : 23|1@1+ (1,0) [0|0] "" Vector__XXX
 SG_ VCSEC_a140_cardRmvdB4RecvingID m140 : 23|1@1+ (1,0) [0|0] "" Vector__XXX
 SG_ VCSEC_a158_transmitTimeout m158 : 23|1@1+ (1,0) [0|0] "" Vector__XXX
 SG_ VCSEC_a159_transmitTimeout m159 : 23|1@1+ (1,0) [0|0] "" Vector__XXX
 SG_ VCSEC_a161_transmitTimeout m161 : 23|1@1+ (1,0) [0|0] "" Vector__XXX
 SG_ VCSEC_a162_transmitTimeout m162 : 23|1@1+ (1,0) [0|0] "" Vector__XXX
 SG_ VCSEC_a212_snifferMIASecondary m212 : 23|1@1+ (1,0) [0|0] "" Vector__XXX
 SG_ VCSEC_a496_hasIMUSupportEnabled m496 : 23|1@1+ (1,0) [0|0] "" Vector__XXX
 SG_ VCSEC_a006_mailboxID m6 : 24|8@1+ (1,0) [0|0] "" Vector__XXX
 SG_ VCSEC_a021_Task100msMissed m21 : 24|1@1+ (1,0) [0|0] "" Vector__XXX
 SG_ VCSEC_a022_TaskInitError0 m22 : 24|8@1+ (1,0) [0|0] "" Vector__XXX
 SG_ VCSEC_a031_uds_bytes_1 m31 : 24|8@1+ (1,0) [0|0] "" Vector__XXX
 SG_ VCSEC_a041_CPULoad1msTask m41 : 24|8@1+ (1,0) [0|0] "" Vector__XXX
 SG_ VCSEC_a042_Usage10msTask m42 : 24|8@1+ (1,0) [0|0] "" Vector__XXX
 SG_ VCSEC_a063_switchType m63 : 24|8@1+ (1,0) [0|0] "" Vector__XXX
 SG_ VCSEC_a086_VEH_vehNm m86 : 24|1@1+ (1,0) [0|0] "" Vector__XXX
 SG_ VCSEC_a087_VEH_motorStatus m87 : 24|1@1+ (1,0) [0|0] "" Vector__XXX
 SG_ VCSEC_a088_VEH_motorStatus m88 : 24|1@1+ (1,0) [0|0] "" Vector__XXX
 SG_ VCSEC_a089_VEH_party1 m89 : 24|1@1+ (1,0) [0|0] "" Vector__XXX
 SG_ VCSEC_a098_PARTY_thermalControl m98 : 24|1@1+ (1,0) [0|0] "" Vector__XXX
 SG_ VCSEC_a104_PARTY_gpsAccuracies m104 : 24|1@1+ (1,0) [0|0] "" Vector__XXX
 SG_ VCSEC_a107_PT_thermalStatus m107 : 24|1@1+ (1,0) [0|0] "" Vector__XXX
 SG_ VCSEC_a108_PARTY_thermalControl m108 : 24|1@1+ (1,0) [0|0] "" Vector__XXX
 SG_ VCSEC_a109_BDY_inertial1 m109 : 24|1@1+ (1,0) [0|0] "" Vector__XXX
 SG_ VCSEC_a110_VEH_gearControl m110 : 24|1@1+ (1,0) [0|0] "" Vector__XXX
 SG_ VCSEC_a111_VEH_LVPowerState m111 : 24|1@1+ (1,0) [0|0] "" Vector__XXX
 SG_ VCSEC_a112_VEH_LVPowerState m112 : 24|1@1+ (1,0) [0|0] "" Vector__XXX
 SG_ VCSEC_a113_VEH_ventCntlReq m113 : 24|1@1+ (1,0) [0|0] "" Vector__XXX
 SG_ VCSEC_a114_CH_wheelRotation m114 : 24|1@1+ (1,0) [0|0] "" Vector__XXX
 SG_ VCSEC_a116_VEH_doorStatus m116 : 24|1@1+ (1,0) [0|0] "" Vector__XXX
 SG_ VCSEC_a117_VEH_lightStatus m117 : 24|1@1+ (1,0) [0|0] "" Vector__XXX
 SG_ VCSEC_a118_VEH_12VBatteryStatus m118 : 24|1@1+ (1,0) [0|0] "" Vector__XXX
 SG_ VCSEC_a120_VEH_speed m120 : 24|1@1+ (1,0) [0|0] "" Vector__XXX
 SG_ VCSEC_a140_multipleTriesToAuth m140 : 24|1@1+ (1,0) [0|0] "" Vector__XXX
 SG_ VCSEC_a158_transErr_noise m158 : 24|1@1+ (1,0) [0|0] "" Vector__XXX
 SG_ VCSEC_a159_transErr_noise m159 : 24|1@1+ (1,0) [0|0] "" Vector__XXX
 SG_ VCSEC_a161_transErr_noise m161 : 24|1@1+ (1,0) [0|0] "" Vector__XXX
 SG_ VCSEC_a162_transErr_noise m162 : 24|1@1+ (1,0) [0|0] "" Vector__XXX
 SG_ VCSEC_a166_reasonMIA m166 : 24|1@1+ (1,0) [0|0] "" Vector__XXX
 SG_ VCSEC_a167_reasonMIA m167 : 24|1@1+ (1,0) [0|0] "" Vector__XXX
 SG_ VCSEC_a168_reasonMIA m168 : 24|1@1+ (1,0) [0|0] "" Vector__XXX
 SG_ VCSEC_a169_reasonMIA m169 : 24|1@1+ (1,0) [0|0] "" Vector__XXX
 SG_ VCSEC_a170_reasonMIA m170 : 24|1@1+ (1,0) [0|0] "" Vector__XXX
 SG_ VCSEC_a179_whitelistSlot m179 : 24|5@1+ (1,0) [0|0] "" Vector__XXX
 SG_ VCSEC_a181_fault m181 : 24|5@1+ (1,0) [0|0] "" Vector__XXX
 SG_ VCSEC_a197_errorInconfrmtn m197 : 24|8@1+ (1,0) [0|0] "" Vector__XXX
 SG_ VCSEC_a206_assertSubcause m206 : 24|8@1+ (1,0) [0|0] "" Vector__XXX
 SG_ VCSEC_a207_assertSubcause m207 : 24|8@1+ (1,0) [0|0] "" Vector__XXX
 SG_ VCSEC_a208_assertSubcause m208 : 24|8@1+ (1,0) [0|0] "" Vector__XXX
 SG_ VCSEC_a209_assertSubcause m209 : 24|8@1+ (1,0) [0|0] "" Vector__XXX
 SG_ VCSEC_a211_RSSIValidMatrix m211 : 24|24@1+ (1,0) [0|0] "" Vector__XXX
 SG_ VCSEC_a212_snifferMIACradle m212 : 24|1@1+ (1,0) [0|0] "" Vector__XXX
 SG_ VCSEC_a215_BLEDisconnectReason m215 : 24|8@1+ (1,0) [0|0] "" Vector__XXX
 SG_ VCSEC_a216_BLEDisconnectReason m216 : 24|8@1+ (1,0) [0|0] "" Vector__XXX
 SG_ VCSEC_a217_BLEDisconnectReason m217 : 24|8@1+ (1,0) [0|0] "" Vector__XXX
 SG_ VCSEC_a218_BLEDisconnectReason m218 : 24|8@1+ (1,0) [0|0] "" Vector__XXX
 SG_ VCSEC_a235_FPCountHighThreshCenter m235 : 24|4@1+ (1,0) [0|0] "" Vector__XXX
 SG_ VCSEC_a238_prevLocationSensor2 m238 : 24|3@1+ (1,0) [0|0] "" Vector__XXX
 SG_ VCSEC_a239_connectionReasonSensor2 m239 : 24|3@1+ (1,0) [0|0] "" Vector__XXX
 SG_ VCSEC_a245_currentCRC m245 : 24|32@1+ (1,0) [0|0] "" Vector__XXX
 SG_ VCSEC_a246_currentCRC m246 : 24|32@1+ (1,0) [0|0] "" Vector__XXX
 SG_ VCSEC_a247_currentCRC m247 : 24|32@1+ (1,0) [0|0] "" Vector__XXX
 SG_ VCSEC_a248_currentCRC m248 : 24|32@1+ (1,0) [0|0] "" Vector__XXX
 SG_ VCSEC_a256_failureReason m256 : 24|6@1+ (1,0) [0|0] "" Vector__XXX
 SG_ VCSEC_a257_keyID m257 : 24|24@1+ (1,0) [0|0] "" Vector__XXX
 SG_ VCSEC_a258_keyID m258 : 24|24@1+ (1,0) [0|0] "" Vector__XXX
 SG_ VCSEC_a264_dispatcherChannel m264 : 24|8@1+ (1,0) [0|0] "" Vector__XXX
 SG_ VCSEC_a303_whitelistChannel m303 : 24|5@1+ (1,0) [0|0] "" Vector__XXX
 SG_ VCSEC_a305_pendingOpcode m305 : 24|8@1+ (1,0) [0|0] "" Vector__XXX
 SG_ VCSEC_a309_whichProtobuf m309 : 24|8@1+ (1,0) [0|0] "" Vector__XXX
 SG_ VCSEC_a310_filteredFalsePositivePressType m310 : 24|1@1+ (1,0) [0|0] "" Vector__XXX
 SG_ VCSEC_a312_RSSI m312 : 24|8@1- (1,0) [0|0] "" Vector__XXX
 SG_ VCSEC_a315_connection m315 : 24|5@1+ (1,0) [0|0] "" Vector__XXX
 SG_ VCSEC_a436_expectedUHFHardware m436 : 24|8@1+ (1,0) [0|0] "" Vector__XXX
 SG_ VCSEC_a478_numUWBsample m478 : 24|32@1+ (1,0) [0|0] "" Vector__XXX
 SG_ VCSEC_a479_NIStateRight0 m479 : 24|5@1+ (1,0) [0|0] "" Vector__XXX
 SG_ VCSEC_a480_NIStateRight1 m480 : 24|5@1+ (1,0) [0|0] "" Vector__XXX
 SG_ VCSEC_a481_NIStateRight2 m481 : 24|5@1+ (1,0) [0|0] "" Vector__XXX
 SG_ VCSEC_a487_protoChannel m487 : 24|4@1+ (1,0) [0|0] "" Vector__XXX
 SG_ VCSEC_a495_CBManagerState_timeframe m495 : 24|3@1+ (1,0) [0|0] "" Vector__XXX
 SG_ VCSEC_a496_runningState m496 : 24|2@1+ (1,0) [0|0] "" Vector__XXX
 SG_ VCSEC_a499_assertReason m499 : 24|8@1+ (1,0) [0|0] "" Vector__XXX
 SG_ VCSEC_a500_assertReason m500 : 24|8@1+ (1,0) [0|0] "" Vector__XXX
 SG_ VCSEC_a501_assertReason m501 : 24|8@1+ (1,0) [0|0] "" Vector__XXX
 SG_ VCSEC_a502_assertReason m502 : 24|8@1+ (1,0) [0|0] "" Vector__XXX
 SG_ VCSEC_a021_Task1000msLate m21 : 25|1@1+ (1,0) [0|0] "" Vector__XXX
 SG_ VCSEC_a089_VEH_party3 m89 : 25|1@1+ (1,0) [0|0] "" Vector__XXX
 SG_ VCSEC_a098_PARTY_torque m98 : 25|1@1+ (1,0) [0|0] "" Vector__XXX
 SG_ VCSEC_a104_CH_status m104 : 25|1@1+ (1,0) [0|0] "" Vector__XXX
 SG_ VCSEC_a107_PT_socStatus m107 : 25|1@1+ (1,0) [0|0] "" Vector__XXX
 SG_ VCSEC_a108_PT_temperature m108 : 25|1@1+ (1,0) [0|0] "" Vector__XXX
 SG_ VCSEC_a109_BDY_inertial2 m109 : 25|1@1+ (1,0) [0|0] "" Vector__XXX
 SG_ VCSEC_a110_VEH_canLogAvailability m110 : 25|1@1+ (1,0) [0|0] "" Vector__XXX
 SG_ VCSEC_a111_VEH_seatStatus m111 : 25|1@1+ (1,0) [0|0] "" Vector__XXX
 SG_ VCSEC_a112_PARTY_status m112 : 25|1@1+ (1,0) [0|0] "" Vector__XXX
 SG_ VCSEC_a113_VEH_chassisControl m113 : 25|1@1+ (1,0) [0|0] "" Vector__XXX
 SG_ VCSEC_a114_VEH_wheelRotation m114 : 25|1@1+ (1,0) [0|0] "" Vector__XXX
 SG_ VCSEC_a116_VEH_seatHeatStatus m116 : 25|1@1+ (1,0) [0|0] "" Vector__XXX
 SG_ VCSEC_a117_VEH_seatStatus m117 : 25|1@1+ (1,0) [0|0] "" Vector__XXX
 SG_ VCSEC_a118_VEH_systemStatus m118 : 25|1@1+ (1,0) [0|0] "" Vector__XXX
 SG_ VCSEC_a120_PARTY_status m120 : 25|1@1+ (1,0) [0|0] "" Vector__XXX
 SG_ VCSEC_a158_transErr_dropped m158 : 25|1@1+ (1,0) [0|0] "" Vector__XXX
 SG_ VCSEC_a159_transErr_dropped m159 : 25|1@1+ (1,0) [0|0] "" Vector__XXX
 SG_ VCSEC_a161_transErr_dropped m161 : 25|1@1+ (1,0) [0|0] "" Vector__XXX
 SG_ VCSEC_a162_transErr_dropped m162 : 25|1@1+ (1,0) [0|0] "" Vector__XXX
 SG_ VCSEC_a166_gapCommandTimeout m166 : 25|1@1+ (1,0) [0|0] "" Vector__XXX
 SG_ VCSEC_a167_gapCommandTimeout m167 : 25|1@1+ (1,0) [0|0] "" Vector__XXX
 SG_ VCSEC_a168_gapCommandTimeout m168 : 25|1@1+ (1,0) [0|0] "" Vector__XXX
 SG_ VCSEC_a169_gapCommandTimeout m169 : 25|1@1+ (1,0) [0|0] "" Vector__XXX
 SG_ VCSEC_a170_gapCommandTimeout m170 : 25|1@1+ (1,0) [0|0] "" Vector__XXX
 SG_ VCSEC_a212_snifferMIARearLeft m212 : 25|1@1+ (1,0) [0|0] "" Vector__XXX
 SG_ VCSEC_a021_Task1000msStarved m21 : 26|1@1+ (1,0) [0|0] "" Vector__XXX
 SG_ VCSEC_a098_PT_thermalControl m98 : 26|1@1+ (1,0) [0|0] "" Vector__XXX
 SG_ VCSEC_a104_PARTY_status m104 : 26|1@1+ (1,0) [0|0] "" Vector__XXX
 SG_ VCSEC_a107_VEH_socStatus m107 : 26|1@1+ (1,0) [0|0] "" Vector__XXX
 SG_ VCSEC_a108_PT_thermalControl m108 : 26|1@1+ (1,0) [0|0] "" Vector__XXX
 SG_ VCSEC_a109_BDY_status m109 : 26|1@1+ (1,0) [0|0] "" Vector__XXX
 SG_ VCSEC_a110_CH_airbagCutoffStatus m110 : 26|1@1+ (1,0) [0|0] "" Vector__XXX
 SG_ VCSEC_a111_PARTY_status m111 : 26|1@1+ (1,0) [0|0] "" Vector__XXX
 SG_ VCSEC_a112_CH_status m112 : 26|1@1+ (1,0) [0|0] "" Vector__XXX
 SG_ VCSEC_a113_VEH_trackModeSettings m113 : 26|1@1+ (1,0) [0|0] "" Vector__XXX
 SG_ VCSEC_a114_PARTY_brakeTorque m114 : 26|1@1+ (1,0) [0|0] "" Vector__XXX
 SG_ VCSEC_a116_VEH_restraintStatus m116 : 26|1@1+ (1,0) [0|0] "" Vector__XXX
 SG_ VCSEC_a117_BDY_falconSwitchStatus m117 : 26|1@1+ (1,0) [0|0] "" Vector__XXX
 SG_ VCSEC_a118_PARTY_LVPowerState m118 : 26|1@1+ (1,0) [0|0] "" Vector__XXX
 SG_ VCSEC_a120_PT_speed m120 : 26|1@1+ (1,0) [0|0] "" Vector__XXX
 SG_ VCSEC_a158_transErr_parity m158 : 26|1@1+ (1,0) [0|0] "" Vector__XXX
 SG_ VCSEC_a159_transErr_parity m159 : 26|1@1+ (1,0) [0|0] "" Vector__XXX
 SG_ VCSEC_a161_transErr_parity m161 : 26|1@1+ (1,0) [0|0] "" Vector__XXX
 SG_ VCSEC_a162_transErr_parity m162 : 26|1@1+ (1,0) [0|0] "" Vector__XXX
 SG_ VCSEC_a166_gapPeripCmdTimeout m166 : 26|1@1+ (1,0) [0|0] "" Vector__XXX
 SG_ VCSEC_a167_gapPeripCmdTimeout m167 : 26|1@1+ (1,0) [0|0] "" Vector__XXX
 SG_ VCSEC_a168_gapPeripCmdTimeout m168 : 26|1@1+ (1,0) [0|0] "" Vector__XXX
 SG_ VCSEC_a169_gapPeripCmdTimeout m169 : 26|1@1+ (1,0) [0|0] "" Vector__XXX
 SG_ VCSEC_a170_gapPeripCmdTimeout m170 : 26|1@1+ (1,0) [0|0] "" Vector__XXX
 SG_ VCSEC_a177_newKeyPublicKey m177 : 26|20@1+ (1,0) [0|0] "" Vector__XXX
 SG_ VCSEC_a212_snifferMIARearRight m212 : 26|1@1+ (1,0) [0|0] "" Vector__XXX
 SG_ VCSEC_a254_updatedKeyPublicKey m254 : 26|20@1+ (1,0) [0|0] "" Vector__XXX
 SG_ VCSEC_a496_runningState_timeframe m496 : 26|3@1+ (1,0) [0|0] "" Vector__XXX
 SG_ VCSEC_a021_Task1000msMissed m21 : 27|1@1+ (1,0) [0|0] "" Vector__XXX
 SG_ VCSEC_a098_PT_temperature m98 : 27|1@1+ (1,0) [0|0] "" Vector__XXX
 SG_ VCSEC_a104_PARTY_steeringControl m104 : 27|1@1+ (1,0) [0|0] "" Vector__XXX
 SG_ VCSEC_a107_VEH_packConfig m107 : 27|1@1+ (1,0) [0|0] "" Vector__XXX
 SG_ VCSEC_a108_PARTY_motorStatus m108 : 27|1@1+ (1,0) [0|0] "" Vector__XXX
 SG_ VCSEC_a109_VEH_inertial1 m109 : 27|1@1+ (1,0) [0|0] "" Vector__XXX
 SG_ VCSEC_a110_CH_carConfig m110 : 27|1@1+ (1,0) [0|0] "" Vector__XXX
 SG_ VCSEC_a111_CH_status m111 : 27|1@1+ (1,0) [0|0] "" Vector__XXX
 SG_ VCSEC_a113_VEH_powertrainControl m113 : 27|1@1+ (1,0) [0|0] "" Vector__XXX
 SG_ VCSEC_a114_PARTY_offsets m114 : 27|1@1+ (1,0) [0|0] "" Vector__XXX
 SG_ VCSEC_a116_VEH_switchStatus m116 : 27|1@1+ (1,0) [0|0] "" Vector__XXX
 SG_ VCSEC_a117_VEH_doorStatus m117 : 27|1@1+ (1,0) [0|0] "" Vector__XXX
 SG_ VCSEC_a118_PARTY_outputPowerStatus m118 : 27|1@1+ (1,0) [0|0] "" Vector__XXX
 SG_ VCSEC_a120_PT_systemStatus m120 : 27|1@1+ (1,0) [0|0] "" Vector__XXX
 SG_ VCSEC_a158_transErr_framing m158 : 27|1@1+ (1,0) [0|0] "" Vector__XXX
 SG_ VCSEC_a159_transErr_framing m159 : 27|1@1+ (1,0) [0|0] "" Vector__XXX
 SG_ VCSEC_a161_transErr_framing m161 : 27|1@1+ (1,0) [0|0] "" Vector__XXX
 SG_ VCSEC_a162_transErr_framing m162 : 27|1@1+ (1,0) [0|0] "" Vector__XXX
 SG_ VCSEC_a166_gattSrvcCmdTimeout m166 : 27|1@1+ (1,0) [0|0] "" Vector__XXX
 SG_ VCSEC_a167_gattSrvcCmdTimeout m167 : 27|1@1+ (1,0) [0|0] "" Vector__XXX
 SG_ VCSEC_a168_gattSrvcCmdTimeout m168 : 27|1@1+ (1,0) [0|0] "" Vector__XXX
 SG_ VCSEC_a169_gattSrvcCmdTimeout m169 : 27|1@1+ (1,0) [0|0] "" Vector__XXX
 SG_ VCSEC_a170_gattSrvcCmdTimeout m170 : 27|1@1+ (1,0) [0|0] "" Vector__XXX
 SG_ VCSEC_a212_snifferMIAFrontLeft m212 : 27|1@1+ (1,0) [0|0] "" Vector__XXX
 SG_ VCSEC_a238_prevLocationSensor3 m238 : 27|3@1+ (1,0) [0|0] "" Vector__XXX
 SG_ VCSEC_a239_connectionReasonSensor3 m239 : 27|3@1+ (1,0) [0|0] "" Vector__XXX
 SG_ VCSEC_a495_CBManagerAuthorization m495 : 27|3@1+ (1,0) [0|0] "" Vector__XXX
 SG_ VCSEC_a058_current m58 : 28|11@1+ (0.1,0) [0|0] "" Vector__XXX
 SG_ VCSEC_a059_resistanceEstimate m59 : 28|12@1+ (0.00244,0) [0|0] "" Vector__XXX
 SG_ VCSEC_a098_PARTY_motorStatus m98 : 28|1@1+ (1,0) [0|0] "" Vector__XXX
 SG_ VCSEC_a104_CH_steeringControl m104 : 28|1@1+ (1,0) [0|0] "" Vector__XXX
 SG_ VCSEC_a107_VEH_energyStatus m107 : 28|1@1+ (1,0) [0|0] "" Vector__XXX
 SG_ VCSEC_a108_VEH_motorStatus m108 : 28|1@1+ (1,0) [0|0] "" Vector__XXX
 SG_ VCSEC_a109_VEH_inertial2 m109 : 28|1@1+ (1,0) [0|0] "" Vector__XXX
 SG_ VCSEC_a110_CH_carState m110 : 28|1@1+ (1,0) [0|0] "" Vector__XXX
 SG_ VCSEC_a113_VEH_vehicleModes m113 : 28|1@1+ (1,0) [0|0] "" Vector__XXX
 SG_ VCSEC_a114_BDY_offsets m114 : 28|1@1+ (1,0) [0|0] "" Vector__XXX
 SG_ VCSEC_a116_VEH_logging1Hz m116 : 28|1@1+ (1,0) [0|0] "" Vector__XXX
 SG_ VCSEC_a117_VEH_doorStatus2 m117 : 28|1@1+ (1,0) [0|0] "" Vector__XXX
 SG_ VCSEC_a118_PARTY_vehicleTime m118 : 28|1@1+ (1,0) [0|0] "" Vector__XXX
 SG_ VCSEC_a120_PARTY_vehicleEstimates m120 : 28|1@1+ (1,0) [0|0] "" Vector__XXX
 SG_ VCSEC_a158_transErr_stuckLow m158 : 28|1@1+ (1,0) [0|0] "" Vector__XXX
 SG_ VCSEC_a159_transErr_stuckLow m159 : 28|1@1+ (1,0) [0|0] "" Vector__XXX
 SG_ VCSEC_a161_transErr_stuckLow m161 : 28|1@1+ (1,0) [0|0] "" Vector__XXX
 SG_ VCSEC_a162_transErr_stuckLow m162 : 28|1@1+ (1,0) [0|0] "" Vector__XXX
 SG_ VCSEC_a166_gattAtrbtMissing m166 : 28|1@1+ (1,0) [0|0] "" Vector__XXX
 SG_ VCSEC_a167_gattAtrbtMissing m167 : 28|1@1+ (1,0) [0|0] "" Vector__XXX
 SG_ VCSEC_a168_gattAtrbtMissing m168 : 28|1@1+ (1,0) [0|0] "" Vector__XXX
 SG_ VCSEC_a169_gattAtrbtMissing m169 : 28|1@1+ (1,0) [0|0] "" Vector__XXX
 SG_ VCSEC_a170_gattAtrbtMissing m170 : 28|1@1+ (1,0) [0|0] "" Vector__XXX
 SG_ VCSEC_a212_snifferMIAFrontRight m212 : 28|1@1+ (1,0) [0|0] "" Vector__XXX
 SG_ VCSEC_a235_FPCountHighThreshRear m235 : 28|4@1+ (1,0) [0|0] "" Vector__XXX
 SG_ VCSEC_a487_unrecognizedTag m487 : 28|10@1+ (1,0) [0|0] "" Vector__XXX
 SG_ VCSEC_a098_VEH_motorStatus m98 : 29|1@1+ (1,0) [0|0] "" Vector__XXX
 SG_ VCSEC_a104_VEH_steeringControl m104 : 29|1@1+ (1,0) [0|0] "" Vector__XXX
 SG_ VCSEC_a107_VEH_chargeInfo m107 : 29|1@1+ (1,0) [0|0] "" Vector__XXX
 SG_ VCSEC_a108_CH_torque m108 : 29|1@1+ (1,0) [0|0] "" Vector__XXX
 SG_ VCSEC_a109_CH_inertial1 m109 : 29|1@1+ (1,0) [0|0] "" Vector__XXX
 SG_ VCSEC_a110_CH_vin m110 : 29|1@1+ (1,0) [0|0] "" Vector__XXX
 SG_ VCSEC_a113_VEH_driverProfileRecall m113 : 29|1@1+ (1,0) [0|0] "" Vector__XXX
 SG_ VCSEC_a114_BDY_party3 m114 : 29|1@1+ (1,0) [0|0] "" Vector__XXX
 SG_ VCSEC_a116_VEH_seatStatus2 m116 : 29|1@1+ (1,0) [0|0] "" Vector__XXX
 SG_ VCSEC_a117_VEH_windowStatus m117 : 29|1@1+ (1,0) [0|0] "" Vector__XXX
 SG_ VCSEC_a118_VEH_thermalCommand m118 : 29|1@1+ (1,0) [0|0] "" Vector__XXX
 SG_ VCSEC_a120_VEH_aggregatedAxleSpeed m120 : 29|1@1+ (1,0) [0|0] "" Vector__XXX
 SG_ VCSEC_a166_externalRequest m166 : 29|1@1+ (1,0) [0|0] "" Vector__XXX
 SG_ VCSEC_a167_externalRequest m167 : 29|1@1+ (1,0) [0|0] "" Vector__XXX
 SG_ VCSEC_a168_externalRequest m168 : 29|1@1+ (1,0) [0|0] "" Vector__XXX
 SG_ VCSEC_a169_externalRequest m169 : 29|1@1+ (1,0) [0|0] "" Vector__XXX
 SG_ VCSEC_a170_externalRequest m170 : 29|1@1+ (1,0) [0|0] "" Vector__XXX
 SG_ VCSEC_a479_NIStateRearLeft0 m479 : 29|5@1+ (1,0) [0|0] "" Vector__XXX
 SG_ VCSEC_a480_NIStateRearLeft1 m480 : 29|5@1+ (1,0) [0|0] "" Vector__XXX
 SG_ VCSEC_a481_NIStateRearLeft2 m481 : 29|5@1+ (1,0) [0|0] "" Vector__XXX
 SG_ VCSEC_a104_PARTY_integratedSafetyFront m104 : 30|1@1+ (1,0) [0|0] "" Vector__XXX
 SG_ VCSEC_a109_CH_inertial2 m109 : 30|1@1+ (1,0) [0|0] "" Vector__XXX
 SG_ VCSEC_a110_CH_chNm m110 : 30|1@1+ (1,0) [0|0] "" Vector__XXX
 SG_ VCSEC_a113_VEH_driverProfileRecall2 m113 : 30|1@1+ (1,0) [0|0] "" Vector__XXX
 SG_ VCSEC_a114_BDY_status m114 : 30|1@1+ (1,0) [0|0] "" Vector__XXX
 SG_ VCSEC_a116_VEH_status m116 : 30|1@1+ (1,0) [0|0] "" Vector__XXX
 SG_ VCSEC_a117_VEH_switchStatus m117 : 30|1@1+ (1,0) [0|0] "" Vector__XXX
 SG_ VCSEC_a118_CH_LVPowerState m118 : 30|1@1+ (1,0) [0|0] "" Vector__XXX
 SG_ VCSEC_a120_PARTY_aggregatedAxleSpeed m120 : 30|1@1+ (1,0) [0|0] "" Vector__XXX
 SG_ VCSEC_a166_radioNotOn m166 : 30|1@1+ (1,0) [0|0] "" Vector__XXX
 SG_ VCSEC_a167_radioNotOn m167 : 30|1@1+ (1,0) [0|0] "" Vector__XXX
 SG_ VCSEC_a168_radioNotOn m168 : 30|1@1+ (1,0) [0|0] "" Vector__XXX
 SG_ VCSEC_a169_radioNotOn m169 : 30|1@1+ (1,0) [0|0] "" Vector__XXX
 SG_ VCSEC_a170_radioNotOn m170 : 30|1@1+ (1,0) [0|0] "" Vector__XXX
 SG_ VCSEC_a483_initialTripStdDev m483 : 30|14@1- (0.01,0) [0|0] "" Vector__XXX
 SG_ VCSEC_a104_PARTY_matrixBendAngleRequest m104 : 31|1@1+ (1,0) [0|0] "" Vector__XXX
 SG_ VCSEC_a109_CH_status m109 : 31|1@1+ (1,0) [0|0] "" Vector__XXX
 SG_ VCSEC_a110_CH_epochTimeGtw m110 : 31|1@1+ (1,0) [0|0] "" Vector__XXX
 SG_ VCSEC_a113_VEH_ventCntlReg m113 : 31|1@1+ (1,0) [0|0] "" Vector__XXX
 SG_ VCSEC_a114_BDY_wheelRotation m114 : 31|1@1+ (1,0) [0|0] "" Vector__XXX
 SG_ VCSEC_a116_VEH_thermalCommand m116 : 31|1@1+ (1,0) [0|0] "" Vector__XXX
 SG_ VCSEC_a117_VEH_intrusionSensorStatus m117 : 31|1@1+ (1,0) [0|0] "" Vector__XXX
 SG_ VCSEC_a118_PARTY_sensors m118 : 31|1@1+ (1,0) [0|0] "" Vector__XXX
 SG_ VCSEC_a120_VEH_systemPower m120 : 31|1@1+ (1,0) [0|0] "" Vector__XXX
 SG_ VCSEC_a166_macIDChanged m166 : 31|1@1+ (1,0) [0|0] "" Vector__XXX
 SG_ VCSEC_a167_macIDChanged m167 : 31|1@1+ (1,0) [0|0] "" Vector__XXX
 SG_ VCSEC_a168_macIDChanged m168 : 31|1@1+ (1,0) [0|0] "" Vector__XXX
 SG_ VCSEC_a169_macIDChanged m169 : 31|1@1+ (1,0) [0|0] "" Vector__XXX
 SG_ VCSEC_a170_macIDChanged m170 : 31|1@1+ (1,0) [0|0] "" Vector__XXX
 SG_ VCSEC_a000_alertDataW1 m0 : 32|16@1+ (1,0) [0|0] "" Vector__XXX
 SG_ VCSEC_a003_LineNumber m3 : 32|16@1+ (1,0) [0|0] "" Vector__XXX
 SG_ VCSEC_a005_busID1 m5 : 32|4@1+ (1,0) [0|0] "" Vector__XXX
 SG_ VCSEC_a006_messageID m6 : 32|29@1+ (1,0) [0|0] "" Vector__XXX
 SG_ VCSEC_a016_NVMMRecordNotFound m16 : 32|1@1+ (1,0) [0|0] "" Vector__XXX
 SG_ VCSEC_a022_TaskInitError1 m22 : 32|8@1+ (1,0) [0|0] "" Vector__XXX
 SG_ VCSEC_a031_uds_bytes_2 m31 : 32|8@1+ (1,0) [0|0] "" Vector__XXX
 SG_ VCSEC_a041_CPULoad10msTask m41 : 32|8@1+ (1,0) [0|0] "" Vector__XXX
 SG_ VCSEC_a042_Usage100msTask m42 : 32|8@1+ (1,0) [0|0] "" Vector__XXX
 SG_ VCSEC_a063_ADCVoltage m63 : 32|8@1+ (0.025,0) [0|0] "" Vector__XXX
 SG_ VCSEC_a104_VEH_matrixHighBeamRequest m104 : 32|1@1+ (1,0) [0|0] "" Vector__XXX
 SG_ VCSEC_a113_VEH_debugECU m113 : 32|1@1+ (1,0) [0|0] "" Vector__XXX
 SG_ VCSEC_a114_BDY_wheelSpeeds m114 : 32|1@1+ (1,0) [0|0] "" Vector__XXX
 SG_ VCSEC_a116_VEH_windowStatus m116 : 32|1@1+ (1,0) [0|0] "" Vector__XXX
 SG_ VCSEC_a117_VEH_liftgateStatus m117 : 32|1@1+ (1,0) [0|0] "" Vector__XXX
 SG_ VCSEC_a118_CH_sensors m118 : 32|1@1+ (1,0) [0|0] "" Vector__XXX
 SG_ VCSEC_a120_PT_systemPower m120 : 32|1@1+ (1,0) [0|0] "" Vector__XXX
 SG_ VCSEC_a166_advNotScheduled m166 : 32|1@1+ (1,0) [0|0] "" Vector__XXX
 SG_ VCSEC_a167_advNotScheduled m167 : 32|1@1+ (1,0) [0|0] "" Vector__XXX
 SG_ VCSEC_a168_advNotScheduled m168 : 32|1@1+ (1,0) [0|0] "" Vector__XXX
 SG_ VCSEC_a169_advNotScheduled m169 : 32|1@1+ (1,0) [0|0] "" Vector__XXX
 SG_ VCSEC_a170_advNotScheduled m170 : 32|1@1+ (1,0) [0|0] "" Vector__XXX
 SG_ VCSEC_a179_signingKeySlot m179 : 32|5@1+ (1,0) [0|0] "" Vector__XXX
 SG_ VCSEC_a206_assertFailCount m206 : 32|8@1+ (1,0) [0|0] "" Vector__XXX
 SG_ VCSEC_a207_assertFailCount m207 : 32|8@1+ (1,0) [0|0] "" Vector__XXX
 SG_ VCSEC_a208_assertFailCount m208 : 32|8@1+ (1,0) [0|0] "" Vector__XXX
 SG_ VCSEC_a209_assertFailCount m209 : 32|8@1+ (1,0) [0|0] "" Vector__XXX
 SG_ VCSEC_a221_homologationRegion m221 : 32|2@1+ (1,0) [0|0] "" Vector__XXX
 SG_ VCSEC_a235_FPCountNN m235 : 32|4@1+ (1,0) [0|0] "" Vector__XXX
 SG_ VCSEC_a238_newLocationSensor0 m238 : 32|3@1+ (1,0) [0|0] "" Vector__XXX
 SG_ VCSEC_a256_whitelistSlot m256 : 32|5@1+ (1,0) [0|0] "" Vector__XXX
 SG_ VCSEC_a264_messageType m264 : 32|8@1+ (1,0) [0|0] "" Vector__XXX
 SG_ VCSEC_a305_connectionChannel m305 : 32|8@1+ (1,0) [0|0] "" Vector__XXX
 SG_ VCSEC_a312_disconnectionReason m312 : 32|8@1+ (1,0) [0|0] "" Vector__XXX
 SG_ VCSEC_a436_countryCode m436 : 32|16@1+ (1,0) [0|0] "" Vector__XXX
 SG_ VCSEC_a495_CBManagerAuthorization_timeframe m495 : 32|3@1+ (1,0) [0|0] "" Vector__XXX
 SG_ VCSEC_a496_serviceStartReason m496 : 32|4@1+ (1,0) [0|0] "" Vector__XXX
 SG_ VCSEC_a499_assertSubreason m499 : 32|8@1+ (1,0) [0|0] "" Vector__XXX
 SG_ VCSEC_a500_assertSubreason m500 : 32|8@1+ (1,0) [0|0] "" Vector__XXX
 SG_ VCSEC_a501_assertSubreason m501 : 32|8@1+ (1,0) [0|0] "" Vector__XXX
 SG_ VCSEC_a502_assertSubreason m502 : 32|8@1+ (1,0) [0|0] "" Vector__XXX
 SG_ VCSEC_a016_NVMMCRCMismatch m16 : 33|1@1+ (1,0) [0|0] "" Vector__XXX
 SG_ VCSEC_a104_VEH_summonCommand m104 : 33|1@1+ (1,0) [0|0] "" Vector__XXX
 SG_ VCSEC_a113_VEH_status m113 : 33|1@1+ (1,0) [0|0] "" Vector__XXX
 SG_ VCSEC_a114_CH_party1 m114 : 33|1@1+ (1,0) [0|0] "" Vector__XXX
 SG_ VCSEC_a116_PARTY_restraintStatus m116 : 33|1@1+ (1,0) [0|0] "" Vector__XXX
 SG_ VCSEC_a117_VEH_seatStatus2 m117 : 33|1@1+ (1,0) [0|0] "" Vector__XXX
 SG_ VCSEC_a118_VEH_interNodeResistance m118 : 33|1@1+ (1,0) [0|0] "" Vector__XXX
 SG_ VCSEC_a120_PARTY_stalklessInterfaces m120 : 33|1@1+ (1,0) [0|0] "" Vector__XXX
 SG_ VCSEC_a166_assertFailure m166 : 33|1@1+ (1,0) [0|0] "" Vector__XXX
 SG_ VCSEC_a167_assertFailure m167 : 33|1@1+ (1,0) [0|0] "" Vector__XXX
 SG_ VCSEC_a168_assertFailure m168 : 33|1@1+ (1,0) [0|0] "" Vector__XXX
 SG_ VCSEC_a169_assertFailure m169 : 33|1@1+ (1,0) [0|0] "" Vector__XXX
 SG_ VCSEC_a170_assertFailure m170 : 33|1@1+ (1,0) [0|0] "" Vector__XXX
 SG_ VCSEC_a016_NVMMVersionMismatch m16 : 34|1@1+ (1,0) [0|0] "" Vector__XXX
 SG_ VCSEC_a104_VEH_status m104 : 34|1@1+ (1,0) [0|0] "" Vector__XXX
 SG_ VCSEC_a113_VEH_elevationStatus m113 : 34|1@1+ (1,0) [0|0] "" Vector__XXX
 SG_ VCSEC_a114_CH_party3 m114 : 34|1@1+ (1,0) [0|0] "" Vector__XXX
 SG_ VCSEC_a116_PARTY_doorStatus m116 : 34|1@1+ (1,0) [0|0] "" Vector__XXX
 SG_ VCSEC_a117_PARTY_restraintStatus m117 : 34|1@1+ (1,0) [0|0] "" Vector__XXX
 SG_ VCSEC_a118_CH_lighting m118 : 34|1@1+ (1,0) [0|0] "" Vector__XXX
 SG_ VCSEC_a120_CH_speed m120 : 34|1@1+ (1,0) [0|0] "" Vector__XXX
 SG_ VCSEC_a166_gattAtrbtWrongState m166 : 34|1@1+ (1,0) [0|0] "" Vector__XXX
 SG_ VCSEC_a167_gattAtrbtWrongState m167 : 34|1@1+ (1,0) [0|0] "" Vector__XXX
 SG_ VCSEC_a168_gattAtrbtWrongState m168 : 34|1@1+ (1,0) [0|0] "" Vector__XXX
 SG_ VCSEC_a169_gattAtrbtWrongState m169 : 34|1@1+ (1,0) [0|0] "" Vector__XXX
 SG_ VCSEC_a170_gattAtrbtWrongState m170 : 34|1@1+ (1,0) [0|0] "" Vector__XXX
 SG_ VCSEC_a474_timeSinceAppLaunchInSeconds m474 : 34|18@1- (1,0) [0|0] "" Vector__XXX
 SG_ VCSEC_a475_timeSinceConnectInSeconds m475 : 34|18@1- (1,0) [0|0] "" Vector__XXX
 SG_ VCSEC_a476_timeSinceBackgroundInSeconds m476 : 34|18@1- (1,0) [0|0] "" Vector__XXX
 SG_ VCSEC_a479_NIStateRearRight0 m479 : 34|5@1+ (1,0) [0|0] "" Vector__XXX
 SG_ VCSEC_a480_NIStateRearRight1 m480 : 34|5@1+ (1,0) [0|0] "" Vector__XXX
 SG_ VCSEC_a481_NIStateRearRight2 m481 : 34|5@1+ (1,0) [0|0] "" Vector__XXX
 SG_ VCSEC_a016_NVMMRecordUpgraded m16 : 35|1@1+ (1,0) [0|0] "" Vector__XXX
 SG_ VCSEC_a104_CH_pscControl m104 : 35|1@1+ (1,0) [0|0] "" Vector__XXX
 SG_ VCSEC_a113_VEH_LVControl m113 : 35|1@1+ (1,0) [0|0] "" Vector__XXX
 SG_ VCSEC_a114_CH_status m114 : 35|1@1+ (1,0) [0|0] "" Vector__XXX
 SG_ VCSEC_a116_BDY_epbmStatus m116 : 35|1@1+ (1,0) [0|0] "" Vector__XXX
 SG_ VCSEC_a117_VEH_thermalStatus m117 : 35|1@1+ (1,0) [0|0] "" Vector__XXX
 SG_ VCSEC_a118_VEH_lightStatus m118 : 35|1@1+ (1,0) [0|0] "" Vector__XXX
 SG_ VCSEC_a120_VEH_estimatedBrakeTemp m120 : 35|1@1+ (1,0) [0|0] "" Vector__XXX
 SG_ VCSEC_a166_unexpectedWakeState m166 : 35|1@1+ (1,0) [0|0] "" Vector__XXX
 SG_ VCSEC_a167_unexpectedWakeState m167 : 35|1@1+ (1,0) [0|0] "" Vector__XXX
 SG_ VCSEC_a168_unexpectedWakeState m168 : 35|1@1+ (1,0) [0|0] "" Vector__XXX
 SG_ VCSEC_a169_unexpectedWakeState m169 : 35|1@1+ (1,0) [0|0] "" Vector__XXX
 SG_ VCSEC_a170_unexpectedWakeState m170 : 35|1@1+ (1,0) [0|0] "" Vector__XXX
 SG_ VCSEC_a238_newLocationSensor1 m238 : 35|3@1+ (1,0) [0|0] "" Vector__XXX
 SG_ VCSEC_a495_CoreBTError m495 : 35|5@1+ (1,0) [0|0] "" Vector__XXX
 SG_ VCSEC_a005_faults1 m5 : 36|12@1+ (1,0) [0|0] "" Vector__XXX
 SG_ VCSEC_a016_NVMMMemOverflow m16 : 36|1@1+ (1,0) [0|0] "" Vector__XXX
 SG_ VCSEC_a104_BDY_gpsAccuracies m104 : 36|1@1+ (1,0) [0|0] "" Vector__XXX
 SG_ VCSEC_a113_CH_chassisControl m113 : 36|1@1+ (1,0) [0|0] "" Vector__XXX
 SG_ VCSEC_a116_BDY_restraintStatus m116 : 36|1@1+ (1,0) [0|0] "" Vector__XXX
 SG_ VCSEC_a117_PARTY_doorStatus m117 : 36|1@1+ (1,0) [0|0] "" Vector__XXX
 SG_ VCSEC_a118_PARTY_vehNm m118 : 36|1@1+ (1,0) [0|0] "" Vector__XXX
 SG_ VCSEC_a120_PARTY_prndControl m120 : 36|1@1+ (1,0) [0|0] "" Vector__XXX
 SG_ VCSEC_a166_transportModeWake m166 : 36|1@1+ (1,0) [0|0] "" Vector__XXX
 SG_ VCSEC_a167_transportModeWake m167 : 36|1@1+ (1,0) [0|0] "" Vector__XXX
 SG_ VCSEC_a168_transportModeWake m168 : 36|1@1+ (1,0) [0|0] "" Vector__XXX
 SG_ VCSEC_a169_transportModeWake m169 : 36|1@1+ (1,0) [0|0] "" Vector__XXX
 SG_ VCSEC_a170_transportModeWake m170 : 36|1@1+ (1,0) [0|0] "" Vector__XXX
 SG_ VCSEC_a235_isOnlyTrackingNN m235 : 36|1@1+ (1,0) [0|0] "" Vector__XXX
 SG_ VCSEC_a255_whitelistSlot m255 : 36|5@1+ (1,0) [0|0] "" Vector__XXX
 SG_ VCSEC_a496_processStart_timeframe m496 : 36|3@1+ (1,0) [0|0] "" Vector__XXX
 SG_ VCSEC_a016_NVMMWriteFailed m16 : 37|1@1+ (1,0) [0|0] "" Vector__XXX
 SG_ VCSEC_a104_BDY_control m104 : 37|1@1+ (1,0) [0|0] "" Vector__XXX
 SG_ VCSEC_a113_CH_powertrainControl m113 : 37|1@1+ (1,0) [0|0] "" Vector__XXX
 SG_ VCSEC_a117_VEH_status m117 : 37|1@1+ (1,0) [0|0] "" Vector__XXX
 SG_ VCSEC_a118_CH_12VBatteryStatus m118 : 37|1@1+ (1,0) [0|0] "" Vector__XXX
 SG_ VCSEC_a120_PARTY_locStatus2 m120 : 37|1@1+ (1,0) [0|0] "" Vector__XXX
 SG_ VCSEC_a166_CMStateMismatch m166 : 37|1@1+ (1,0) [0|0] "" Vector__XXX
 SG_ VCSEC_a167_CMStateMismatch m167 : 37|1@1+ (1,0) [0|0] "" Vector__XXX
 SG_ VCSEC_a168_CMStateMismatch m168 : 37|1@1+ (1,0) [0|0] "" Vector__XXX
 SG_ VCSEC_a169_CMStateMismatch m169 : 37|1@1+ (1,0) [0|0] "" Vector__XXX
 SG_ VCSEC_a170_CMStateMismatch m170 : 37|1@1+ (1,0) [0|0] "" Vector__XXX
 SG_ VCSEC_a179_keyActiveTime m179 : 37|18@1+ (1,0) [0|0] "" Vector__XXX
 SG_ VCSEC_a104_BDY_status m104 : 38|1@1+ (1,0) [0|0] "" Vector__XXX
 SG_ VCSEC_a113_VEH_tripPlanning m113 : 38|1@1+ (1,0) [0|0] "" Vector__XXX
 SG_ VCSEC_a117_PARTY_prndStatus m117 : 38|1@1+ (1,0) [0|0] "" Vector__XXX
 SG_ VCSEC_a118_CH_LVBMS_statusHigh m118 : 38|1@1+ (1,0) [0|0] "" Vector__XXX
 SG_ VCSEC_a120_VEH_chassisCntl m120 : 38|1@1+ (1,0) [0|0] "" Vector__XXX
 SG_ VCSEC_a166_connectionWithoutChannel m166 : 38|1@1+ (1,0) [0|0] "" Vector__XXX
 SG_ VCSEC_a167_connectionWithoutChannel m167 : 38|1@1+ (1,0) [0|0] "" Vector__XXX
 SG_ VCSEC_a168_connectionWithoutChannel m168 : 38|1@1+ (1,0) [0|0] "" Vector__XXX
 SG_ VCSEC_a169_connectionWithoutChannel m169 : 38|1@1+ (1,0) [0|0] "" Vector__XXX
 SG_ VCSEC_a170_connectionWithoutChannel m170 : 38|1@1+ (1,0) [0|0] "" Vector__XXX
 SG_ VCSEC_a058_prevREstimate m58 : 39|12@1+ (0.00061,0) [0|0] "" Vector__XXX
 SG_ VCSEC_a104_VEH_wirelessChargingStatus m104 : 39|1@1+ (1,0) [0|0] "" Vector__XXX
 SG_ VCSEC_a113_VEH_vehicleControl3 m113 : 39|1@1+ (1,0) [0|0] "" Vector__XXX
 SG_ VCSEC_a117_PARTY_lightingSecondary m117 : 39|1@1+ (1,0) [0|0] "" Vector__XXX
 SG_ VCSEC_a118_CH_alertMatrix m118 : 39|1@1+ (1,0) [0|0] "" Vector__XXX
 SG_ VCSEC_a120_VEH_locStatus m120 : 39|1@1+ (1,0) [0|0] "" Vector__XXX
 SG_ VCSEC_a166_stuckAttemptingToConnect m166 : 39|1@1+ (1,0) [0|0] "" Vector__XXX
 SG_ VCSEC_a167_stuckAttemptingToConnect m167 : 39|1@1+ (1,0) [0|0] "" Vector__XXX
 SG_ VCSEC_a168_stuckAttemptingToConnect m168 : 39|1@1+ (1,0) [0|0] "" Vector__XXX
 SG_ VCSEC_a169_stuckAttemptingToConnect m169 : 39|1@1+ (1,0) [0|0] "" Vector__XXX
 SG_ VCSEC_a170_stuckAttemptingToConnect m170 : 39|1@1+ (1,0) [0|0] "" Vector__XXX
 SG_ VCSEC_a479_NIStateHeader0 m479 : 39|5@1+ (1,0) [0|0] "" Vector__XXX
 SG_ VCSEC_a480_NIStateHeader1 m480 : 39|5@1+ (1,0) [0|0] "" Vector__XXX
 SG_ VCSEC_a481_NIStateHeader2 m481 : 39|5@1+ (1,0) [0|0] "" Vector__XXX
 SG_ VCSEC_a022_TaskInitError2 m22 : 40|8@1+ (1,0) [0|0] "" Vector__XXX
 SG_ VCSEC_a031_uds_bytes_3 m31 : 40|8@1+ (1,0) [0|0] "" Vector__XXX
 SG_ VCSEC_a041_CPULoad100msTask m41 : 40|8@1+ (1,0) [0|0] "" Vector__XXX
 SG_ VCSEC_a042_Usage1000msTask m42 : 40|8@1+ (1,0) [0|0] "" Vector__XXX
 SG_ VCSEC_a043_CallTrace1 m43 : 40|24@1+ (1,0) [0|0] "" Vector__XXX
 SG_ VCSEC_a044_CallTrace1 m44 : 40|24@1+ (1,0) [0|0] "" Vector__XXX
 SG_ VCSEC_a045_CallTrace1 m45 : 40|24@1+ (1,0) [0|0] "" Vector__XXX
 SG_ VCSEC_a046_CallTrace1 m46 : 40|24@1+ (1,0) [0|0] "" Vector__XXX
 SG_ VCSEC_a059_current m59 : 40|12@1+ (0.05,0) [0|0] "" Vector__XXX
 SG_ VCSEC_a063_disconnected m63 : 40|1@1+ (1,0) [0|0] "" Vector__XXX
 SG_ VCSEC_a104_VEH_control m104 : 40|1@1+ (1,0) [0|0] "" Vector__XXX
 SG_ VCSEC_a113_VEH_vehicleControlThermal m113 : 40|1@1+ (1,0) [0|0] "" Vector__XXX
 SG_ VCSEC_a118_BDY_outputPowerStatus m118 : 40|1@1+ (1,0) [0|0] "" Vector__XXX
 SG_ VCSEC_a120_VEH_locStatus2 m120 : 40|1@1+ (1,0) [0|0] "" Vector__XXX
 SG_ VCSEC_a166_memAllocError m166 : 40|1@1+ (1,0) [0|0] "" Vector__XXX
 SG_ VCSEC_a167_memAllocError m167 : 40|1@1+ (1,0) [0|0] "" Vector__XXX
 SG_ VCSEC_a168_memAllocError m168 : 40|1@1+ (1,0) [0|0] "" Vector__XXX
 SG_ VCSEC_a169_memAllocError m169 : 40|1@1+ (1,0) [0|0] "" Vector__XXX
 SG_ VCSEC_a170_memAllocError m170 : 40|1@1+ (1,0) [0|0] "" Vector__XXX
 SG_ VCSEC_a238_newLocationSensor2 m238 : 40|3@1+ (1,0) [0|0] "" Vector__XXX
 SG_ VCSEC_a256_signingKeySlot m256 : 40|5@1+ (1,0) [0|0] "" Vector__XXX
 SG_ VCSEC_a312_modelHash m312 : 40|24@1+ (1,0) [0|0] "" Vector__XXX
 SG_ VCSEC_a495_CoreBTError_timeframe m495 : 40|3@1+ (1,0) [0|0] "" Vector__XXX
 SG_ VCSEC_a496_osStart_timeframe m496 : 40|3@1+ (1,0) [0|0] "" Vector__XXX
 SG_ VCSEC_a063_indeterminate m63 : 41|1@1+ (1,0) [0|0] "" Vector__XXX
 SG_ VCSEC_a104_BDY_bodyControls m104 : 41|1@1+ (1,0) [0|0] "" Vector__XXX
 SG_ VCSEC_a113_CH_odo m113 : 41|1@1+ (1,0) [0|0] "" Vector__XXX
 SG_ VCSEC_a118_BDY_vehicleTime m118 : 41|1@1+ (1,0) [0|0] "" Vector__XXX
 SG_ VCSEC_a120_VEH_prndControl m120 : 41|1@1+ (1,0) [0|0] "" Vector__XXX
 SG_ VCSEC_a166_TPMSConnectionRequestFailing m166 : 41|1@1+ (1,0) [0|0] "" Vector__XXX
 SG_ VCSEC_a167_TPMSConnectionRequestFailing m167 : 41|1@1+ (1,0) [0|0] "" Vector__XXX
 SG_ VCSEC_a168_TPMSConnectionRequestFailing m168 : 41|1@1+ (1,0) [0|0] "" Vector__XXX
 SG_ VCSEC_a169_TPMSConnectionRequestFailing m169 : 41|1@1+ (1,0) [0|0] "" Vector__XXX
 SG_ VCSEC_a170_TPMSConnectionRequestFailing m170 : 41|1@1+ (1,0) [0|0] "" Vector__XXX
 SG_ VCSEC_a255_signingKeySlot m255 : 41|5@1+ (1,0) [0|0] "" Vector__XXX
 SG_ VCSEC_a063_stuckActive m63 : 42|1@1+ (1,0) [0|0] "" Vector__XXX
 SG_ VCSEC_a113_VEH_locationStatus m113 : 42|1@1+ (1,0) [0|0] "" Vector__XXX
 SG_ VCSEC_a118_PARTY_AP_vehicleState1HzMuxed m118 : 42|1@1+ (1,0) [0|0] "" Vector__XXX
 SG_ VCSEC_a120_VEH_vehicleEstimates m120 : 42|1@1+ (1,0) [0|0] "" Vector__XXX
 SG_ VCSEC_a166_TPMSRepeatedlyDisconnecting m166 : 42|1@1+ (1,0) [0|0] "" Vector__XXX
 SG_ VCSEC_a167_TPMSRepeatedlyDisconnecting m167 : 42|1@1+ (1,0) [0|0] "" Vector__XXX
 SG_ VCSEC_a168_TPMSRepeatedlyDisconnecting m168 : 42|1@1+ (1,0) [0|0] "" Vector__XXX
 SG_ VCSEC_a169_TPMSRepeatedlyDisconnecting m169 : 42|1@1+ (1,0) [0|0] "" Vector__XXX
 SG_ VCSEC_a170_TPMSRepeatedlyDisconnecting m170 : 42|1@1+ (1,0) [0|0] "" Vector__XXX
 SG_ VCSEC_a063_faulted m63 : 43|1@1+ (1,0) [0|0] "" Vector__XXX
 SG_ VCSEC_a113_VEH_gpsTime m113 : 43|1@1+ (1,0) [0|0] "" Vector__XXX
 SG_ VCSEC_a118_BDY_AP_vehicleState1HzMuxed m118 : 43|1@1+ (1,0) [0|0] "" Vector__XXX
 SG_ VCSEC_a120_PARTY_motorStatus m120 : 43|1@1+ (1,0) [0|0] "" Vector__XXX
 SG_ VCSEC_a166_heapUsageTooHigh m166 : 43|1@1+ (1,0) [0|0] "" Vector__XXX
 SG_ VCSEC_a167_heapUsageTooHigh m167 : 43|1@1+ (1,0) [0|0] "" Vector__XXX
 SG_ VCSEC_a168_heapUsageTooHigh m168 : 43|1@1+ (1,0) [0|0] "" Vector__XXX
 SG_ VCSEC_a169_heapUsageTooHigh m169 : 43|1@1+ (1,0) [0|0] "" Vector__XXX
 SG_ VCSEC_a170_heapUsageTooHigh m170 : 43|1@1+ (1,0) [0|0] "" Vector__XXX
 SG_ VCSEC_a238_newLocationSensor3 m238 : 43|3@1+ (1,0) [0|0] "" Vector__XXX
 SG_ VCSEC_a495_CoreBTATTError m495 : 43|5@1+ (1,0) [0|0] "" Vector__XXX
 SG_ VCSEC_a496_screenOn_timeframe m496 : 43|3@1+ (1,0) [0|0] "" Vector__XXX
 SG_ VCSEC_a113_VEH_gpsVehicleSpeed m113 : 44|1@1+ (1,0) [0|0] "" Vector__XXX
 SG_ VCSEC_a118_PARTY_VCFRONT_cameraCleaningStatus m118 : 44|1@1+ (1,0) [0|0] "" Vector__XXX
 SG_ VCSEC_a120_VEH_motorStatus m120 : 44|1@1+ (1,0) [0|0] "" Vector__XXX
 SG_ VCSEC_a166_linkLayerBreakdown m166 : 44|1@1+ (1,0) [0|0] "" Vector__XXX
 SG_ VCSEC_a167_linkLayerBreakdown m167 : 44|1@1+ (1,0) [0|0] "" Vector__XXX
 SG_ VCSEC_a168_linkLayerBreakdown m168 : 44|1@1+ (1,0) [0|0] "" Vector__XXX
 SG_ VCSEC_a169_linkLayerBreakdown m169 : 44|1@1+ (1,0) [0|0] "" Vector__XXX
 SG_ VCSEC_a170_linkLayerBreakdown m170 : 44|1@1+ (1,0) [0|0] "" Vector__XXX
 SG_ VCSEC_a479_NIStateRearBumper0 m479 : 44|5@1+ (1,0) [0|0] "" Vector__XXX
 SG_ VCSEC_a480_NIStateRearBumper1 m480 : 44|5@1+ (1,0) [0|0] "" Vector__XXX
 SG_ VCSEC_a481_NIStateRearBumper2 m481 : 44|5@1+ (1,0) [0|0] "" Vector__XXX
 SG_ VCSEC_a483_warning1_endpoints_global m483 : 44|10@1+ (1,0) [0|0] "" Vector__XXX
 SG_ VCSEC_a113_VEH_status2 m113 : 45|1@1+ (1,0) [0|0] "" Vector__XXX
 SG_ VCSEC_a120_BDY_speed m120 : 45|1@1+ (1,0) [0|0] "" Vector__XXX
 SG_ VCSEC_a166_uwbReset m166 : 45|1@1+ (1,0) [0|0] "" Vector__XXX
 SG_ VCSEC_a167_uwbReset m167 : 45|1@1+ (1,0) [0|0] "" Vector__XXX
 SG_ VCSEC_a168_uwbReset m168 : 45|1@1+ (1,0) [0|0] "" Vector__XXX
 SG_ VCSEC_a169_uwbReset m169 : 45|1@1+ (1,0) [0|0] "" Vector__XXX
 SG_ VCSEC_a170_uwbReset m170 : 45|1@1+ (1,0) [0|0] "" Vector__XXX
 SG_ VCSEC_a256_keyActiveTime m256 : 45|18@1+ (1,0) [0|0] "" Vector__XXX
 SG_ VCSEC_a113_VEH_autopilotControl m113 : 46|1@1+ (1,0) [0|0] "" Vector__XXX
 SG_ VCSEC_a166_bondingFailure m166 : 46|1@1+ (1,0) [0|0] "" Vector__XXX
 SG_ VCSEC_a167_bondingFailure m167 : 46|1@1+ (1,0) [0|0] "" Vector__XXX
 SG_ VCSEC_a168_bondingFailure m168 : 46|1@1+ (1,0) [0|0] "" Vector__XXX
 SG_ VCSEC_a169_bondingFailure m169 : 46|1@1+ (1,0) [0|0] "" Vector__XXX
 SG_ VCSEC_a170_bondingFailure m170 : 46|1@1+ (1,0) [0|0] "" Vector__XXX
 SG_ VCSEC_a177_keyActiveTime m177 : 46|12@1+ (1,0) [0|0] "" Vector__XXX
 SG_ VCSEC_a254_keyActiveTime m254 : 46|18@1+ (1,0) [0|0] "" Vector__XXX
 SG_ VCSEC_a255_keyActiveTime m255 : 46|18@1+ (1,0) [0|0] "" Vector__XXX
 SG_ VCSEC_a113_VEH_ambientLightingCtrls m113 : 47|1@1+ (1,0) [0|0] "" Vector__XXX
 SG_ VCSEC_a166_uwbMIA m166 : 47|1@1+ (1,0) [0|0] "" Vector__XXX
 SG_ VCSEC_a167_uwbMIA m167 : 47|1@1+ (1,0) [0|0] "" Vector__XXX
 SG_ VCSEC_a168_uwbMIA m168 : 47|1@1+ (1,0) [0|0] "" Vector__XXX
 SG_ VCSEC_a169_uwbMIA m169 : 47|1@1+ (1,0) [0|0] "" Vector__XXX
 SG_ VCSEC_a170_uwbMIA m170 : 47|1@1+ (1,0) [0|0] "" Vector__XXX
 SG_ VCSEC_a000_alertDataW2 m0 : 48|16@1+ (1,0) [0|0] "" Vector__XXX
 SG_ VCSEC_a003_Data m3 : 48|16@1+ (1,0) [0|0] "" Vector__XXX
 SG_ VCSEC_a022_TaskInitError3 m22 : 48|8@1+ (1,0) [0|0] "" Vector__XXX
 SG_ VCSEC_a031_uds_bytes_4 m31 : 48|8@1+ (1,0) [0|0] "" Vector__XXX
 SG_ VCSEC_a041_CPULoad1000msTask m41 : 48|8@1+ (1,0) [0|0] "" Vector__XXX
 SG_ VCSEC_a042_UsageUDSTask m42 : 48|8@1+ (1,0) [0|0] "" Vector__XXX
 SG_ VCSEC_a113_VEH_driverAssistMapData m113 : 48|1@1+ (1,0) [0|0] "" Vector__XXX
 SG_ VCSEC_a166_operationModeChanged m166 : 48|1@1+ (1,0) [0|0] "" Vector__XXX
 SG_ VCSEC_a167_operationModeChanged m167 : 48|1@1+ (1,0) [0|0] "" Vector__XXX
 SG_ VCSEC_a168_operationModeChanged m168 : 48|1@1+ (1,0) [0|0] "" Vector__XXX
 SG_ VCSEC_a169_operationModeChanged m169 : 48|1@1+ (1,0) [0|0] "" Vector__XXX
 SG_ VCSEC_a170_operationModeChanged m170 : 48|1@1+ (1,0) [0|0] "" Vector__XXX
 SG_ VCSEC_a178_signingKeySlot m178 : 48|5@1+ (1,0) [0|0] "" Vector__XXX
 SG_ VCSEC_a180_whitelistSlot m180 : 48|8@1+ (1,0) [0|0] "" Vector__XXX
 SG_ VCSEC_a211_DevicePresentCount m211 : 48|2@1+ (1,0) [0|0] "" Vector__XXX
 SG_ VCSEC_a257_keyActiveTime m257 : 48|8@1+ (1,0) [0|0] "" Vector__XXX
 SG_ VCSEC_a258_keyActiveTime m258 : 48|8@1+ (1,0) [0|0] "" Vector__XXX
 SG_ VCSEC_a300_keySlot m300 : 48|8@1+ (1,0) [0|0] "" Vector__XXX
 SG_ VCSEC_a472_wlChannel m472 : 48|5@1+ (1,0) [0|0] "" Vector__XXX
 SG_ VCSEC_a473_wlChannel m473 : 48|5@1+ (1,0) [0|0] "" Vector__XXX
 SG_ VCSEC_a477_wlChannel m477 : 48|5@1+ (1,0) [0|0] "" Vector__XXX
 SG_ VCSEC_a495_CoreBTATTError_timeframe m495 : 48|3@1+ (1,0) [0|0] "" Vector__XXX
 SG_ VCSEC_a496_bootReceiver_timeframe m496 : 48|3@1+ (1,0) [0|0] "" Vector__XXX
 SG_ VCSEC_a113_CH_vehicleControl2 m113 : 49|1@1+ (1,0) [0|0] "" Vector__XXX
 SG_ VCSEC_a479_NIStateFront0 m479 : 49|5@1+ (1,0) [0|0] "" Vector__XXX
 SG_ VCSEC_a480_NIStateFront1 m480 : 49|5@1+ (1,0) [0|0] "" Vector__XXX
 SG_ VCSEC_a481_NIStateFront2 m481 : 49|5@1+ (1,0) [0|0] "" Vector__XXX
 SG_ VCSEC_a113_VEH_odo m113 : 50|1@1+ (1,0) [0|0] "" Vector__XXX
 SG_ VCSEC_a211_UnknownDevicePresent m211 : 50|1@1+ (1,0) [0|0] "" Vector__XXX
 SG_ VCSEC_a058_newREstimate m58 : 51|12@1+ (0.00061,0) [0|0] "" Vector__XXX
 SG_ VCSEC_a211_AuthRequested m211 : 51|1@1+ (1,0) [0|0] "" Vector__XXX
 SG_ VCSEC_a495_iOS_launchReason m495 : 51|3@1+ (1,0) [0|0] "" Vector__XXX
 SG_ VCSEC_a211_MaximumRSSI m211 : 52|8@1- (1,0) [0|0] "" Vector__XXX
 SG_ VCSEC_a474_peripheralState m474 : 52|3@1+ (1,0) [0|0] "" Vector__XXX
 SG_ VCSEC_a178_removedKeySlot m178 : 53|5@1+ (1,0) [0|0] "" Vector__XXX
 SG_ VCSEC_a472_receivedRemotely m472 : 53|1@1+ (1,0) [0|0] "" Vector__XXX
 SG_ VCSEC_a473_receivedRemotely m473 : 53|1@1+ (1,0) [0|0] "" Vector__XXX
 SG_ VCSEC_a477_receivedRemotely m477 : 53|1@1+ (1,0) [0|0] "" Vector__XXX
 SG_ VCSEC_a473_remoteStartIssued m473 : 54|1@1+ (1,0) [0|0] "" Vector__XXX
 SG_ VCSEC_a479_NIStateFrontLeft0 m479 : 54|5@1+ (1,0) [0|0] "" Vector__XXX
 SG_ VCSEC_a480_NIStateFrontLeft1 m480 : 54|5@1+ (1,0) [0|0] "" Vector__XXX
 SG_ VCSEC_a481_NIStateFrontLeft2 m481 : 54|5@1+ (1,0) [0|0] "" Vector__XXX
 SG_ VCSEC_a483_warning2_endpoints_global m483 : 54|10@1+ (1,0) [0|0] "" Vector__XXX
 SG_ VCSEC_a473_PhoneKeyServiceDiscovered m473 : 55|1@1+ (1,0) [0|0] "" Vector__XXX
 SG_ VCSEC_a022_TaskInitError4 m22 : 56|8@1+ (1,0) [0|0] "" Vector__XXX
 SG_ VCSEC_a031_uds_bytes_5 m31 : 56|8@1+ (1,0) [0|0] "" Vector__XXX
 SG_ VCSEC_a041_CPULoadNVMMTask m41 : 56|8@1+ (1,0) [0|0] "" Vector__XXX
 SG_ VCSEC_a042_UsageNVMMTask m42 : 56|8@1+ (1,0) [0|0] "" Vector__XXX
 SG_ VCSEC_a180_signingKeySlot m180 : 56|8@1+ (1,0) [0|0] "" Vector__XXX
 SG_ VCSEC_a257_permissionActiveTime m257 : 56|8@1+ (1,0) [0|0] "" Vector__XXX
 SG_ VCSEC_a258_permissionActiveTime m258 : 56|8@1+ (1,0) [0|0] "" Vector__XXX
 SG_ VCSEC_a473_toVehicleCharDiscovered m473 : 56|1@1+ (1,0) [0|0] "" Vector__XXX
 SG_ VCSEC_a474_mobileAppLastCommand_timeframe m474 : 56|3@1+ (1,0) [0|0] "" Vector__XXX
 SG_ VCSEC_a495_iOS_launchReason_timeframe m495 : 56|3@1+ (1,0) [0|0] "" Vector__XXX
 SG_ VCSEC_a473_fromVehicleCharDiscovered m473 : 57|1@1+ (1,0) [0|0] "" Vector__XXX
 SG_ VCSEC_a177_keyRole m177 : 58|4@1+ (1,0) [0|0] "" Vector__XXX
 SG_ VCSEC_a178_removedKeyRole m178 : 58|4@1+ (1,0) [0|0] "" Vector__XXX
 SG_ VCSEC_a473_versionCharDiscovered m473 : 58|1@1+ (1,0) [0|0] "" Vector__XXX
 SG_ VCSEC_a473_bondingServiceDiscovered m473 : 59|1@1+ (1,0) [0|0] "" Vector__XXX
 SG_ VCSEC_a474_mobileAppLastCommandAck_timeframe m474 : 59|3@1+ (1,0) [0|0] "" Vector__XXX
 SG_ VCSEC_a479_NIStateFrontRight0 m479 : 59|5@1+ (1,0) [0|0] "" Vector__XXX
 SG_ VCSEC_a480_NIStateFrontRight1 m480 : 59|5@1+ (1,0) [0|0] "" Vector__XXX
 SG_ VCSEC_a481_NIStateFrontRight2 m481 : 59|5@1+ (1,0) [0|0] "" Vector__XXX
 SG_ VCSEC_a495_iOS_appState m495 : 59|2@1+ (1,0) [0|0] "" Vector__XXX
 SG_ VCSEC_a211_MaximumRSSIAntenna m211 : 60|4@1+ (1,0) [0|0] "" Vector__XXX
 SG_ VCSEC_a473_bondingCharDiscovered m473 : 60|1@1+ (1,0) [0|0] "" Vector__XXX
 SG_ VCSEC_a473_locationPermission m473 : 61|3@1+ (1,0) [0|0] "" Vector__XXX
 SG_ VCSEC_a058_faultReason m58 : 63|1@1+ (1,0) [0|0] "" Vector__XXX

BO_ 1329 VCSEC_alertCleared: 8 Vector__XXX
 SG_ VCSEC_alertClearedID : 0|10@1+ (1,0) [0|0] "" Vector__XXX

BO_ 1330 EPBR_bootID: 8 Vector__XXX
 SG_ EPBR_bootIdData : 0|64@1+ (1,0) [0|0] "" Vector__XXX

BO_ 1331 EPBL_bootID: 8 Vector__XXX
 SG_ EPBL_bootIdData : 0|64@1+ (1,0) [0|0] "" Vector__XXX

BO_ 1332 VCFRONT_alertLog: 8 Vector__XXX
 SG_ VCFRONT_alertID M : 0|10@1+ (1,0) [0|0] "" Vector__XXX
 SG_ VCFRONT_alertState : 15|1@1+ (1,0) [0|0] "" Vector__XXX
 SG_ VCFRONT_a000_alertDataW0 m0 : 16|16@1+ (1,0) [0|0] "" Vector__XXX
 SG_ VCFRONT_a001_InternalWatchdog m1 : 16|1@1+ (1,0) [0|0] "" Vector__XXX
 SG_ VCFRONT_a002_CPUUndervoltage m2 : 16|1@1+ (1,0) [0|0] "" Vector__XXX
 SG_ VCFRONT_a003_AssertID m3 : 16|16@1+ (1,0) [0|0] "" Vector__XXX
 SG_ VCFRONT_a004_APPWatchdogFaultOrMIA m4 : 16|1@1+ (1,0) [0|0] "" Vector__XXX
 SG_ VCFRONT_a005_busID0 m5 : 16|4@1+ (1,0) [0|0] "" Vector__XXX
 SG_ VCFRONT_a006_busID m6 : 16|4@1+ (1,0) [0|0] "" Vector__XXX
 SG_ VCFRONT_a008_APPWatchdogFaultOrMIA m8 : 16|1@1+ (1,0) [0|0] "" Vector__XXX
 SG_ VCFRONT_a009_purgeTimeSeconds m9 : 16|5@1+ (1,0) [0|0] "" Vector__XXX
 SG_ VCFRONT_a010_UnderVoltageDetected m10 : 16|1@1+ (1,0) [0|0] "" Vector__XXX
 SG_ VCFRONT_a012_ClockError m12 : 16|1@1+ (1,0) [0|0] "" Vector__XXX
 SG_ VCFRONT_a013_LogQueueFull m13 : 16|1@1+ (1,0) [0|0] "" Vector__XXX
 SG_ VCFRONT_a015_NVMMMemOverflow m15 : 16|1@1+ (1,0) [0|0] "" Vector__XXX
 SG_ VCFRONT_a016_NVMMRecordID m16 : 16|16@1+ (1,0) [0|0] "" Vector__XXX
 SG_ VCFRONT_a017_NVMMLifetimeEraseCycles m17 : 16|32@1+ (1,0) [0|0] "" Vector__XXX
 SG_ VCFRONT_a021_Task1msLate m21 : 16|1@1+ (1,0) [0|0] "" Vector__XXX
 SG_ VCFRONT_a022_TaskInitErrorCount m22 : 16|8@1+ (1,0) [0|0] "" Vector__XXX
 SG_ VCFRONT_a030_logId m30 : 16|4@1+ (1,0) [0|0] "" Vector__XXX
 SG_ VCFRONT_a031_uds_bytes_0 m31 : 16|8@1+ (1,0) [0|0] "" Vector__XXX
 SG_ VCFRONT_a032_core m32 : 16|2@1+ (1,0) [0|0] "" Vector__XXX
 SG_ VCFRONT_a033_index m33 : 16|7@1+ (1,0) [0|0] "" Vector__XXX
 SG_ VCFRONT_a038_faultType m38 : 16|2@1+ (1,0) [0|0] "" Vector__XXX
 SG_ VCFRONT_a039_faultType m39 : 16|2@1+ (1,0) [0|0] "" Vector__XXX
 SG_ VCFRONT_a040_depth m40 : 16|4@1+ (1,0) [0|0] "" Vector__XXX
 SG_ VCFRONT_a041_CPULoadTotal m41 : 16|8@1+ (1,0) [0|0] "" Vector__XXX
 SG_ VCFRONT_a042_Usage1msTask m42 : 16|8@1+ (1,0) [0|0] "" Vector__XXX
 SG_ VCFRONT_a043_CallTrace0 m43 : 16|24@1+ (1,0) [0|0] "" Vector__XXX
 SG_ VCFRONT_a044_CallTrace0 m44 : 16|24@1+ (1,0) [0|0] "" Vector__XXX
 SG_ VCFRONT_a045_CallTrace0 m45 : 16|24@1+ (1,0) [0|0] "" Vector__XXX
 SG_ VCFRONT_a046_CallTrace0 m46 : 16|24@1+ (1,0) [0|0] "" Vector__XXX
 SG_ VCFRONT_a047_Wdt m47 : 16|1@1+ (1,0) [0|0] "" Vector__XXX
 SG_ VCFRONT_a057_VEH_cpControl m57 : 16|1@1+ (1,0) [0|0] "" Vector__XXX
 SG_ VCFRONT_a058_voltageDrop m58 : 16|12@1+ (0.005443676098,0) [0|0] "" Vector__XXX
 SG_ VCFRONT_a059_voltageDrop m59 : 16|12@1+ (0.005443676098,0) [0|0] "" Vector__XXX
 SG_ VCFRONT_a060_lockoutDisabled m60 : 16|1@1+ (1,0) [0|0] "" Vector__XXX
 SG_ VCFRONT_a063_switchChannel m63 : 16|8@1+ (1,0) [0|0] "" Vector__XXX
 SG_ VCFRONT_a064_busBitField m64 : 16|8@1+ (1,0) [0|0] "" Vector__XXX
 SG_ VCFRONT_a082_RIPC_epbPrivateState m82 : 16|1@1+ (1,0) [0|0] "" Vector__XXX
 SG_ VCFRONT_a083_LIPC_epbPrivateState m83 : 16|1@1+ (1,0) [0|0] "" Vector__XXX
 SG_ VCFRONT_a084_CH_StatusC m84 : 16|1@1+ (1,0) [0|0] "" Vector__XXX
 SG_ VCFRONT_a085_PARTY_buttonStatus m85 : 16|1@1+ (1,0) [0|0] "" Vector__XXX
 SG_ VCFRONT_a086_VEH_LVBMS_statusHigh m86 : 16|1@1+ (1,0) [0|0] "" Vector__XXX
 SG_ VCFRONT_a087_VEH_temperature m87 : 16|1@1+ (1,0) [0|0] "" Vector__XXX
 SG_ VCFRONT_a088_VEH_temperature m88 : 16|1@1+ (1,0) [0|0] "" Vector__XXX
 SG_ VCFRONT_a089_PARTY_party1 m89 : 16|1@1+ (1,0) [0|0] "" Vector__XXX
 SG_ VCFRONT_a090_VEH_chNm m90 : 16|1@1+ (1,0) [0|0] "" Vector__XXX
 SG_ VCFRONT_a091_VEH_faultsAndExtras m91 : 16|1@1+ (1,0) [0|0] "" Vector__XXX
 SG_ VCFRONT_a092_VEH_restraintStatus m92 : 16|1@1+ (1,0) [0|0] "" Vector__XXX
 SG_ VCFRONT_a093_VEH_restraintStatus m93 : 16|1@1+ (1,0) [0|0] "" Vector__XXX
 SG_ VCFRONT_a094_VEH_sysStatus m94 : 16|1@1+ (1,0) [0|0] "" Vector__XXX
 SG_ VCFRONT_a095_PT_ptNm m95 : 16|1@1+ (1,0) [0|0] "" Vector__XXX
 SG_ VCFRONT_a096_VEH_status m96 : 16|1@1+ (1,0) [0|0] "" Vector__XXX
 SG_ VCFRONT_a097_VEH_HVStatus m97 : 16|1@1+ (1,0) [0|0] "" Vector__XXX
 SG_ VCFRONT_a098_CH_torque m98 : 16|1@1+ (1,0) [0|0] "" Vector__XXX
 SG_ VCFRONT_a099_VEH_oocStatus m99 : 16|1@1+ (1,0) [0|0] "" Vector__XXX
 SG_ VCFRONT_a100_VEH m100 : 16|1@1+ (1,0) [0|0] "" Vector__XXX
 SG_ VCFRONT_a101_VEH_state m101 : 16|1@1+ (1,0) [0|0] "" Vector__XXX
 SG_ VCFRONT_a102_VEH_faultsAndExtras m102 : 16|1@1+ (1,0) [0|0] "" Vector__XXX
 SG_ VCFRONT_a103_VEH_hvsNm m103 : 16|1@1+ (1,0) [0|0] "" Vector__XXX
 SG_ VCFRONT_a104_VEH_defogInfoMessage m104 : 16|1@1+ (1,0) [0|0] "" Vector__XXX
 SG_ VCFRONT_a105_VEH_states m105 : 16|1@1+ (1,0) [0|0] "" Vector__XXX
 SG_ VCFRONT_a106_VEH_dcdcStatus m106 : 16|1@1+ (1,0) [0|0] "" Vector__XXX
 SG_ VCFRONT_a107_VEH_hvsNm m107 : 16|1@1+ (1,0) [0|0] "" Vector__XXX
 SG_ VCFRONT_a108_VEH_hvStatus m108 : 16|1@1+ (1,0) [0|0] "" Vector__XXX
 SG_ VCFRONT_a109_PARTY_status m109 : 16|1@1+ (1,0) [0|0] "" Vector__XXX
 SG_ VCFRONT_a110_VEH_status m110 : 16|1@1+ (1,0) [0|0] "" Vector__XXX
 SG_ VCFRONT_a111_VEH_internalStatus m111 : 16|1@1+ (1,0) [0|0] "" Vector__XXX
 SG_ VCFRONT_a112_VEH_internalStatus m112 : 16|1@1+ (1,0) [0|0] "" Vector__XXX
 SG_ VCFRONT_a113_VEH_ethNm m113 : 16|1@1+ (1,0) [0|0] "" Vector__XXX
 SG_ VCFRONT_a114_PARTY_status m114 : 16|1@1+ (1,0) [0|0] "" Vector__XXX
 SG_ VCFRONT_a115_VEH_vehNm m115 : 16|1@1+ (1,0) [0|0] "" Vector__XXX
 SG_ VCFRONT_a116_PARTY_epbmStatus m116 : 16|1@1+ (1,0) [0|0] "" Vector__XXX
 SG_ VCFRONT_a117_BDY_epbmStatus m117 : 16|1@1+ (1,0) [0|0] "" Vector__XXX
 SG_ VCFRONT_a118_VEH_vehNm m118 : 16|1@1+ (1,0) [0|0] "" Vector__XXX
 SG_ VCFRONT_a119_VEH_steerAngle m119 : 16|1@1+ (1,0) [0|0] "" Vector__XXX
 SG_ VCFRONT_a120_PARTY_chassisCntl m120 : 16|1@1+ (1,0) [0|0] "" Vector__XXX
 SG_ VCFRONT_a121_overCurrentError m121 : 16|1@1+ (1,0) [0|0] "" Vector__XXX
 SG_ VCFRONT_a122_junctionTempWarning m122 : 16|1@1+ (1,0) [0|0] "" Vector__XXX
 SG_ VCFRONT_a123_overCurrentError m123 : 16|1@1+ (1,0) [0|0] "" Vector__XXX
 SG_ VCFRONT_a124_junctionTempWarning m124 : 16|1@1+ (1,0) [0|0] "" Vector__XXX
 SG_ VCFRONT_a125_overCurrentError m125 : 16|1@1+ (1,0) [0|0] "" Vector__XXX
 SG_ VCFRONT_a126_junctionTempWarning m126 : 16|1@1+ (1,0) [0|0] "" Vector__XXX
 SG_ VCFRONT_a127_vcleftEFuseCurrent m127 : 16|16@1+ (0.1,0) [0|0] "" Vector__XXX
 SG_ VCFRONT_a128_vcrightEFuseCurrent m128 : 16|16@1+ (0.1,0) [0|0] "" Vector__XXX
 SG_ VCFRONT_a129_pcsEFuseCurrent m129 : 16|16@1+ (0.1,0) [0|0] "" Vector__XXX
 SG_ VCFRONT_a130_epas3pEFuseCurrent m130 : 16|16@1+ (0.1,0) [0|0] "" Vector__XXX
 SG_ VCFRONT_a131_epas3sEFuseCurrent m131 : 16|16@1+ (0.1,0) [0|0] "" Vector__XXX
 SG_ VCFRONT_a132_iBoosterCurrent m132 : 16|16@1+ (0.1,0) [0|0] "" Vector__XXX
 SG_ VCFRONT_a133_espEFuseCurrent m133 : 16|16@1+ (0.1,0) [0|0] "" Vector__XXX
 SG_ VCFRONT_a134_fusedHighCurrent m134 : 16|16@1+ (0.1,0) [0|0] "" Vector__XXX
 SG_ VCFRONT_a136_snsShortCircuit m136 : 16|1@1+ (1,0) [0|0] "" Vector__XXX
 SG_ VCFRONT_a137_snsShortCircuit m137 : 16|1@1+ (1,0) [0|0] "" Vector__XXX
 SG_ VCFRONT_a138_snsShortCircuit m138 : 16|1@1+ (1,0) [0|0] "" Vector__XXX
 SG_ VCFRONT_a139_snsShortCircuit m139 : 16|1@1+ (1,0) [0|0] "" Vector__XXX
 SG_ VCFRONT_a140_snsShortCircuit m140 : 16|1@1+ (1,0) [0|0] "" Vector__XXX
 SG_ VCFRONT_a141_snsShortCircuit m141 : 16|1@1+ (1,0) [0|0] "" Vector__XXX
 SG_ VCFRONT_a142_driverState m142 : 16|4@1+ (1,0) [0|0] "" Vector__XXX
 SG_ VCFRONT_a143_vsUnderVoltage m143 : 16|1@1+ (1,0) [0|0] "" Vector__XXX
 SG_ VCFRONT_a144_vsUnderVoltage m144 : 16|1@1+ (1,0) [0|0] "" Vector__XXX
 SG_ VCFRONT_a145_vsUnderVoltage m145 : 16|1@1+ (1,0) [0|0] "" Vector__XXX
 SG_ VCFRONT_a146_RPMActual m146 : 16|10@1+ (10,0) [0|0] "" Vector__XXX
 SG_ VCFRONT_a147_RPMActual m147 : 16|10@1+ (10,0) [0|0] "" Vector__XXX
 SG_ VCFRONT_a148_RPMActual m148 : 16|10@1+ (10,0) [0|0] "" Vector__XXX
 SG_ VCFRONT_a150_RPMActual m150 : 16|10@1+ (10,0) [0|0] "" Vector__XXX
 SG_ VCFRONT_a151_RPMActual m151 : 16|10@1+ (10,0) [0|0] "" Vector__XXX
 SG_ VCFRONT_a152_RPMActual m152 : 16|10@1+ (10,0) [0|0] "" Vector__XXX
 SG_ VCFRONT_a153_userPresenceState m153 : 16|2@1+ (1,0) [0|0] "" Vector__XXX
 SG_ VCFRONT_a154_lastSilentWakeIBSVoltage m154 : 16|11@1+ (0.005,5) [0|0] "" Vector__XXX
 SG_ VCFRONT_a155_IBSAmpHoursAtContactorsOpen m155 : 16|6@1+ (0.05,-3) [0|0] "" Vector__XXX
 SG_ VCFRONT_a156_motorCounts m156 : 16|11@1+ (1,-100) [0|0] "" Vector__XXX
 SG_ VCFRONT_a157_motorCounts m157 : 16|11@1+ (1,-100) [0|0] "" Vector__XXX
 SG_ VCFRONT_a159_stall m159 : 16|1@1+ (1,0) [0|0] "" Vector__XXX
 SG_ VCFRONT_a160_highDischTemp m160 : 16|1@1+ (1,0) [0|0] "" Vector__XXX
 SG_ VCFRONT_a161_failedStart m161 : 16|1@1+ (1,0) [0|0] "" Vector__XXX
 SG_ VCFRONT_a162_dischargePressure m162 : 16|6@1+ (0.5,0) [0|0] "" Vector__XXX
 SG_ VCFRONT_a163_compDisabledFSR m163 : 16|1@1+ (1,0) [0|0] "" Vector__XXX
 SG_ VCFRONT_a164_lockoutVoltage m164 : 16|16@1+ (0.1,0) [0|0] "" Vector__XXX
 SG_ VCFRONT_a165_lockoutVoltage m165 : 16|16@1+ (0.1,0) [0|0] "" Vector__XXX
 SG_ VCFRONT_a168_leftECU m168 : 16|1@1+ (1,0) [0|0] "" Vector__XXX
 SG_ VCFRONT_a169_leftECU m169 : 16|1@1+ (1,0) [0|0] "" Vector__XXX
 SG_ VCFRONT_a170_leftECU m170 : 16|1@1+ (1,0) [0|0] "" Vector__XXX
 SG_ VCFRONT_a171_VCFRONT m171 : 16|1@1+ (1,0) [0|0] "" Vector__XXX
 SG_ VCFRONT_a172_ECUMismatchBits m172 : 16|47@1+ (1,0) [0|0] "" Vector__XXX
 SG_ VCFRONT_a173_ECUMismatchBits m173 : 16|47@1+ (1,0) [0|0] "" Vector__XXX
 SG_ VCFRONT_a174_driveNotAuthedData m174 : 16|1@1+ (1,0) [0|0] "" Vector__XXX
 SG_ VCFRONT_a175_snsShortCircuit m175 : 16|1@1+ (1,0) [0|0] "" Vector__XXX
 SG_ VCFRONT_a176_vehicleState m176 : 16|3@1+ (1,0) [0|0] "" Vector__XXX
 SG_ VCFRONT_a177_mcuAudioCurrent m177 : 16|10@1+ (0.1,0) [0|0] "" Vector__XXX
 SG_ VCFRONT_a178_pumpOutState m178 : 16|3@1+ (1,0) [0|0] "" Vector__XXX
 SG_ VCFRONT_a179_highLVAmpsIntoPCSLog m179 : 16|1@1+ (1,0) [0|0] "" Vector__XXX
 SG_ VCFRONT_a180_vehiclePowerState m180 : 16|2@1+ (1,0) [0|0] "" Vector__XXX
 SG_ VCFRONT_a181_vehicleState m181 : 16|2@1+ (1,0) [0|0] "" Vector__XXX
 SG_ VCFRONT_a182_deadLV m182 : 16|1@1+ (1,0) [0|0] "" Vector__XXX
 SG_ VCFRONT_a183_deadLV m183 : 16|1@1+ (1,0) [0|0] "" Vector__XXX
 SG_ VCFRONT_a184_hvacFlow m184 : 16|7@1+ (2,0) [0|0] "" Vector__XXX
 SG_ VCFRONT_a186_noDriveChgCableConX m186 : 16|1@1+ (1,0) [0|0] "" Vector__XXX
 SG_ VCFRONT_a187_vehBusRetryCount m187 : 16|9@1+ (1,0) [0|0] "" Vector__XXX
 SG_ VCFRONT_a188_sleepBypassCurrent m188 : 16|8@1+ (0.2,0) [0|0] "" Vector__XXX
 SG_ VCFRONT_a190_frameID m190 : 16|6@1+ (1,0) [0|0] "" Vector__XXX
 SG_ VCFRONT_a191_vehiclePowerState m191 : 16|2@1+ (1,0) [0|0] "" Vector__XXX
 SG_ VCFRONT_a192_vehiclePowerState m192 : 16|2@1+ (1,0) [0|0] "" Vector__XXX
 SG_ VCFRONT_a195_IBSVoltage m195 : 16|12@1+ (0.005443676098,0) [0|0] "" Vector__XXX
 SG_ VCFRONT_a196_factoryMode m196 : 16|1@1+ (1,0) [0|0] "" Vector__XXX
 SG_ VCFRONT_a197_IBSAmpHoursAtStartOfPrecharge m197 : 16|14@1+ (0.005,-40.96) [0|0] "" Vector__XXX
 SG_ VCFRONT_a198_outputState m198 : 16|1@1+ (1,0) [0|0] "" Vector__XXX
 SG_ VCFRONT_a199_outputState m199 : 16|1@1+ (1,0) [0|0] "" Vector__XXX
 SG_ VCFRONT_a200_vcleftSelfTest m200 : 16|4@1+ (1,0) [0|0] "" Vector__XXX
 SG_ VCFRONT_a201_vcrightSelfTest m201 : 16|4@1+ (1,0) [0|0] "" Vector__XXX
 SG_ VCFRONT_a202_pcsSelfTest m202 : 16|4@1+ (1,0) [0|0] "" Vector__XXX
 SG_ VCFRONT_a203_epas3pSelfTest m203 : 16|4@1+ (1,0) [0|0] "" Vector__XXX
 SG_ VCFRONT_a204_epas3sSelfTest m204 : 16|4@1+ (1,0) [0|0] "" Vector__XXX
 SG_ VCFRONT_a205_iBoosterSelfTest m205 : 16|4@1+ (1,0) [0|0] "" Vector__XXX
 SG_ VCFRONT_a206_espSelfTest m206 : 16|4@1+ (1,0) [0|0] "" Vector__XXX
 SG_ VCFRONT_a207_vbatFusedSelfTest m207 : 16|4@1+ (1,0) [0|0] "" Vector__XXX
 SG_ VCFRONT_a210_valveUnderTravel m210 : 16|1@1+ (1,0) [0|0] "" Vector__XXX
 SG_ VCFRONT_a211_DeviceIDBits m211 : 16|8@1+ (1,0) [0|0] "" Vector__XXX
 SG_ VCFRONT_a212_IBSTemp m212 : 16|16@1- (0.01,0) [0|0] "" Vector__XXX
 SG_ VCFRONT_a213_IBSVolts m213 : 16|12@1+ (0.005443676098,0) [0|0] "" Vector__XXX
 SG_ VCFRONT_a216_inDrive m216 : 16|1@1+ (1,0) [0|0] "" Vector__XXX
 SG_ VCFRONT_a218_socPercentThreshold m218 : 16|8@1+ (1,0) [0|0] "" Vector__XXX
 SG_ VCFRONT_a219_IBSVolts m219 : 16|12@1+ (0.005443676098,0) [0|0] "" Vector__XXX
 SG_ VCFRONT_a220_IBSCurrent m220 : 16|16@1- (0.005,0) [0|0] "" Vector__XXX
 SG_ VCFRONT_a221_outputFaulted m221 : 16|1@1+ (1,0) [0|0] "" Vector__XXX
 SG_ VCFRONT_a222_outputFaulted m222 : 16|1@1+ (1,0) [0|0] "" Vector__XXX
 SG_ VCFRONT_a223_12VTemperature m223 : 16|16@1- (0.1,0) [0|0] "" Vector__XXX
 SG_ VCFRONT_a228_RPMActual m228 : 16|10@1+ (10,0) [0|0] "" Vector__XXX
 SG_ VCFRONT_a229_RPMActual m229 : 16|10@1+ (10,0) [0|0] "" Vector__XXX
 SG_ VCFRONT_a230_RPMActual m230 : 16|10@1+ (10,0) [0|0] "" Vector__XXX
 SG_ VCFRONT_a231_12VTemperature m231 : 16|16@1- (0.1,0) [0|0] "" Vector__XXX
 SG_ VCFRONT_a232_sHFeedbackHigherThanOriginalLimit m232 : 16|1@1+ (1,0) [0|0] "" Vector__XXX
 SG_ VCFRONT_a233_current m233 : 16|10@1+ (0.1,0) [0|0] "" Vector__XXX
 SG_ VCFRONT_a234_current m234 : 16|10@1+ (0.1,0) [0|0] "" Vector__XXX
 SG_ VCFRONT_a235_ptSensorTemp m235 : 16|11@1+ (0.125,-40) [0|0] "" Vector__XXX
 SG_ VCFRONT_a236_batSensorTemp m236 : 16|11@1+ (0.125,-40) [0|0] "" Vector__XXX
 SG_ VCFRONT_a237_spiErrorCount m237 : 16|1@1+ (1,0) [0|0] "" Vector__XXX
 SG_ VCFRONT_a238_spiErrorCount m238 : 16|1@1+ (1,0) [0|0] "" Vector__XXX
 SG_ VCFRONT_a239_spiErrorCount m239 : 16|1@1+ (1,0) [0|0] "" Vector__XXX
 SG_ VCFRONT_a240_lowPsCutoutCabinCool m240 : 16|1@1+ (1,0) [0|0] "" Vector__XXX
 SG_ VCFRONT_a242_LVBatteryTemp m242 : 16|7@1+ (1,-40) [0|0] "" Vector__XXX
 SG_ VCFRONT_a243_IBSVolts m243 : 16|12@1+ (0.005443676098,0) [0|0] "" Vector__XXX
 SG_ VCFRONT_a244_current m244 : 16|16@1+ (0.1,0) [0|0] "" Vector__XXX
 SG_ VCFRONT_a245_current m245 : 16|16@1+ (0.1,0) [0|0] "" Vector__XXX
 SG_ VCFRONT_a246_current m246 : 16|16@1+ (0.1,0) [0|0] "" Vector__XXX
 SG_ VCFRONT_a247_solenoidISense m247 : 16|8@1- (0.01,0) [0|0] "" Vector__XXX
 SG_ VCFRONT_a248_AS8510Voltage m248 : 16|12@1+ (0.005443676098,0) [0|0] "" Vector__XXX
 SG_ VCFRONT_a249_tempCoolantBatInlet m249 : 16|10@1+ (0.125,-40) [0|0] "" Vector__XXX
 SG_ VCFRONT_a250_isGlobalHeadlamps m250 : 16|1@1+ (1,0) [0|0] "" Vector__XXX
 SG_ VCFRONT_a251_UIKeepAwake m251 : 16|6@1+ (1,0) [0|0] "" Vector__XXX
 SG_ VCFRONT_a252_IBSVoltage m252 : 16|12@1+ (0.005443676098,0) [0|0] "" Vector__XXX
 SG_ VCFRONT_a253_currentNotTapered m253 : 16|1@1+ (1,0) [0|0] "" Vector__XXX
 SG_ VCFRONT_a254_RPMActual m254 : 16|10@1+ (10,0) [0|0] "" Vector__XXX
 SG_ VCFRONT_a255_RPMActual m255 : 16|10@1+ (10,0) [0|0] "" Vector__XXX
 SG_ VCFRONT_a257_lockoutVoltage m257 : 16|16@1+ (0.1,0) [0|0] "" Vector__XXX
 SG_ VCFRONT_a258_minVoltageReached m258 : 16|12@1+ (0.005443676098,0) [0|0] "" Vector__XXX
 SG_ VCFRONT_a259_serviceMode m259 : 16|1@1+ (1,0) [0|0] "" Vector__XXX
 SG_ VCFRONT_a260_IBSVolts m260 : 16|12@1+ (0.005443676098,0) [0|0] "" Vector__XXX
 SG_ VCFRONT_a261_eFuseVoltage m261 : 16|16@1+ (0.1,0) [0|0] "" Vector__XXX
 SG_ VCFRONT_a262_eFuseVoltage m262 : 16|16@1+ (0.1,0) [0|0] "" Vector__XXX
 SG_ VCFRONT_a263_eFuseVoltage m263 : 16|16@1+ (0.1,0) [0|0] "" Vector__XXX
 SG_ VCFRONT_a264_eFuseVoltage m264 : 16|16@1+ (0.1,0) [0|0] "" Vector__XXX
 SG_ VCFRONT_a265_eFuseVoltage m265 : 16|16@1+ (0.1,0) [0|0] "" Vector__XXX
 SG_ VCFRONT_a266_eFuseVoltage m266 : 16|16@1+ (0.1,0) [0|0] "" Vector__XXX
 SG_ VCFRONT_a267_eFuseVoltage m267 : 16|16@1+ (0.1,0) [0|0] "" Vector__XXX
 SG_ VCFRONT_a268_eFuseVoltage m268 : 16|16@1+ (0.1,0) [0|0] "" Vector__XXX
 SG_ VCFRONT_a269_LVBatteryTemp m269 : 16|7@1+ (1,-40) [0|0] "" Vector__XXX
 SG_ VCFRONT_a271_shortedCellTestTrigger m271 : 16|1@1+ (1,0) [0|0] "" Vector__XXX
 SG_ VCFRONT_a273_inwipePowerFailureToResolve m273 : 16|1@1+ (1,0) [0|0] "" Vector__XXX
 SG_ VCFRONT_a274_shortedCellTestTrigger m274 : 16|1@1+ (1,0) [0|0] "" Vector__XXX
 SG_ VCFRONT_a275_breakLocationA m275 : 16|5@1+ (1,0) [0|0] "" Vector__XXX
 SG_ VCFRONT_a276_breakLocationA m276 : 16|5@1+ (1,0) [0|0] "" Vector__XXX
 SG_ VCFRONT_a277_bmbDeviceMask m277 : 16|16@1+ (1,0) [0|0] "" Vector__XXX
 SG_ VCFRONT_a279_snsShortCircuit m279 : 16|1@1+ (1,0) [0|0] "" Vector__XXX
 SG_ VCFRONT_a280_snsShortCircuit m280 : 16|1@1+ (1,0) [0|0] "" Vector__XXX
 SG_ VCFRONT_a283_thmlFanDisabled m283 : 16|1@1+ (1,0) [0|0] "" Vector__XXX
 SG_ VCFRONT_a284_driverState m284 : 16|4@1+ (1,0) [0|0] "" Vector__XXX
 SG_ VCFRONT_a285_driverState m285 : 16|4@1+ (1,0) [0|0] "" Vector__XXX
 SG_ VCFRONT_a286_driverState m286 : 16|4@1+ (1,0) [0|0] "" Vector__XXX
 SG_ VCFRONT_a287_driverState m287 : 16|4@1+ (1,0) [0|0] "" Vector__XXX
 SG_ VCFRONT_a288_driverState m288 : 16|4@1+ (1,0) [0|0] "" Vector__XXX
 SG_ VCFRONT_a289_driverState m289 : 16|4@1+ (1,0) [0|0] "" Vector__XXX
 SG_ VCFRONT_a290_outputFaulted m290 : 16|1@1+ (1,0) [0|0] "" Vector__XXX
 SG_ VCFRONT_a291_outputFaulted m291 : 16|1@1+ (1,0) [0|0] "" Vector__XXX
 SG_ VCFRONT_a292_outputFaulted m292 : 16|1@1+ (1,0) [0|0] "" Vector__XXX
 SG_ VCFRONT_a293_outputFaulted m293 : 16|1@1+ (1,0) [0|0] "" Vector__XXX
 SG_ VCFRONT_a294_outputFaulted m294 : 16|1@1+ (1,0) [0|0] "" Vector__XXX
 SG_ VCFRONT_a295_outputFaulted m295 : 16|1@1+ (1,0) [0|0] "" Vector__XXX
 SG_ VCFRONT_a296_turnIndicatorStalkStatus m296 : 16|3@1+ (1,0) [0|0] "" Vector__XXX
 SG_ VCFRONT_a297_bmbDeviceId m297 : 16|4@1+ (1,1) [0|0] "" Vector__XXX
 SG_ VCFRONT_a299_LINBusy m299 : 16|1@1+ (1,0) [0|0] "" Vector__XXX
 SG_ VCFRONT_a300_oldType m300 : 16|2@1+ (1,0) [0|0] "" Vector__XXX
 SG_ VCFRONT_a302_LINFrameStatus m302 : 16|3@1+ (1,0) [0|0] "" Vector__XXX
 SG_ VCFRONT_a303_vehicleSpeed m303 : 16|12@1+ (0.08,-40) [0|0] "" Vector__XXX
 SG_ VCFRONT_a304_voltage m304 : 16|7@1+ (0.15,0) [0|0] "" Vector__XXX
 SG_ VCFRONT_a305_voltage m305 : 16|7@1+ (0.15,0) [0|0] "" Vector__XXX
 SG_ VCFRONT_a306_voltage m306 : 16|7@1+ (0.15,0) [0|0] "" Vector__XXX
 SG_ VCFRONT_a307_voltage m307 : 16|7@1+ (0.15,0) [0|0] "" Vector__XXX
 SG_ VCFRONT_a308_voltage m308 : 16|7@1+ (0.15,0) [0|0] "" Vector__XXX
 SG_ VCFRONT_a309_vehicleSpeed m309 : 16|12@1+ (0.08,-40) [0|0] "" Vector__XXX
 SG_ VCFRONT_a310_maxSlope m310 : 16|11@1+ (0.125,-40) [0|0] "" Vector__XXX
 SG_ VCFRONT_a311_maxSlope m311 : 16|11@1+ (0.125,-40) [0|0] "" Vector__XXX
 SG_ VCFRONT_a312_maxSlope m312 : 16|11@1+ (0.125,-40) [0|0] "" Vector__XXX
 SG_ VCFRONT_a313_maxSlope m313 : 16|11@1+ (0.125,-40) [0|0] "" Vector__XXX
 SG_ VCFRONT_a314_maxSlope m314 : 16|11@1+ (0.125,-40) [0|0] "" Vector__XXX
 SG_ VCFRONT_a315_maxSlope m315 : 16|11@1+ (0.125,-40) [0|0] "" Vector__XXX
 SG_ VCFRONT_a316_maxSlope m316 : 16|11@1+ (0.125,-40) [0|0] "" Vector__XXX
 SG_ VCFRONT_a317_maxSlope m317 : 16|11@1+ (0.125,-40) [0|0] "" Vector__XXX
 SG_ VCFRONT_a318_maxSlope m318 : 16|11@1+ (0.125,-40) [0|0] "" Vector__XXX
 SG_ VCFRONT_a319_maxSlope m319 : 16|11@1+ (0.125,-40) [0|0] "" Vector__XXX
 SG_ VCFRONT_a320_maxSlope m320 : 16|11@1+ (0.125,-40) [0|0] "" Vector__XXX
 SG_ VCFRONT_a321_maxSlope m321 : 16|11@1+ (0.125,-40) [0|0] "" Vector__XXX
 SG_ VCFRONT_a322_maxSlope m322 : 16|11@1+ (0.125,-40) [0|0] "" Vector__XXX
 SG_ VCFRONT_a323_maxSlope m323 : 16|11@1+ (0.125,-40) [0|0] "" Vector__XXX
 SG_ VCFRONT_a324_maxSlope m324 : 16|11@1+ (0.125,-40) [0|0] "" Vector__XXX
 SG_ VCFRONT_a325_maxSlope m325 : 16|11@1+ (0.125,-40) [0|0] "" Vector__XXX
 SG_ VCFRONT_a326_avgCurrent m326 : 16|16@1+ (0.1,0) [0|0] "" Vector__XXX
 SG_ VCFRONT_a327_avgCurrent m327 : 16|16@1+ (0.1,0) [0|0] "" Vector__XXX
 SG_ VCFRONT_a328_avgCurrent m328 : 16|16@1+ (0.1,0) [0|0] "" Vector__XXX
 SG_ VCFRONT_a329_avgCurrent m329 : 16|16@1+ (0.1,0) [0|0] "" Vector__XXX
 SG_ VCFRONT_a330_avgCurrent m330 : 16|16@1+ (0.1,0) [0|0] "" Vector__XXX
 SG_ VCFRONT_a331_avgCurrent m331 : 16|16@1+ (0.1,0) [0|0] "" Vector__XXX
 SG_ VCFRONT_a332_avgCurrent m332 : 16|16@1+ (0.1,0) [0|0] "" Vector__XXX
 SG_ VCFRONT_a333_avgCurrent m333 : 16|16@1+ (0.1,0) [0|0] "" Vector__XXX
 SG_ VCFRONT_a334_maxSlope m334 : 16|12@1+ (0.1,0) [0|0] "" Vector__XXX
 SG_ VCFRONT_a335_maxSlope m335 : 16|12@1+ (0.1,0) [0|0] "" Vector__XXX
 SG_ VCFRONT_a336_maxSlope m336 : 16|12@1+ (0.1,0) [0|0] "" Vector__XXX
 SG_ VCFRONT_a337_maxSlope m337 : 16|12@1+ (0.1,0) [0|0] "" Vector__XXX
 SG_ VCFRONT_a338_maxSlope m338 : 16|12@1+ (0.1,0) [0|0] "" Vector__XXX
 SG_ VCFRONT_a339_maxSlope m339 : 16|12@1+ (0.1,0) [0|0] "" Vector__XXX
 SG_ VCFRONT_a340_maxSlope m340 : 16|12@1+ (0.1,0) [0|0] "" Vector__XXX
 SG_ VCFRONT_a341_maxSlope m341 : 16|12@1+ (0.1,0) [0|0] "" Vector__XXX
 SG_ VCFRONT_a342_maxSlope m342 : 16|12@1+ (0.1,0) [0|0] "" Vector__XXX
 SG_ VCFRONT_a343_maxSlope m343 : 16|12@1+ (0.1,0) [0|0] "" Vector__XXX
 SG_ VCFRONT_a344_maxSlope m344 : 16|12@1+ (0.1,0) [0|0] "" Vector__XXX
 SG_ VCFRONT_a345_maxSlope m345 : 16|12@1+ (0.1,0) [0|0] "" Vector__XXX
 SG_ VCFRONT_a346_maxSlope m346 : 16|12@1+ (0.1,0) [0|0] "" Vector__XXX
 SG_ VCFRONT_a347_maxSlope m347 : 16|12@1+ (0.1,0) [0|0] "" Vector__XXX
 SG_ VCFRONT_a348_maxSlope m348 : 16|12@1+ (0.1,0) [0|0] "" Vector__XXX
 SG_ VCFRONT_a349_maxSlope m349 : 16|12@1+ (0.1,0) [0|0] "" Vector__XXX
 SG_ VCFRONT_a350_espValveCurrent m350 : 16|10@1+ (0.1,0) [0|0] "" Vector__XXX
 SG_ VCFRONT_a352_pointsAboveThreshold m352 : 16|10@1+ (1,0) [0|0] "" Vector__XXX
 SG_ VCFRONT_a353_wiperHeaterCurrent m353 : 16|8@1+ (0.1,0) [0|0] "" Vector__XXX
 SG_ VCFRONT_a354_windshieldCameraHeaterCurrent m354 : 16|8@1+ (0.1,0) [0|0] "" Vector__XXX
 SG_ VCFRONT_a355_fluidNotFilled m355 : 16|1@1+ (1,0) [0|0] "" Vector__XXX
 SG_ VCFRONT_a356_fluidNotFilled m356 : 16|1@1+ (1,0) [0|0] "" Vector__XXX
 SG_ VCFRONT_a357_maxTransientCurrent m357 : 16|10@1+ (0.02,0) [0|0] "" Vector__XXX
 SG_ VCFRONT_a358_maxTransientCurrent m358 : 16|10@1+ (0.05,0) [0|0] "" Vector__XXX
 SG_ VCFRONT_a359_IBSVolts m359 : 16|12@1+ (0.005443676098,0) [0|0] "" Vector__XXX
 SG_ VCFRONT_a360_vehicleLoadShedActive m360 : 16|1@1+ (1,0) [0|0] "" Vector__XXX
 SG_ VCFRONT_a363_minBleedCharge m363 : 16|15@1+ (0.001,0) [0|0] "" Vector__XXX
 SG_ VCFRONT_a364_channel m364 : 16|1@1+ (1,0) [0|0] "" Vector__XXX
 SG_ VCFRONT_a365_startSuccessful m365 : 16|1@1+ (1,0) [0|0] "" Vector__XXX
 SG_ VCFRONT_a366_enteringState m366 : 16|3@1+ (1,0) [0|0] "" Vector__XXX
 SG_ VCFRONT_a367_bmsSoc m367 : 16|8@1+ (0.5,0) [0|0] "" Vector__XXX
 SG_ VCFRONT_a368_bmsRequestRemoved m368 : 16|1@1+ (1,0) [0|0] "" Vector__XXX
 SG_ VCFRONT_a369_powerGenerationLimited m369 : 16|1@1+ (1,0) [0|0] "" Vector__XXX
 SG_ VCFRONT_a370_IBSVolts m370 : 16|12@1+ (0.005443676098,0) [0|0] "" Vector__XXX
 SG_ VCFRONT_a371_shortedCellTestTrigger m371 : 16|1@1+ (1,0) [0|0] "" Vector__XXX
 SG_ VCFRONT_a372_bmbDeviceId m372 : 16|4@1+ (1,1) [0|0] "" Vector__XXX
 SG_ VCFRONT_a373_tempSuperheatActual m373 : 16|10@1+ (0.1,-20) [0|0] "" Vector__XXX
 SG_ VCFRONT_a374_lccInletSolenoidISense m374 : 16|8@1- (0.01,0) [0|0] "" Vector__XXX
 SG_ VCFRONT_a375_refVoltageScaleFactor m375 : 16|12@1+ (0.1,0) [0|0] "" Vector__XXX
 SG_ VCFRONT_a376_IBSCurrentSampleCount m376 : 16|16@1+ (1,0) [0|0] "" Vector__XXX
 SG_ VCFRONT_a377_wiperStuckOutOfPark m377 : 16|1@1+ (1,0) [0|0] "" Vector__XXX
 SG_ VCFRONT_a378_wiperBlocked m378 : 16|1@1+ (1,0) [0|0] "" Vector__XXX
 SG_ VCFRONT_a379_minVoltageReached m379 : 16|12@1+ (0.005443676098,0) [0|0] "" Vector__XXX
 SG_ VCFRONT_a380_driverState m380 : 16|4@1+ (1,0) [0|0] "" Vector__XXX
 SG_ VCFRONT_a381_driverState m381 : 16|4@1+ (1,0) [0|0] "" Vector__XXX
 SG_ VCFRONT_a382_driverState m382 : 16|4@1+ (1,0) [0|0] "" Vector__XXX
 SG_ VCFRONT_a383_driverState m383 : 16|4@1+ (1,0) [0|0] "" Vector__XXX
 SG_ VCFRONT_a384_driverState m384 : 16|4@1+ (1,0) [0|0] "" Vector__XXX
 SG_ VCFRONT_a385_driverState m385 : 16|4@1+ (1,0) [0|0] "" Vector__XXX
 SG_ VCFRONT_a386_driverState m386 : 16|4@1+ (1,0) [0|0] "" Vector__XXX
 SG_ VCFRONT_a387_shortedCellFaultCounter m387 : 16|3@1+ (1,0) [0|0] "" Vector__XXX
 SG_ VCFRONT_a388_shortedCellFaultCounter m388 : 16|3@1+ (1,0) [0|0] "" Vector__XXX
 SG_ VCFRONT_a389_closedAtSpeed m389 : 16|1@1+ (1,0) [0|0] "" Vector__XXX
 SG_ VCFRONT_a390_cabinLoadType m390 : 16|2@1+ (1,0) [0|0] "" Vector__XXX
 SG_ VCFRONT_a391_switchMismatch m391 : 16|1@1+ (1,0) [0|0] "" Vector__XXX
 SG_ VCFRONT_a392_bmbDeviceId m392 : 16|4@1+ (1,1) [0|0] "" Vector__XXX
 SG_ VCFRONT_a394_discharge m394 : 16|1@1+ (1,0) [0|0] "" Vector__XXX
 SG_ VCFRONT_a397_discharge m397 : 16|1@1+ (1,0) [0|0] "" Vector__XXX
 SG_ VCFRONT_a400_VrefSample m400 : 16|16@1+ (0.0001,0) [0|0] "" Vector__XXX
 SG_ VCFRONT_a401_LVBatteryTemp m401 : 16|7@1+ (1,-40) [0|0] "" Vector__XXX
 SG_ VCFRONT_a402_LVBatteryTemp m402 : 16|7@1+ (1,-40) [0|0] "" Vector__XXX
 SG_ VCFRONT_a403_IBSCurrent m403 : 16|15@1- (0.005,0) [0|0] "" Vector__XXX
 SG_ VCFRONT_a404_minVoltageReached m404 : 16|12@1+ (0.005443676098,0) [0|0] "" Vector__XXX
 SG_ VCFRONT_a405_dcrMilliOhms m405 : 16|8@1+ (0.2,0) [0|0] "" Vector__XXX
 SG_ VCFRONT_a406_pulseVoltage1 m406 : 16|8@1+ (0.02,9) [0|0] "" Vector__XXX
 SG_ VCFRONT_a407_dcrMilliOhms m407 : 16|8@1+ (0.2,0) [0|0] "" Vector__XXX
 SG_ VCFRONT_a408_IBSCurrent m408 : 16|16@1- (0.005,0) [0|0] "" Vector__XXX
 SG_ VCFRONT_a409_brushlessMotorConfigurationInvalid m409 : 16|1@1+ (1,0) [0|0] "" Vector__XXX
 SG_ VCFRONT_a410_LVBatteryTemp m410 : 16|7@1+ (1,-40) [0|0] "" Vector__XXX
 SG_ VCFRONT_a411_LVBatteryTemp m411 : 16|7@1+ (1,-40) [0|0] "" Vector__XXX
 SG_ VCFRONT_a412_dcrMilliOhmsShifted m412 : 16|8@1+ (0.2,0) [0|0] "" Vector__XXX
 SG_ VCFRONT_a413_VrefSample m413 : 16|16@1+ (0.0001,0) [0|0] "" Vector__XXX
 SG_ VCFRONT_a414_dcrMilliOhms m414 : 16|6@1+ (1,0) [0|0] "" Vector__XXX
 SG_ VCFRONT_a415_dcrMilliOhms m415 : 16|6@1+ (1,0) [0|0] "" Vector__XXX
 SG_ VCFRONT_a416_brickVoltageMin m416 : 16|10@1+ (0.005,0) [0|0] "" Vector__XXX
 SG_ VCFRONT_a417_brickVoltageMin m417 : 16|10@1+ (0.005,0) [0|0] "" Vector__XXX
 SG_ VCFRONT_a418_brickVoltageMin m418 : 16|10@1+ (0.005,0) [0|0] "" Vector__XXX
 SG_ VCFRONT_a419_brickVoltageMin m419 : 16|10@1+ (0.005,0) [0|0] "" Vector__XXX
 SG_ VCFRONT_a420_partyTimeS m420 : 16|10@1+ (1,0) [0|0] "" Vector__XXX
 SG_ VCFRONT_a421_inFactoryMode m421 : 16|1@1+ (1,0) [0|0] "" Vector__XXX
 SG_ VCFRONT_a423_brickVoltageMin m423 : 16|10@1+ (0.005,0) [0|0] "" Vector__XXX
 SG_ VCFRONT_a424_brickVoltageMin m424 : 16|10@1+ (0.005,0) [0|0] "" Vector__XXX
 SG_ VCFRONT_a425_busVoltage m425 : 16|16@1+ (0.002,0) [0|0] "" Vector__XXX
 SG_ VCFRONT_a426_busVoltage m426 : 16|16@1+ (0.002,0) [0|0] "" Vector__XXX
 SG_ VCFRONT_a427_initialSoc m427 : 16|9@1+ (0.2,0) [0|0] "" Vector__XXX
 SG_ VCFRONT_a428_minBrickCacId m428 : 16|7@1+ (1,1) [0|0] "" Vector__XXX
 SG_ VCFRONT_a429_sohTestEndMode m429 : 16|4@1+ (1,0) [0|0] "" Vector__XXX
 SG_ VCFRONT_a430_netPackCurrent m430 : 16|16@1- (0.1,0) [0|0] "" Vector__XXX
 SG_ VCFRONT_a431_netPackCurrent m431 : 16|16@1- (0.1,0) [0|0] "" Vector__XXX
 SG_ VCFRONT_a432_targetCurrent m432 : 16|16@1- (0.1,0) [0|0] "" Vector__XXX
 SG_ VCFRONT_a433_bmbModuleId m433 : 16|16@1+ (1,0) [0|0] "" Vector__XXX
 SG_ VCFRONT_a434_bmbModuleId m434 : 16|16@1+ (1,0) [0|0] "" Vector__XXX
 SG_ VCFRONT_a435_netPackCurrent m435 : 16|16@1- (0.1,0) [0|0] "" Vector__XXX
 SG_ VCFRONT_a436_netPackCurrent m436 : 16|16@1- (0.1,0) [0|0] "" Vector__XXX
 SG_ VCFRONT_a437_nvmDataMissingA m437 : 16|1@1+ (1,0) [0|0] "" Vector__XXX
 SG_ VCFRONT_a438_temperature m438 : 16|16@1+ (0.01,0) [0|0] "" Vector__XXX
 SG_ VCFRONT_a439_temperature m439 : 16|16@1+ (0.01,0) [0|0] "" Vector__XXX
 SG_ VCFRONT_a441_bmbModuleId m441 : 16|16@1+ (1,0) [0|0] "" Vector__XXX
 SG_ VCFRONT_a442_maxSocChange m442 : 16|11@1- (0.1,0) [0|0] "" Vector__XXX
 SG_ VCFRONT_a443_bmbDeviceId m443 : 16|4@1+ (1,1) [0|0] "" Vector__XXX
 SG_ VCFRONT_a444_retriesAvailable m444 : 16|8@1+ (1,0) [0|0] "" Vector__XXX
 SG_ VCFRONT_a445_checksFailedCount m445 : 16|2@1+ (1,0) [0|0] "" Vector__XXX
 SG_ VCFRONT_a446_compFaultRefrigerant m446 : 16|1@1+ (1,0) [0|0] "" Vector__XXX
 SG_ VCFRONT_a447_caseHVACUnavailable m447 : 16|1@1+ (1,0) [0|0] "" Vector__XXX
 SG_ VCFRONT_a448_bootpCount m448 : 16|8@1+ (1,0) [0|0] "" Vector__XXX
 SG_ VCFRONT_a459_coolantFillActive m459 : 16|1@1+ (1,0) [0|0] "" Vector__XXX
 SG_ VCFRONT_a461_socByAhRaw m461 : 16|11@1+ (0.1,0) [0|0] "" Vector__XXX
 SG_ VCFRONT_a462_CellOVLevel1 m462 : 16|1@1+ (1,0) [0|0] "" Vector__XXX
 SG_ VCFRONT_a463_switchMismatch m463 : 16|1@1+ (1,0) [0|0] "" Vector__XXX
 SG_ VCFRONT_a464_flowIndex m464 : 16|8@1+ (1,0) [0|0] "" Vector__XXX
 SG_ VCFRONT_a465_flowIndex m465 : 16|8@1+ (1,0) [0|0] "" Vector__XXX
 SG_ VCFRONT_a466_flowIndex m466 : 16|8@1+ (1,0) [0|0] "" Vector__XXX
 SG_ VCFRONT_a467_powerIndexFiltered m467 : 16|7@1+ (1,0) [0|0] "" Vector__XXX
 SG_ VCFRONT_a468_powerIndexFiltered m468 : 16|7@1+ (1,0) [0|0] "" Vector__XXX
 SG_ VCFRONT_a469_pressureDischargeEstimated m469 : 16|8@1+ (0.2,0) [0|0] "" Vector__XXX
 SG_ VCFRONT_a470_pressureLiquid m470 : 16|8@1+ (0.2,0) [0|0] "" Vector__XXX
 SG_ VCFRONT_a472_range m472 : 16|10@1+ (1,0) [0|0] "" Vector__XXX
 SG_ VCFRONT_a473_range m473 : 16|10@1+ (1,0) [0|0] "" Vector__XXX
 SG_ VCFRONT_a474_ssl100Bank1Status m474 : 16|2@1+ (1,0) [0|0] "" Vector__XXX
 SG_ VCFRONT_a475_ssl100Bank1Status m475 : 16|2@1+ (1,0) [0|0] "" Vector__XXX
 SG_ VCFRONT_a476_FRM1_timedOut m476 : 16|1@1+ (1,0) [0|0] "" Vector__XXX
 SG_ VCFRONT_a477_cell1Voltage m477 : 16|9@1+ (0.01,0) [0|0] "" Vector__XXX
 SG_ VCFRONT_a478_battFaultPackOverVoltage m478 : 16|1@1+ (1,0) [0|0] "" Vector__XXX
 SG_ VCFRONT_a479_FRM3_timedOut m479 : 16|1@1+ (1,0) [0|0] "" Vector__XXX
 SG_ VCFRONT_a480_channel m480 : 16|3@1+ (1,0) [0|0] "" Vector__XXX
 SG_ VCFRONT_a481_channel m481 : 16|8@1+ (1,0) [0|0] "" Vector__XXX
 SG_ VCFRONT_a482_migrationState m482 : 16|2@1+ (1,0) [0|0] "" Vector__XXX
 SG_ VCFRONT_a483_NCV70501Fault m483 : 16|3@1+ (1,0) [0|0] "" Vector__XXX
 SG_ VCFRONT_a484_frontRideHeight m484 : 16|8@1- (1,0) [0|0] "" Vector__XXX
 SG_ VCFRONT_a485_migrationState m485 : 16|2@1+ (1,0) [0|0] "" Vector__XXX
 SG_ VCFRONT_a486_mcuGraphicsEFuseCurrent m486 : 16|10@1+ (0.1,0) [0|0] "" Vector__XXX
 SG_ VCFRONT_a487_lastPosition m487 : 16|10@1+ (1,0) [0|0] "" Vector__XXX
 SG_ VCFRONT_a488_NCV70501Fault m488 : 16|3@1+ (1,0) [0|0] "" Vector__XXX
 SG_ VCFRONT_a489_ChillerEXV m489 : 16|1@1+ (1,0) [0|0] "" Vector__XXX
 SG_ VCFRONT_a490_coolantPumpType m490 : 16|3@1+ (1,0) [0|0] "" Vector__XXX
 SG_ VCFRONT_a491_lastPosition m491 : 16|10@1+ (1,0) [0|0] "" Vector__XXX
 SG_ VCFRONT_a492_minBrickSocId m492 : 16|7@1+ (1,1) [0|0] "" Vector__XXX
 SG_ VCFRONT_a493_minBrickSocId m493 : 16|7@1+ (1,1) [0|0] "" Vector__XXX
 SG_ VCFRONT_a495_SoCUnrecoverable m495 : 16|1@1+ (1,0) [0|0] "" Vector__XXX
 SG_ VCFRONT_a496_reverseBatteryEFuseFault m496 : 16|1@1+ (1,0) [0|0] "" Vector__XXX
 SG_ VCFRONT_a497_serviceMode m497 : 16|1@1+ (1,0) [0|0] "" Vector__XXX
 SG_ VCFRONT_a498_packTemp m498 : 16|8@1+ (0.5,-20) [0|0] "" Vector__XXX
 SG_ VCFRONT_a499_maxHVBMSCellTemp m499 : 16|8@1+ (1,0) [0|0] "" Vector__XXX
 SG_ VCFRONT_a500_channel m500 : 16|8@1+ (1,0) [0|0] "" Vector__XXX
 SG_ VCFRONT_a501_channel m501 : 16|8@1+ (1,0) [0|0] "" Vector__XXX
 SG_ VCFRONT_a502_worstBrickId m502 : 16|7@1+ (1,1) [0|0] "" Vector__XXX
 SG_ VCFRONT_a503_brickVoltageMin m503 : 16|10@1+ (0.005,0) [0|0] "" Vector__XXX
 SG_ VCFRONT_a505_voltageInmV m505 : 16|16@1+ (1,0) [0|0] "" Vector__XXX
 SG_ VCFRONT_a506_superManifoldType m506 : 16|2@1+ (1,0) [0|0] "" Vector__XXX
 SG_ VCFRONT_a507_headlampAimRequestSource m507 : 16|2@1+ (1,0) [0|0] "" Vector__XXX
 SG_ VCFRONT_a508_brickImpedance m508 : 16|14@1+ (2.5e-05,0) [0|0] "" Vector__XXX
 SG_ VCFRONT_a509_vcrightEFuseCurrent m509 : 16|16@1- (0.1,0) [0|0] "" Vector__XXX
 SG_ VCFRONT_a510_sumCellVoltage m510 : 16|8@1+ (0.1,0) [0|0] "" Vector__XXX
 SG_ VCFRONT_a511_PCSEFuseCurrent m511 : 16|16@1- (0.1,0) [0|0] "" Vector__XXX
 SG_ VCFRONT_a512_packVoltageIntervalMin m512 : 16|8@1+ (0.1,0) [0|0] "" Vector__XXX
 SG_ VCFRONT_a513_packCurrent m513 : 16|12@1+ (0.2,-600) [0|0] "" Vector__XXX
 SG_ VCFRONT_a514_cell1Voltage m514 : 16|7@1+ (0.08,0) [0|0] "" Vector__XXX
 SG_ VCFRONT_a515_cell1Voltage m515 : 16|7@1+ (0.08,0) [0|0] "" Vector__XXX
 SG_ VCFRONT_a516_IBSVoltage m516 : 16|8@1+ (0.1,0) [0|0] "" Vector__XXX
 SG_ VCFRONT_a517_IBSVoltage m517 : 16|8@1+ (0.1,0) [0|0] "" Vector__XXX
 SG_ VCFRONT_a518_packVoltage m518 : 16|8@1+ (0.1,0) [0|0] "" Vector__XXX
 SG_ VCFRONT_a521_vcleftEFuseCurrent m521 : 16|16@1- (0.1,0) [0|0] "" Vector__XXX
 SG_ VCFRONT_a522_IBSVoltage m522 : 16|8@1+ (0.1,0) [0|0] "" Vector__XXX
 SG_ VCFRONT_a523_channel m523 : 16|8@1+ (1,0) [0|0] "" Vector__XXX
 SG_ VCFRONT_a524_headlampAimRequestSource m524 : 16|2@1+ (1,0) [0|0] "" Vector__XXX
 SG_ VCFRONT_a525_GTW_twelveVBatteryType m525 : 16|3@1+ (1,0) [0|0] "" Vector__XXX
 SG_ VCFRONT_a527_cell1Voltage m527 : 16|10@1+ (0.01,0) [0|0] "" Vector__XXX
 SG_ VCFRONT_a528_ECPAStateSNA m528 : 16|1@1+ (1,0) [0|0] "" Vector__XXX
 SG_ VCFRONT_a529_sumCellVoltage m529 : 16|8@1+ (0.1,0) [0|0] "" Vector__XXX
 SG_ VCFRONT_a530_PCSCurrent m530 : 16|16@1- (0.1,0) [0|0] "" Vector__XXX
 SG_ VCFRONT_a531_powerIndexFiltered m531 : 16|7@1+ (1,0) [0|0] "" Vector__XXX
 SG_ VCFRONT_a532_eFuseFault m532 : 16|1@1+ (1,0) [0|0] "" Vector__XXX
 SG_ VCFRONT_a533_temperature m533 : 16|16@1+ (0.01,0) [0|0] "" Vector__XXX
 SG_ VCFRONT_a534_calibrationOffset m534 : 16|8@1- (4,0) [0|0] "" Vector__XXX
 SG_ VCFRONT_a535_calibrationOffset m535 : 16|8@1- (4,0) [0|0] "" Vector__XXX
 SG_ VCFRONT_a536_calibrationOffset m536 : 16|8@1- (4,0) [0|0] "" Vector__XXX
 SG_ VCFRONT_a537_calibrationOffset m537 : 16|8@1- (4,0) [0|0] "" Vector__XXX
 SG_ VCFRONT_a538_calibrationOffset m538 : 16|8@1- (4,0) [0|0] "" Vector__XXX
 SG_ VCFRONT_a539_calibrationOffset m539 : 16|8@1- (4,0) [0|0] "" Vector__XXX
 SG_ VCFRONT_a541_PackTemperature m541 : 16|9@1+ (0.5,-50) [0|0] "" Vector__XXX
 SG_ VCFRONT_a542_dischargePressure m542 : 16|6@1+ (0.5,0) [0|0] "" Vector__XXX
 SG_ VCFRONT_a544_serviceMode m544 : 16|1@1+ (1,0) [0|0] "" Vector__XXX
 SG_ VCFRONT_a545_GTW_twelveVBatteryType m545 : 16|3@1+ (1,0) [0|0] "" Vector__XXX
 SG_ VCFRONT_a547_serviceMode m547 : 16|1@1+ (1,0) [0|0] "" Vector__XXX
 SG_ VCFRONT_a548_vehiclePowerState m548 : 16|2@1+ (1,0) [0|0] "" Vector__XXX
 SG_ VCFRONT_a551_headlampCurrent m551 : 16|8@1+ (0.1,0) [0|0] "" Vector__XXX
 SG_ VCFRONT_a552_vcrightSelfTestResult m552 : 16|4@1+ (1,0) [0|0] "" Vector__XXX
 SG_ VCFRONT_a553_headlampCurrent m553 : 16|8@1+ (0.1,0) [0|0] "" Vector__XXX
 SG_ VCFRONT_a555_cell1Voltage m555 : 16|10@1+ (0.01,0) [0|0] "" Vector__XXX
 SG_ VCFRONT_a556_factoryMode m556 : 16|1@1+ (1,0) [0|0] "" Vector__XXX
 SG_ VCFRONT_a558_aimedVerticalPosition m558 : 16|10@1+ (1,0) [0|0] "" Vector__XXX
 SG_ VCFRONT_a559_SOC m559 : 16|7@1+ (1,0) [0|0] "" Vector__XXX
 SG_ VCFRONT_a560_highSHCOP1 m560 : 16|1@1+ (1,0) [0|0] "" Vector__XXX
 SG_ VCFRONT_a561_efuseTemperature m561 : 16|5@1+ (4,0) [0|0] "" Vector__XXX
 SG_ VCFRONT_a562_efuseTemperature m562 : 16|5@1+ (4,0) [0|0] "" Vector__XXX
 SG_ VCFRONT_a564_aimedVerticalPosition m564 : 16|10@1+ (1,0) [0|0] "" Vector__XXX
 SG_ VCFRONT_a565_userPresenceState m565 : 16|2@1+ (1,0) [0|0] "" Vector__XXX
 SG_ VCFRONT_a572_hvacCompressorCurrent m572 : 16|16@1+ (0.1,0) [0|0] "" Vector__XXX
 SG_ VCFRONT_a573_radarCurrent m573 : 16|16@1+ (0.1,0) [0|0] "" Vector__XXX
 SG_ VCFRONT_a574_frontDriveInverterCurrent m574 : 16|16@1+ (0.1,0) [0|0] "" Vector__XXX
 SG_ VCFRONT_a575_frontOilPumpCurrent m575 : 16|16@1+ (0.1,0) [0|0] "" Vector__XXX
 SG_ VCFRONT_a576_mcuLogicCurrent m576 : 16|16@1+ (0.1,0) [0|0] "" Vector__XXX
 SG_ VCFRONT_a577_tasCurrent m577 : 16|16@1+ (0.1,0) [0|0] "" Vector__XXX
 SG_ VCFRONT_a578_vbatFusedLowCurrentFeedCurrent m578 : 16|16@1+ (0.1,0) [0|0] "" Vector__XXX
 SG_ VCFRONT_a579_leftHeadlightCurrent m579 : 16|16@1+ (0.1,0) [0|0] "" Vector__XXX
 SG_ VCFRONT_a580_rightHeadlightCurrent m580 : 16|16@1+ (0.1,0) [0|0] "" Vector__XXX
 SG_ VCFRONT_a581_windshieldWiperCurrent m581 : 16|16@1+ (0.1,0) [0|0] "" Vector__XXX
 SG_ VCFRONT_a582_batterySMState m582 : 16|4@1+ (1,0) [0|0] "" Vector__XXX
 SG_ VCFRONT_a583_shadowSwitchGroupState m583 : 16|2@1+ (1,0) [0|0] "" Vector__XXX
 SG_ VCFRONT_a584_frunkSwitchGroupStateCurrent m584 : 16|2@1+ (1,0) [0|0] "" Vector__XXX
 SG_ VCFRONT_a585_leftHeadlampInternalErrorMask m585 : 16|20@1+ (1,0) [0|0] "" Vector__XXX
 SG_ VCFRONT_a587_factoryMode m587 : 16|1@1+ (1,0) [0|0] "" Vector__XXX
 SG_ VCFRONT_a588_vcleftEFuseCurveType m588 : 16|1@1+ (1,0) [0|0] "" Vector__XXX
 SG_ VCFRONT_a589_vcleftEFuseFastBlowType m589 : 16|1@1+ (1,0) [0|0] "" Vector__XXX
 SG_ VCFRONT_a590_vcrightEFuseCurveType m590 : 16|1@1+ (1,0) [0|0] "" Vector__XXX
 SG_ VCFRONT_a591_vcrightEFuseFastBlowType m591 : 16|1@1+ (1,0) [0|0] "" Vector__XXX
 SG_ VCFRONT_a592_vcleftCutoffEFuseCurveType m592 : 16|1@1+ (1,0) [0|0] "" Vector__XXX
 SG_ VCFRONT_a593_vcleftCutoffEFuseFastBlowType m593 : 16|1@1+ (1,0) [0|0] "" Vector__XXX
 SG_ VCFRONT_a594_maxOffsetFusionSession m594 : 16|8@1- (0.001,0) [0|0] "" Vector__XXX
 SG_ VCFRONT_a595_factoryMode m595 : 16|1@1+ (1,0) [0|0] "" Vector__XXX
 SG_ VCFRONT_a596_vcrightCutoffEFuseCurveType m596 : 16|1@1+ (1,0) [0|0] "" Vector__XXX
 SG_ VCFRONT_a597_vcrightCutoffEFuseFastBlowType m597 : 16|1@1+ (1,0) [0|0] "" Vector__XXX
 SG_ VCFRONT_a598_vcleftSelfTestResult m598 : 16|4@1+ (1,0) [0|0] "" Vector__XXX
 SG_ VCFRONT_a599_GTW_twelveVBatteryType m599 : 16|3@1+ (1,0) [0|0] "" Vector__XXX
 SG_ VCFRONT_a600_factoryMode m600 : 16|1@1+ (1,0) [0|0] "" Vector__XXX
 SG_ VCFRONT_a601_firstPurgeRequestTimestamp m601 : 16|32@1+ (1,0) [0|0] "" Vector__XXX
 SG_ VCFRONT_a605_vbatProtVoltage m605 : 16|10@1+ (0.1,0) [0|0] "" Vector__XXX
 SG_ VCFRONT_a606_expectedQChillerVeryHigh m606 : 16|1@1+ (1,0) [0|0] "" Vector__XXX
 SG_ VCFRONT_a607_avgSleepBypassCurrent m607 : 16|10@1+ (0.01,0) [0|0] "" Vector__XXX
 SG_ VCFRONT_a608_deltaV m608 : 16|16@1+ (0.0001,0) [0|0] "" Vector__XXX
 SG_ VCFRONT_a609_driverPresent m609 : 16|1@1+ (1,0) [0|0] "" Vector__XXX
 SG_ VCFRONT_a610_switch1State m610 : 16|2@1+ (1,0) [0|0] "" Vector__XXX
 SG_ VCFRONT_a611_isCoolantModeSeries m611 : 16|1@1+ (1,0) [0|0] "" Vector__XXX
 SG_ VCFRONT_a612_DI_gear m612 : 16|3@1+ (1,0) [0|0] "" Vector__XXX
 SG_ VCFRONT_a614_finalState m614 : 16|3@1+ (1,0) [0|0] "" Vector__XXX
 SG_ VCFRONT_a615_heaterCurrent m615 : 16|9@1- (0.25,0) [0|0] "" Vector__XXX
 SG_ VCFRONT_a618_ambientTemp m618 : 16|6@1+ (1,0) [0|0] "" Vector__XXX
 SG_ VCFRONT_a619_switch1State m619 : 16|2@1+ (1,0) [0|0] "" Vector__XXX
 SG_ VCFRONT_a623_DI_gear m623 : 16|3@1+ (1,0) [0|0] "" Vector__XXX
 SG_ VCFRONT_a626_dcrMilliOhms m626 : 16|8@1+ (0.2,0) [0|0] "" Vector__XXX
 SG_ VCFRONT_a627_cell1Voltage m627 : 16|9@1+ (0.01,0) [0|0] "" Vector__XXX
 SG_ VCFRONT_a628_thermistorId m628 : 16|3@1+ (1,1) [0|0] "" Vector__XXX
 SG_ VCFRONT_a630_faultBitfield m630 : 16|32@1+ (1,0) [0|0] "" Vector__XXX
 SG_ VCFRONT_a631_faultBitfield m631 : 16|32@1+ (1,0) [0|0] "" Vector__XXX
 SG_ VCFRONT_a634_ajar1OpeningDeltaV m634 : 16|10@1- (0.01,0) [0|0] "" Vector__XXX
 SG_ VCFRONT_a635_sleepRequest m635 : 16|1@1+ (1,0) [0|0] "" Vector__XXX
 SG_ VCFRONT_a643_inFactoryMode m643 : 16|1@1+ (1,0) [0|0] "" Vector__XXX
 SG_ VCFRONT_a644_washPumpChannel m644 : 16|4@1+ (1,0) [0|0] "" Vector__XXX
 SG_ VCFRONT_a645_washPumpChannel m645 : 16|4@1+ (1,0) [0|0] "" Vector__XXX
 SG_ VCFRONT_a646_washPumpChannel m646 : 16|4@1+ (1,0) [0|0] "" Vector__XXX
 SG_ VCFRONT_a649_vehicleLoadShedding m649 : 16|1@1+ (1,0) [0|0] "" Vector__XXX
 SG_ VCFRONT_a661_headlampCurrentFiltered m661 : 16|10@1+ (0.027,0) [0|0] "" Vector__XXX
 SG_ VCFRONT_a662_headlampCurrentFiltered m662 : 16|10@1+ (0.027,0) [0|0] "" Vector__XXX
 SG_ VCFRONT_a663_hcmlUartDmaQueueHighWaterMarkPercent m663 : 16|5@1+ (3.225806451612903,0) [0|0] "" Vector__XXX
 SG_ VCFRONT_a664_hcmrUartDmaQueueHighWaterMarkPercent m664 : 16|5@1+ (3.225806451612903,0) [0|0] "" Vector__XXX
 SG_ VCFRONT_a665_retryChannel m665 : 16|4@1+ (1,0) [0|0] "" Vector__XXX
 SG_ VCFRONT_a666_retryChannel m666 : 16|4@1+ (1,0) [0|0] "" Vector__XXX
 SG_ VCFRONT_a667_hcmRegionAndSide m667 : 16|3@1+ (1,0) [0|0] "" Vector__XXX
 SG_ VCFRONT_a668_hcmRegionAndSide m668 : 16|3@1+ (1,0) [0|0] "" Vector__XXX
 SG_ VCFRONT_a669_isEnforced m669 : 16|1@1+ (1,0) [0|0] "" Vector__XXX
 SG_ VCFRONT_a697_isGlobalHeadlamps m697 : 16|1@1+ (1,0) [0|0] "" Vector__XXX
 SG_ VCFRONT_a698_isGlobalHeadlamps m698 : 16|1@1+ (1,0) [0|0] "" Vector__XXX
 SG_ VCFRONT_a002_PowerOnReset m2 : 17|1@1+ (1,0) [0|0] "" Vector__XXX
 SG_ VCFRONT_a004_DASHighLowBeamDecisionSNA m4 : 17|1@1+ (1,0) [0|0] "" Vector__XXX
 SG_ VCFRONT_a008_DASHighLowBeamDecisionSNA m8 : 17|1@1+ (1,0) [0|0] "" Vector__XXX
 SG_ VCFRONT_a010_UnderVoltageTimeout m10 : 17|1@1+ (1,0) [0|0] "" Vector__XXX
 SG_ VCFRONT_a012_FlashError m12 : 17|1@1+ (1,0) [0|0] "" Vector__XXX
 SG_ VCFRONT_a013_ClearQueueFull m13 : 17|1@1+ (1,0) [0|0] "" Vector__XXX
 SG_ VCFRONT_a015_NVMMFilesystemError m15 : 17|1@1+ (1,0) [0|0] "" Vector__XXX
 SG_ VCFRONT_a021_Task1msStarved m21 : 17|1@1+ (1,0) [0|0] "" Vector__XXX
 SG_ VCFRONT_a047_ActFault m47 : 17|1@1+ (1,0) [0|0] "" Vector__XXX
 SG_ VCFRONT_a060_resetUnlocked m60 : 17|1@1+ (1,0) [0|0] "" Vector__XXX
 SG_ VCFRONT_a082_RIPC_remoteHSD m82 : 17|1@1+ (1,0) [0|0] "" Vector__XXX
 SG_ VCFRONT_a083_LIPC_remoteHSD m83 : 17|1@1+ (1,0) [0|0] "" Vector__XXX
 SG_ VCFRONT_a086_VEH_LVBMS_statusLow m86 : 17|1@1+ (1,0) [0|0] "" Vector__XXX
 SG_ VCFRONT_a087_VEH_thermalControl m87 : 17|1@1+ (1,0) [0|0] "" Vector__XXX
 SG_ VCFRONT_a088_VEH_thermalControl m88 : 17|1@1+ (1,0) [0|0] "" Vector__XXX
 SG_ VCFRONT_a089_PARTY_status m89 : 17|1@1+ (1,0) [0|0] "" Vector__XXX
 SG_ VCFRONT_a090_VEH_state m90 : 17|1@1+ (1,0) [0|0] "" Vector__XXX
 SG_ VCFRONT_a091_VEH_info m91 : 17|1@1+ (1,0) [0|0] "" Vector__XXX
 SG_ VCFRONT_a092_VEH_switchStatus m92 : 17|1@1+ (1,0) [0|0] "" Vector__XXX
 SG_ VCFRONT_a093_VEH_switchStatus m93 : 17|1@1+ (1,0) [0|0] "" Vector__XXX
 SG_ VCFRONT_a094_PARTY_sysStatus m94 : 17|1@1+ (1,0) [0|0] "" Vector__XXX
 SG_ VCFRONT_a095_PT_status m95 : 17|1@1+ (1,0) [0|0] "" Vector__XXX
 SG_ VCFRONT_a096_CH_status m96 : 17|1@1+ (1,0) [0|0] "" Vector__XXX
 SG_ VCFRONT_a097_VEH_state m97 : 17|1@1+ (1,0) [0|0] "" Vector__XXX
 SG_ VCFRONT_a098_VEH_hvStatus m98 : 17|1@1+ (1,0) [0|0] "" Vector__XXX
 SG_ VCFRONT_a100_PARTY m100 : 17|1@1+ (1,0) [0|0] "" Vector__XXX
 SG_ VCFRONT_a101_PARTY_locState m101 : 17|1@1+ (1,0) [0|0] "" Vector__XXX
 SG_ VCFRONT_a102_VEH_feedbackStatus m102 : 17|1@1+ (1,0) [0|0] "" Vector__XXX
 SG_ VCFRONT_a103_VEH_vehNm m103 : 17|1@1+ (1,0) [0|0] "" Vector__XXX
 SG_ VCFRONT_a104_VEH_chNm m104 : 17|1@1+ (1,0) [0|0] "" Vector__XXX
 SG_ VCFRONT_a105_VEH_chNm m105 : 17|1@1+ (1,0) [0|0] "" Vector__XXX
 SG_ VCFRONT_a106_VEH_thermalControl m106 : 17|1@1+ (1,0) [0|0] "" Vector__XXX
 SG_ VCFRONT_a107_VEH_vehNm m107 : 17|1@1+ (1,0) [0|0] "" Vector__XXX
 SG_ VCFRONT_a108_VEH_temperature m108 : 17|1@1+ (1,0) [0|0] "" Vector__XXX
 SG_ VCFRONT_a109_PARTY_inertial2 m109 : 17|1@1+ (1,0) [0|0] "" Vector__XXX
 SG_ VCFRONT_a110_VEH_carState m110 : 17|1@1+ (1,0) [0|0] "" Vector__XXX
 SG_ VCFRONT_a111_VEH_status m111 : 17|1@1+ (1,0) [0|0] "" Vector__XXX
 SG_ VCFRONT_a112_VEH_status m112 : 17|1@1+ (1,0) [0|0] "" Vector__XXX
 SG_ VCFRONT_a113_VEH_hvacRequest m113 : 17|1@1+ (1,0) [0|0] "" Vector__XXX
 SG_ VCFRONT_a114_PARTY_wheelSpeeds m114 : 17|1@1+ (1,0) [0|0] "" Vector__XXX
 SG_ VCFRONT_a115_VEH_authentication m115 : 17|1@1+ (1,0) [0|0] "" Vector__XXX
 SG_ VCFRONT_a116_VEH_vehNm m116 : 17|1@1+ (1,0) [0|0] "" Vector__XXX
 SG_ VCFRONT_a117_BDY_restraintStatus m117 : 17|1@1+ (1,0) [0|0] "" Vector__XXX
 SG_ VCFRONT_a118_VEH_lighting m118 : 17|1@1+ (1,0) [0|0] "" Vector__XXX
 SG_ VCFRONT_a119_VEH_leftStalk m119 : 17|1@1+ (1,0) [0|0] "" Vector__XXX
 SG_ VCFRONT_a120_VEH_systemStatus m120 : 17|1@1+ (1,0) [0|0] "" Vector__XXX
 SG_ VCFRONT_a121_fetShortCircuit m121 : 17|1@1+ (1,0) [0|0] "" Vector__XXX
 SG_ VCFRONT_a122_junctionOverTemp m122 : 17|1@1+ (1,0) [0|0] "" Vector__XXX
 SG_ VCFRONT_a123_fetShortCircuit m123 : 17|1@1+ (1,0) [0|0] "" Vector__XXX
 SG_ VCFRONT_a124_junctionOverTemp m124 : 17|1@1+ (1,0) [0|0] "" Vector__XXX
 SG_ VCFRONT_a125_fetShortCircuit m125 : 17|1@1+ (1,0) [0|0] "" Vector__XXX
 SG_ VCFRONT_a126_junctionOverTemp m126 : 17|1@1+ (1,0) [0|0] "" Vector__XXX
 SG_ VCFRONT_a136_snsDisconnect m136 : 17|1@1+ (1,0) [0|0] "" Vector__XXX
 SG_ VCFRONT_a137_snsDisconnect m137 : 17|1@1+ (1,0) [0|0] "" Vector__XXX
 SG_ VCFRONT_a138_snsDisconnect m138 : 17|1@1+ (1,0) [0|0] "" Vector__XXX
 SG_ VCFRONT_a139_snsDisconnect m139 : 17|1@1+ (1,0) [0|0] "" Vector__XXX
 SG_ VCFRONT_a140_snsDisconnect m140 : 17|1@1+ (1,0) [0|0] "" Vector__XXX
 SG_ VCFRONT_a141_snsDisconnect m141 : 17|1@1+ (1,0) [0|0] "" Vector__XXX
 SG_ VCFRONT_a143_vsOverVoltage m143 : 17|1@1+ (1,0) [0|0] "" Vector__XXX
 SG_ VCFRONT_a144_vsOverVoltage m144 : 17|1@1+ (1,0) [0|0] "" Vector__XXX
 SG_ VCFRONT_a145_vsOverVoltage m145 : 17|1@1+ (1,0) [0|0] "" Vector__XXX
 SG_ VCFRONT_a159_angleActual m159 : 17|10@1+ (0.25,-70) [0|0] "" Vector__XXX
 SG_ VCFRONT_a160_lowDischPressure m160 : 17|1@1+ (1,0) [0|0] "" Vector__XXX
 SG_ VCFRONT_a161_HVOverVoltage m161 : 17|1@1+ (1,0) [0|0] "" Vector__XXX
 SG_ VCFRONT_a163_compRecoverAfterFSR m163 : 17|1@1+ (1,0) [0|0] "" Vector__XXX
 SG_ VCFRONT_a168_rightECU m168 : 17|1@1+ (1,0) [0|0] "" Vector__XXX
 SG_ VCFRONT_a169_rightECU m169 : 17|1@1+ (1,0) [0|0] "" Vector__XXX
 SG_ VCFRONT_a170_rightECU m170 : 17|1@1+ (1,0) [0|0] "" Vector__XXX
 SG_ VCFRONT_a171_VCRIGHT m171 : 17|1@1+ (1,0) [0|0] "" Vector__XXX
 SG_ VCFRONT_a175_snsDisconnect m175 : 17|1@1+ (1,0) [0|0] "" Vector__XXX
 SG_ VCFRONT_a182_voltageDrop m182 : 17|1@1+ (1,0) [0|0] "" Vector__XXX
 SG_ VCFRONT_a183_voltageDrop m183 : 17|1@1+ (1,0) [0|0] "" Vector__XXX
 SG_ VCFRONT_a196_serviceMode m196 : 17|1@1+ (1,0) [0|0] "" Vector__XXX
 SG_ VCFRONT_a198_NVRAMState m198 : 17|1@1+ (1,0) [0|0] "" Vector__XXX
 SG_ VCFRONT_a199_NVRAMState m199 : 17|1@1+ (1,0) [0|0] "" Vector__XXX
 SG_ VCFRONT_a210_valveOverTravel m210 : 17|1@1+ (1,0) [0|0] "" Vector__XXX
 SG_ VCFRONT_a216_hvState m216 : 17|3@1+ (1,0) [0|0] "" Vector__XXX
 SG_ VCFRONT_a221_currentSenseFaulted m221 : 17|1@1+ (1,0) [0|0] "" Vector__XXX
 SG_ VCFRONT_a222_currentSenseFaulted m222 : 17|1@1+ (1,0) [0|0] "" Vector__XXX
 SG_ VCFRONT_a237_spiRegisterMismatch m237 : 17|1@1+ (1,0) [0|0] "" Vector__XXX
 SG_ VCFRONT_a238_spiRegisterMismatch m238 : 17|1@1+ (1,0) [0|0] "" Vector__XXX
 SG_ VCFRONT_a239_spiRegisterMismatch m239 : 17|1@1+ (1,0) [0|0] "" Vector__XXX
 SG_ VCFRONT_a240_lowPsCutoutCabinBattHeatDisabled m240 : 17|1@1+ (1,0) [0|0] "" Vector__XXX
 SG_ VCFRONT_a250_isVirtualPitchSensor m250 : 17|1@1+ (1,0) [0|0] "" Vector__XXX
 SG_ VCFRONT_a253_ampHourTargetNotReached m253 : 17|1@1+ (1,0) [0|0] "" Vector__XXX
 SG_ VCFRONT_a259_voltageDropCounter m259 : 17|3@1+ (2,0) [0|0] "" Vector__XXX
 SG_ VCFRONT_a271_voltDropOnHighCurrentTrigger m271 : 17|1@1+ (1,0) [0|0] "" Vector__XXX
 SG_ VCFRONT_a273_outwipePowerFailureToResolve m273 : 17|1@1+ (1,0) [0|0] "" Vector__XXX
 SG_ VCFRONT_a274_voltDropOnHighCurrentTrigger m274 : 17|1@1+ (1,0) [0|0] "" Vector__XXX
 SG_ VCFRONT_a279_snsDisconnect m279 : 17|1@1+ (1,0) [0|0] "" Vector__XXX
 SG_ VCFRONT_a280_snsDisconnect m280 : 17|1@1+ (1,0) [0|0] "" Vector__XXX
 SG_ VCFRONT_a283_thmlFanLimited m283 : 17|1@1+ (1,0) [0|0] "" Vector__XXX
 SG_ VCFRONT_a290_currentSenseFaulted m290 : 17|1@1+ (1,0) [0|0] "" Vector__XXX
 SG_ VCFRONT_a291_currentSenseFaulted m291 : 17|1@1+ (1,0) [0|0] "" Vector__XXX
 SG_ VCFRONT_a292_currentSenseFaulted m292 : 17|1@1+ (1,0) [0|0] "" Vector__XXX
 SG_ VCFRONT_a293_currentSenseFaulted m293 : 17|1@1+ (1,0) [0|0] "" Vector__XXX
 SG_ VCFRONT_a294_currentSenseFaulted m294 : 17|1@1+ (1,0) [0|0] "" Vector__XXX
 SG_ VCFRONT_a295_currentSenseFaulted m295 : 17|1@1+ (1,0) [0|0] "" Vector__XXX
 SG_ VCFRONT_a299_LINError m299 : 17|1@1+ (1,0) [0|0] "" Vector__XXX
 SG_ VCFRONT_a355_systemNotCommissioned m355 : 17|1@1+ (1,0) [0|0] "" Vector__XXX
 SG_ VCFRONT_a356_systemNotCommissioned m356 : 17|1@1+ (1,0) [0|0] "" Vector__XXX
 SG_ VCFRONT_a360_notEnoughPowerForSupport m360 : 17|1@1+ (1,0) [0|0] "" Vector__XXX
 SG_ VCFRONT_a364_previousHeaterType m364 : 17|3@1+ (1,0) [0|0] "" Vector__XXX
 SG_ VCFRONT_a365_enteringState m365 : 17|3@1+ (1,0) [0|0] "" Vector__XXX
 SG_ VCFRONT_a368_enteringState m368 : 17|3@1+ (1,0) [0|0] "" Vector__XXX
 SG_ VCFRONT_a369_heatRejectionLimited m369 : 17|1@1+ (1,0) [0|0] "" Vector__XXX
 SG_ VCFRONT_a371_voltDropOnHighCurrentTrigger m371 : 17|1@1+ (1,0) [0|0] "" Vector__XXX
 SG_ VCFRONT_a377_wiperStuckInPark m377 : 17|1@1+ (1,0) [0|0] "" Vector__XXX
 SG_ VCFRONT_a378_wiperOverload m378 : 17|2@1+ (1,0) [0|0] "" Vector__XXX
 SG_ VCFRONT_a389_faultedWhileOpenAtSpeed m389 : 17|1@1+ (1,0) [0|0] "" Vector__XXX
 SG_ VCFRONT_a391_switch1Shorted m391 : 17|1@1+ (1,0) [0|0] "" Vector__XXX
 SG_ VCFRONT_a394_suction m394 : 17|1@1+ (1,0) [0|0] "" Vector__XXX
 SG_ VCFRONT_a397_suction m397 : 17|1@1+ (1,0) [0|0] "" Vector__XXX
 SG_ VCFRONT_a421_inServiceMode m421 : 17|1@1+ (1,0) [0|0] "" Vector__XXX
 SG_ VCFRONT_a437_nvmDataMissingB m437 : 17|1@1+ (1,0) [0|0] "" Vector__XXX
 SG_ VCFRONT_a446_compFaultTdHigh m446 : 17|1@1+ (1,0) [0|0] "" Vector__XXX
 SG_ VCFRONT_a447_heatPumpHVACUnavailable m447 : 17|1@1+ (1,0) [0|0] "" Vector__XXX
 SG_ VCFRONT_a459_refrigerantFillActive m459 : 17|1@1+ (1,0) [0|0] "" Vector__XXX
 SG_ VCFRONT_a462_CellOVLevel2 m462 : 17|1@1+ (1,0) [0|0] "" Vector__XXX
 SG_ VCFRONT_a463_switch1Shorted m463 : 17|1@1+ (1,0) [0|0] "" Vector__XXX
 SG_ VCFRONT_a476_FRM2_timedOut m476 : 17|1@1+ (1,0) [0|0] "" Vector__XXX
 SG_ VCFRONT_a478_battFaultHardwareOverCurrent m478 : 17|1@1+ (1,0) [0|0] "" Vector__XXX
 SG_ VCFRONT_a479_ECPAState m479 : 17|2@1+ (1,0) [0|0] "" Vector__XXX
 SG_ VCFRONT_a489_EvapEXV m489 : 17|1@1+ (1,0) [0|0] "" Vector__XXX
 SG_ VCFRONT_a495_SocTooLow m495 : 17|1@1+ (1,0) [0|0] "" Vector__XXX
 SG_ VCFRONT_a496_vehicleLoadShedActive m496 : 17|1@1+ (1,0) [0|0] "" Vector__XXX
 SG_ VCFRONT_a497_FactoryMode m497 : 17|1@1+ (1,0) [0|0] "" Vector__XXX
 SG_ VCFRONT_a528_ECPAFrameTimeout m528 : 17|1@1+ (1,0) [0|0] "" Vector__XXX
 SG_ VCFRONT_a544_frunkOpen m544 : 17|1@1+ (1,0) [0|0] "" Vector__XXX
 SG_ VCFRONT_a547_frunkOpen m547 : 17|1@1+ (1,0) [0|0] "" Vector__XXX
 SG_ VCFRONT_a556_serviceMode m556 : 17|1@1+ (1,0) [0|0] "" Vector__XXX
 SG_ VCFRONT_a560_highSHBattConditioning m560 : 17|1@1+ (1,0) [0|0] "" Vector__XXX
 SG_ VCFRONT_a587_serviceMode m587 : 17|1@1+ (1,0) [0|0] "" Vector__XXX
 SG_ VCFRONT_a588_vcleftCurveOffsetChannel m588 : 17|3@1+ (1,0) [0|0] "" Vector__XXX
 SG_ VCFRONT_a589_vcleftCurrentThreshold m589 : 17|12@1+ (0.1,0) [0|0] "" Vector__XXX
 SG_ VCFRONT_a590_vcrightCurveOffsetChannel m590 : 17|3@1+ (1,0) [0|0] "" Vector__XXX
 SG_ VCFRONT_a591_vcrightCurrentThreshold m591 : 17|12@1+ (0.1,0) [0|0] "" Vector__XXX
 SG_ VCFRONT_a592_vcleftCutoffCurveOffsetChannel m592 : 17|3@1+ (1,0) [0|0] "" Vector__XXX
 SG_ VCFRONT_a593_vcleftCutoffCurrentThreshold m593 : 17|12@1+ (0.1,0) [0|0] "" Vector__XXX
 SG_ VCFRONT_a595_serviceMode m595 : 17|1@1+ (1,0) [0|0] "" Vector__XXX
 SG_ VCFRONT_a596_vcrightCutoffCurveOffsetChannel m596 : 17|3@1+ (1,0) [0|0] "" Vector__XXX
 SG_ VCFRONT_a597_vcrightCutoffCurrentThreshold m597 : 17|12@1+ (0.1,0) [0|0] "" Vector__XXX
 SG_ VCFRONT_a600_serviceMode m600 : 17|1@1+ (1,0) [0|0] "" Vector__XXX
 SG_ VCFRONT_a606_tempDuctMissTooHigh m606 : 17|1@1+ (1,0) [0|0] "" Vector__XXX
 SG_ VCFRONT_a609_vehiclePowerState m609 : 17|2@1+ (1,0) [0|0] "" Vector__XXX
 SG_ VCFRONT_a611_isCoolantModeParallel m611 : 17|1@1+ (1,0) [0|0] "" Vector__XXX
 SG_ VCFRONT_a635_allBusesSleeping m635 : 17|1@1+ (1,0) [0|0] "" Vector__XXX
 SG_ VCFRONT_a643_inServiceMode m643 : 17|1@1+ (1,0) [0|0] "" Vector__XXX
 SG_ VCFRONT_a649_hvBlockingPersistAccPower m649 : 17|1@1+ (1,0) [0|0] "" Vector__XXX
 SG_ VCFRONT_a669_thermalHVDevicesLimited m669 : 17|1@1+ (1,0) [0|0] "" Vector__XXX
 SG_ VCFRONT_a697_isVirtualPitchSensor m697 : 17|1@1+ (1,0) [0|0] "" Vector__XXX
 SG_ VCFRONT_a698_isVirtualPitchSensor m698 : 17|1@1+ (1,0) [0|0] "" Vector__XXX
 SG_ VCFRONT_a004_DASAdaptiveHighBeamFault m4 : 18|1@1+ (1,0) [0|0] "" Vector__XXX
 SG_ VCFRONT_a008_DASAdaptiveHighBeamFault m8 : 18|1@1+ (1,0) [0|0] "" Vector__XXX
 SG_ VCFRONT_a012_SoftwareReset m12 : 18|1@1+ (1,0) [0|0] "" Vector__XXX
 SG_ VCFRONT_a015_NVMMRecordIDError m15 : 18|1@1+ (1,0) [0|0] "" Vector__XXX
 SG_ VCFRONT_a021_Task1msMissed m21 : 18|1@1+ (1,0) [0|0] "" Vector__XXX
 SG_ VCFRONT_a032_watchdogState m32 : 18|1@1+ (1,0) [0|0] "" Vector__XXX
 SG_ VCFRONT_a038_userRead m38 : 18|1@1+ (1,0) [0|0] "" Vector__XXX
 SG_ VCFRONT_a047_DpslpFault m47 : 18|1@1+ (1,0) [0|0] "" Vector__XXX
 SG_ VCFRONT_a082_RIPC_railStatus m82 : 18|1@1+ (1,0) [0|0] "" Vector__XXX
 SG_ VCFRONT_a083_LIPC_railStatus m83 : 18|1@1+ (1,0) [0|0] "" Vector__XXX
 SG_ VCFRONT_a086_VEH_status m86 : 18|1@1+ (1,0) [0|0] "" Vector__XXX
 SG_ VCFRONT_a087_VEH_torque m87 : 18|1@1+ (1,0) [0|0] "" Vector__XXX
 SG_ VCFRONT_a088_VEH_torque m88 : 18|1@1+ (1,0) [0|0] "" Vector__XXX
 SG_ VCFRONT_a089_VEH_status m89 : 18|1@1+ (1,0) [0|0] "" Vector__XXX
 SG_ VCFRONT_a090_PARTY_eacMonitor m90 : 18|1@1+ (1,0) [0|0] "" Vector__XXX
 SG_ VCFRONT_a091_VEH_state m91 : 18|1@1+ (1,0) [0|0] "" Vector__XXX
 SG_ VCFRONT_a092_VEH_seatStatus2 m92 : 18|1@1+ (1,0) [0|0] "" Vector__XXX
 SG_ VCFRONT_a093_VEH_seatStatus2 m93 : 18|1@1+ (1,0) [0|0] "" Vector__XXX
 SG_ VCFRONT_a098_VEH_status m98 : 18|1@1+ (1,0) [0|0] "" Vector__XXX
 SG_ VCFRONT_a100_PT m100 : 18|1@1+ (1,0) [0|0] "" Vector__XXX
 SG_ VCFRONT_a101_LIPC_externalWatchdogHeartBeat m101 : 18|1@1+ (1,0) [0|0] "" Vector__XXX
 SG_ VCFRONT_a102_VEH_sensorStatus m102 : 18|1@1+ (1,0) [0|0] "" Vector__XXX
 SG_ VCFRONT_a103_VEH_status m103 : 18|1@1+ (1,0) [0|0] "" Vector__XXX
 SG_ VCFRONT_a104_VEH_bodyControls m104 : 18|1@1+ (1,0) [0|0] "" Vector__XXX
 SG_ VCFRONT_a105_VEH_dampingStates m105 : 18|1@1+ (1,0) [0|0] "" Vector__XXX
 SG_ VCFRONT_a106_VEH_dcdcRailStatus m106 : 18|1@1+ (1,0) [0|0] "" Vector__XXX
 SG_ VCFRONT_a107_VEH_status m107 : 18|1@1+ (1,0) [0|0] "" Vector__XXX
 SG_ VCFRONT_a108_VEH_thermalControl m108 : 18|1@1+ (1,0) [0|0] "" Vector__XXX
 SG_ VCFRONT_a109_PARTY_nearDeploy m109 : 18|1@1+ (1,0) [0|0] "" Vector__XXX
 SG_ VCFRONT_a110_VEH_carConfig m110 : 18|1@1+ (1,0) [0|0] "" Vector__XXX
 SG_ VCFRONT_a111_VEH_vehNm m111 : 18|1@1+ (1,0) [0|0] "" Vector__XXX
 SG_ VCFRONT_a112_VEH_vehNm m112 : 18|1@1+ (1,0) [0|0] "" Vector__XXX
 SG_ VCFRONT_a113_VEH_chargeRequest m113 : 18|1@1+ (1,0) [0|0] "" Vector__XXX
 SG_ VCFRONT_a114_VEH_wheelSpeeds m114 : 18|1@1+ (1,0) [0|0] "" Vector__XXX
 SG_ VCFRONT_a115_VEH_BLEResetRequest m115 : 18|1@1+ (1,0) [0|0] "" Vector__XXX
 SG_ VCFRONT_a116_VEH_hvacRequest m116 : 18|1@1+ (1,0) [0|0] "" Vector__XXX
 SG_ VCFRONT_a117_VEH_prndStatus m117 : 18|1@1+ (1,0) [0|0] "" Vector__XXX
 SG_ VCFRONT_a118_VEH_sensors m118 : 18|1@1+ (1,0) [0|0] "" Vector__XXX
 SG_ VCFRONT_a119_VEH_rightStalk m119 : 18|1@1+ (1,0) [0|0] "" Vector__XXX
 SG_ VCFRONT_a120_CH_chassisCntl m120 : 18|1@1+ (1,0) [0|0] "" Vector__XXX
 SG_ VCFRONT_a121_lockedRotor m121 : 18|1@1+ (1,0) [0|0] "" Vector__XXX
 SG_ VCFRONT_a122_startUpOperation m122 : 18|1@1+ (1,0) [0|0] "" Vector__XXX
 SG_ VCFRONT_a123_lockedRotor m123 : 18|1@1+ (1,0) [0|0] "" Vector__XXX
 SG_ VCFRONT_a124_startUpOperation m124 : 18|1@1+ (1,0) [0|0] "" Vector__XXX
 SG_ VCFRONT_a125_lockedRotor m125 : 18|1@1+ (1,0) [0|0] "" Vector__XXX
 SG_ VCFRONT_a126_startUpOperation m126 : 18|1@1+ (1,0) [0|0] "" Vector__XXX
 SG_ VCFRONT_a136_snsRateChangeUp m136 : 18|1@1+ (1,0) [0|0] "" Vector__XXX
 SG_ VCFRONT_a137_snsRateChangeUp m137 : 18|1@1+ (1,0) [0|0] "" Vector__XXX
 SG_ VCFRONT_a138_snsRateChangeUp m138 : 18|1@1+ (1,0) [0|0] "" Vector__XXX
 SG_ VCFRONT_a139_snsRateChangeUp m139 : 18|1@1+ (1,0) [0|0] "" Vector__XXX
 SG_ VCFRONT_a140_snsRateChangeUp m140 : 18|1@1+ (1,0) [0|0] "" Vector__XXX
 SG_ VCFRONT_a141_snsRateChangeUp m141 : 18|1@1+ (1,0) [0|0] "" Vector__XXX
 SG_ VCFRONT_a143_chpUnderVoltage m143 : 18|1@1+ (1,0) [0|0] "" Vector__XXX
 SG_ VCFRONT_a144_chpUnderVoltage m144 : 18|1@1+ (1,0) [0|0] "" Vector__XXX
 SG_ VCFRONT_a145_chpUnderVoltage m145 : 18|1@1+ (1,0) [0|0] "" Vector__XXX
 SG_ VCFRONT_a153_UIDisplayOnForUser m153 : 18|1@1+ (1,0) [0|0] "" Vector__XXX
 SG_ VCFRONT_a160_highDischPressure m160 : 18|1@1+ (1,0) [0|0] "" Vector__XXX
 SG_ VCFRONT_a161_HVUnderVoltage m161 : 18|1@1+ (1,0) [0|0] "" Vector__XXX
 SG_ VCFRONT_a163_compressorType m163 : 18|4@1+ (1,0) [0|0] "" Vector__XXX
 SG_ VCFRONT_a171_VCLEFT m171 : 18|1@1+ (1,0) [0|0] "" Vector__XXX
 SG_ VCFRONT_a175_snsRateChangeUp m175 : 18|1@1+ (1,0) [0|0] "" Vector__XXX
 SG_ VCFRONT_a180_hvState m180 : 18|3@1+ (1,0) [0|0] "" Vector__XXX
 SG_ VCFRONT_a182_overcharge m182 : 18|1@1+ (1,0) [0|0] "" Vector__XXX
 SG_ VCFRONT_a183_overcharge m183 : 18|1@1+ (1,0) [0|0] "" Vector__XXX
 SG_ VCFRONT_a191_hvState m191 : 18|3@1+ (1,0) [0|0] "" Vector__XXX
 SG_ VCFRONT_a192_hvState m192 : 18|3@1+ (1,0) [0|0] "" Vector__XXX
 SG_ VCFRONT_a196_transportMode m196 : 18|1@1+ (1,0) [0|0] "" Vector__XXX
 SG_ VCFRONT_a198_lockoutState m198 : 18|1@1+ (1,0) [0|0] "" Vector__XXX
 SG_ VCFRONT_a199_lockoutState m199 : 18|1@1+ (1,0) [0|0] "" Vector__XXX
 SG_ VCFRONT_a210_valveNoTravel m210 : 18|1@1+ (1,0) [0|0] "" Vector__XXX
 SG_ VCFRONT_a221_tempSenseFaulted m221 : 18|1@1+ (1,0) [0|0] "" Vector__XXX
 SG_ VCFRONT_a222_tempSenseFaulted m222 : 18|1@1+ (1,0) [0|0] "" Vector__XXX
 SG_ VCFRONT_a237_spiDiagError m237 : 18|1@1+ (1,0) [0|0] "" Vector__XXX
 SG_ VCFRONT_a238_spiDiagError m238 : 18|1@1+ (1,0) [0|0] "" Vector__XXX
 SG_ VCFRONT_a239_spiDiagError m239 : 18|1@1+ (1,0) [0|0] "" Vector__XXX
 SG_ VCFRONT_a240_lowPsCutoutScavenge m240 : 18|1@1+ (1,0) [0|0] "" Vector__XXX
 SG_ VCFRONT_a250_isAimedHCML m250 : 18|1@1+ (1,0) [0|0] "" Vector__XXX
 SG_ VCFRONT_a253_IBSCurrent m253 : 18|16@1- (0.005,0) [0|0] "" Vector__XXX
 SG_ VCFRONT_a271_deadLVMinimalAhDischargedTrigger m271 : 18|1@1+ (1,0) [0|0] "" Vector__XXX
 SG_ VCFRONT_a274_deadLVMinimalAhDischargedTrigger m274 : 18|1@1+ (1,0) [0|0] "" Vector__XXX
 SG_ VCFRONT_a279_snsRateChangeUp m279 : 18|1@1+ (1,0) [0|0] "" Vector__XXX
 SG_ VCFRONT_a280_snsRateChangeUp m280 : 18|1@1+ (1,0) [0|0] "" Vector__XXX
 SG_ VCFRONT_a290_tempSenseFaulted m290 : 18|1@1+ (1,0) [0|0] "" Vector__XXX
 SG_ VCFRONT_a291_tempSenseFaulted m291 : 18|1@1+ (1,0) [0|0] "" Vector__XXX
 SG_ VCFRONT_a292_tempSenseFaulted m292 : 18|1@1+ (1,0) [0|0] "" Vector__XXX
 SG_ VCFRONT_a293_tempSenseFaulted m293 : 18|1@1+ (1,0) [0|0] "" Vector__XXX
 SG_ VCFRONT_a294_tempSenseFaulted m294 : 18|1@1+ (1,0) [0|0] "" Vector__XXX
 SG_ VCFRONT_a295_tempSenseFaulted m295 : 18|1@1+ (1,0) [0|0] "" Vector__XXX
 SG_ VCFRONT_a299_unsupportedCountry m299 : 18|1@1+ (1,0) [0|0] "" Vector__XXX
 SG_ VCFRONT_a300_newType m300 : 18|2@1+ (1,0) [0|0] "" Vector__XXX
 SG_ VCFRONT_a355_serviceLockout m355 : 18|1@1+ (1,0) [0|0] "" Vector__XXX
 SG_ VCFRONT_a356_serviceLockout m356 : 18|1@1+ (1,0) [0|0] "" Vector__XXX
 SG_ VCFRONT_a371_deadLVMinimalAhDischargedTrigger m371 : 18|1@1+ (1,0) [0|0] "" Vector__XXX
 SG_ VCFRONT_a389_possiblyStuckClosed m389 : 18|1@1+ (1,0) [0|0] "" Vector__XXX
 SG_ VCFRONT_a390_batteryLoadType m390 : 18|2@1+ (1,0) [0|0] "" Vector__XXX
 SG_ VCFRONT_a391_switch1Disconnected m391 : 18|1@1+ (1,0) [0|0] "" Vector__XXX
 SG_ VCFRONT_a394_liquid m394 : 18|1@1+ (1,0) [0|0] "" Vector__XXX
 SG_ VCFRONT_a397_liquid m397 : 18|1@1+ (1,0) [0|0] "" Vector__XXX
 SG_ VCFRONT_a421_frunkOpen m421 : 18|1@1+ (1,0) [0|0] "" Vector__XXX
 SG_ VCFRONT_a445_SPIFaultCount m445 : 18|2@1+ (1,0) [0|0] "" Vector__XXX
 SG_ VCFRONT_a446_compFaultPdLow m446 : 18|1@1+ (1,0) [0|0] "" Vector__XXX
 SG_ VCFRONT_a447_activeLouverCompromised m447 : 18|1@1+ (1,0) [0|0] "" Vector__XXX
 SG_ VCFRONT_a462_CellOVLevel3 m462 : 18|1@1+ (1,0) [0|0] "" Vector__XXX
 SG_ VCFRONT_a463_switch1Disconnected m463 : 18|1@1+ (1,0) [0|0] "" Vector__XXX
 SG_ VCFRONT_a474_ssl100Bank2Status m474 : 18|2@1+ (1,0) [0|0] "" Vector__XXX
 SG_ VCFRONT_a475_ssl100Bank2Status m475 : 18|2@1+ (1,0) [0|0] "" Vector__XXX
 SG_ VCFRONT_a476_FRM3_timedOut m476 : 18|1@1+ (1,0) [0|0] "" Vector__XXX
 SG_ VCFRONT_a478_battFaultChargeOverCurrent m478 : 18|1@1+ (1,0) [0|0] "" Vector__XXX
 SG_ VCFRONT_a482_lastPosition m482 : 18|10@1+ (1,0) [0|0] "" Vector__XXX
 SG_ VCFRONT_a485_lastPosition m485 : 18|10@1+ (1,0) [0|0] "" Vector__XXX
 SG_ VCFRONT_a489_RecircEXV m489 : 18|1@1+ (1,0) [0|0] "" Vector__XXX
 SG_ VCFRONT_a495_retryExpended m495 : 18|1@1+ (1,0) [0|0] "" Vector__XXX
 SG_ VCFRONT_a496_MOSState m496 : 18|2@1+ (1,0) [0|0] "" Vector__XXX
 SG_ VCFRONT_a506_refrigLccType m506 : 18|1@1+ (1,0) [0|0] "" Vector__XXX
 SG_ VCFRONT_a507_aimingAllowed m507 : 18|1@1+ (1,0) [0|0] "" Vector__XXX
 SG_ VCFRONT_a524_aimingAllowed m524 : 18|1@1+ (1,0) [0|0] "" Vector__XXX
 SG_ VCFRONT_a528_currentSenseFaulted m528 : 18|1@1+ (1,0) [0|0] "" Vector__XXX
 SG_ VCFRONT_a544_LVBMSSOC m544 : 18|5@1+ (3,0) [0|0] "" Vector__XXX
 SG_ VCFRONT_a548_notEnoughPowerForSupport m548 : 18|1@1+ (1,0) [0|0] "" Vector__XXX
 SG_ VCFRONT_a556_transportMode m556 : 18|1@1+ (1,0) [0|0] "" Vector__XXX
 SG_ VCFRONT_a560_highSHCabinReheatCD m560 : 18|1@1+ (1,0) [0|0] "" Vector__XXX
 SG_ VCFRONT_a565_UIDisplayOnForUser m565 : 18|1@1+ (1,0) [0|0] "" Vector__XXX
 SG_ VCFRONT_a583_referenceSwitchGroupStateSimple m583 : 18|2@1+ (1,0) [0|0] "" Vector__XXX
 SG_ VCFRONT_a584_frunkSwitchGroupStatePrevious m584 : 18|2@1+ (1,0) [0|0] "" Vector__XXX
 SG_ VCFRONT_a587_transportMode m587 : 18|1@1+ (1,0) [0|0] "" Vector__XXX
 SG_ VCFRONT_a595_transportMode m595 : 18|1@1+ (1,0) [0|0] "" Vector__XXX
 SG_ VCFRONT_a600_transportMode m600 : 18|1@1+ (1,0) [0|0] "" Vector__XXX
 SG_ VCFRONT_a606_packTempTooWarm m606 : 18|1@1+ (1,0) [0|0] "" Vector__XXX
 SG_ VCFRONT_a610_switch2State m610 : 18|2@1+ (1,0) [0|0] "" Vector__XXX
 SG_ VCFRONT_a611_tempCoolantRadOutletActual m611 : 18|6@1+ (1,20) [0|0] "" Vector__XXX
 SG_ VCFRONT_a619_switch2State m619 : 18|2@1+ (1,0) [0|0] "" Vector__XXX
 SG_ VCFRONT_a635_vehBusAwake m635 : 18|1@1+ (1,0) [0|0] "" Vector__XXX
 SG_ VCFRONT_a643_frunkOpen m643 : 18|1@1+ (1,0) [0|0] "" Vector__XXX
 SG_ VCFRONT_a669_thermalHVDevicesDisabled m669 : 18|1@1+ (1,0) [0|0] "" Vector__XXX
 SG_ VCFRONT_a697_calibratedVerticalPositionHCML m697 : 18|10@1+ (1,0) [0|0] "" Vector__XXX
 SG_ VCFRONT_a698_calibratedVerticalPositionHCMR m698 : 18|10@1+ (1,0) [0|0] "" Vector__XXX
 SG_ VCFRONT_a004_DASMatrixColumnMsgMIA m4 : 19|1@1+ (1,0) [0|0] "" Vector__XXX
 SG_ VCFRONT_a008_DASMatrixColumnMsgMIA m8 : 19|1@1+ (1,0) [0|0] "" Vector__XXX
 SG_ VCFRONT_a012_CheckstopReset m12 : 19|1@1+ (1,0) [0|0] "" Vector__XXX
 SG_ VCFRONT_a021_Task10msLate m21 : 19|1@1+ (1,0) [0|0] "" Vector__XXX
 SG_ VCFRONT_a032_corePowerMode m32 : 19|2@1+ (1,0) [0|0] "" Vector__XXX
 SG_ VCFRONT_a038_userWrite m38 : 19|1@1+ (1,0) [0|0] "" Vector__XXX
 SG_ VCFRONT_a047_TcDbgreset m47 : 19|1@1+ (1,0) [0|0] "" Vector__XXX
 SG_ VCFRONT_a082_RIPC_remoteMux m82 : 19|1@1+ (1,0) [0|0] "" Vector__XXX
 SG_ VCFRONT_a083_LIPC_HSDFaults m83 : 19|1@1+ (1,0) [0|0] "" Vector__XXX
 SG_ VCFRONT_a086_VEH_12VBatteryStatus m86 : 19|1@1+ (1,0) [0|0] "" Vector__XXX
 SG_ VCFRONT_a087_VEH_status m87 : 19|1@1+ (1,0) [0|0] "" Vector__XXX
 SG_ VCFRONT_a088_VEH_status m88 : 19|1@1+ (1,0) [0|0] "" Vector__XXX
 SG_ VCFRONT_a089_BDY_party1 m89 : 19|1@1+ (1,0) [0|0] "" Vector__XXX
 SG_ VCFRONT_a090_CH_eacMonitor m90 : 19|1@1+ (1,0) [0|0] "" Vector__XXX
 SG_ VCFRONT_a092_VEH_vehNm m92 : 19|1@1+ (1,0) [0|0] "" Vector__XXX
 SG_ VCFRONT_a093_VEH_vehNm m93 : 19|1@1+ (1,0) [0|0] "" Vector__XXX
 SG_ VCFRONT_a098_VEH_thermalControl m98 : 19|1@1+ (1,0) [0|0] "" Vector__XXX
 SG_ VCFRONT_a100_CH m100 : 19|1@1+ (1,0) [0|0] "" Vector__XXX
 SG_ VCFRONT_a101_VEH_locState m101 : 19|1@1+ (1,0) [0|0] "" Vector__XXX
 SG_ VCFRONT_a102_VEH_rods m102 : 19|1@1+ (1,0) [0|0] "" Vector__XXX
 SG_ VCFRONT_a103_PT_ptNm m103 : 19|1@1+ (1,0) [0|0] "" Vector__XXX
 SG_ VCFRONT_a104_VEH_bodyControls3 m104 : 19|1@1+ (1,0) [0|0] "" Vector__XXX
 SG_ VCFRONT_a106_CH_dcdcRailStatus m106 : 19|1@1+ (1,0) [0|0] "" Vector__XXX
 SG_ VCFRONT_a107_VEH_thermalStatus m107 : 19|1@1+ (1,0) [0|0] "" Vector__XXX
 SG_ VCFRONT_a108_VEH_torque m108 : 19|1@1+ (1,0) [0|0] "" Vector__XXX
 SG_ VCFRONT_a109_PARTY_collision m109 : 19|1@1+ (1,0) [0|0] "" Vector__XXX
 SG_ VCFRONT_a110_VEH_time m110 : 19|1@1+ (1,0) [0|0] "" Vector__XXX
 SG_ VCFRONT_a111_RIPC_LVPowerState m111 : 19|1@1+ (1,0) [0|0] "" Vector__XXX
 SG_ VCFRONT_a112_LIPC_LVPowerState m112 : 19|1@1+ (1,0) [0|0] "" Vector__XXX
 SG_ VCFRONT_a113_VEH_vehicleControl m113 : 19|1@1+ (1,0) [0|0] "" Vector__XXX
 SG_ VCFRONT_a114_CH_wheelSpeeds m114 : 19|1@1+ (1,0) [0|0] "" Vector__XXX
 SG_ VCFRONT_a115_VEH_requests m115 : 19|1@1+ (1,0) [0|0] "" Vector__XXX
 SG_ VCFRONT_a116_VEH_hvacStatus m116 : 19|1@1+ (1,0) [0|0] "" Vector__XXX
 SG_ VCFRONT_a117_PARTY_epbmStatus m117 : 19|1@1+ (1,0) [0|0] "" Vector__XXX
 SG_ VCFRONT_a118_VEH_status m118 : 19|1@1+ (1,0) [0|0] "" Vector__XXX
 SG_ VCFRONT_a119_PARTY_rightStalk m119 : 19|1@1+ (1,0) [0|0] "" Vector__XXX
 SG_ VCFRONT_a120_PARTY_systemStatus m120 : 19|1@1+ (1,0) [0|0] "" Vector__XXX
 SG_ VCFRONT_a122_lossOfSpeedLock m122 : 19|1@1+ (1,0) [0|0] "" Vector__XXX
 SG_ VCFRONT_a124_lossOfSpeedLock m124 : 19|1@1+ (1,0) [0|0] "" Vector__XXX
 SG_ VCFRONT_a126_lossOfSpeedLock m126 : 19|1@1+ (1,0) [0|0] "" Vector__XXX
 SG_ VCFRONT_a136_snsRateChangeDown m136 : 19|1@1+ (1,0) [0|0] "" Vector__XXX
 SG_ VCFRONT_a137_snsRateChangeDown m137 : 19|1@1+ (1,0) [0|0] "" Vector__XXX
 SG_ VCFRONT_a138_snsRateChangeDown m138 : 19|1@1+ (1,0) [0|0] "" Vector__XXX
 SG_ VCFRONT_a139_snsRateChangeDown m139 : 19|1@1+ (1,0) [0|0] "" Vector__XXX
 SG_ VCFRONT_a140_snsRateChangeDown m140 : 19|1@1+ (1,0) [0|0] "" Vector__XXX
 SG_ VCFRONT_a141_snsRateChangeDown m141 : 19|1@1+ (1,0) [0|0] "" Vector__XXX
 SG_ VCFRONT_a143_vglUnderVoltage m143 : 19|1@1+ (1,0) [0|0] "" Vector__XXX
 SG_ VCFRONT_a144_vglUnderVoltage m144 : 19|1@1+ (1,0) [0|0] "" Vector__XXX
 SG_ VCFRONT_a145_vglUnderVoltage m145 : 19|1@1+ (1,0) [0|0] "" Vector__XXX
 SG_ VCFRONT_a153_inDriveState m153 : 19|1@1+ (1,0) [0|0] "" Vector__XXX
 SG_ VCFRONT_a160_lowSuctionPressure m160 : 19|1@1+ (1,0) [0|0] "" Vector__XXX
 SG_ VCFRONT_a161_overCurrent m161 : 19|1@1+ (1,0) [0|0] "" Vector__XXX
 SG_ VCFRONT_a171_VCBATT m171 : 19|1@1+ (1,0) [0|0] "" Vector__XXX
 SG_ VCFRONT_a175_snsRateChangeDown m175 : 19|1@1+ (1,0) [0|0] "" Vector__XXX
 SG_ VCFRONT_a178_compressorState m178 : 19|2@1+ (1,0) [0|0] "" Vector__XXX
 SG_ VCFRONT_a182_LVFloorReached m182 : 19|1@1+ (1,0) [0|0] "" Vector__XXX
 SG_ VCFRONT_a183_LVFloorReached m183 : 19|1@1+ (1,0) [0|0] "" Vector__XXX
 SG_ VCFRONT_a196_frunkOpen m196 : 19|1@1+ (1,0) [0|0] "" Vector__XXX
 SG_ VCFRONT_a221_underCurrent m221 : 19|1@1+ (1,0) [0|0] "" Vector__XXX
 SG_ VCFRONT_a222_underCurrent m222 : 19|1@1+ (1,0) [0|0] "" Vector__XXX
 SG_ VCFRONT_a237_pwmOutputFault m237 : 19|1@1+ (1,0) [0|0] "" Vector__XXX
 SG_ VCFRONT_a238_pwmOutputFault m238 : 19|1@1+ (1,0) [0|0] "" Vector__XXX
 SG_ VCFRONT_a239_pwmOutputFault m239 : 19|1@1+ (1,0) [0|0] "" Vector__XXX
 SG_ VCFRONT_a240_lowPsCutoutAS m240 : 19|1@1+ (1,0) [0|0] "" Vector__XXX
 SG_ VCFRONT_a250_isAimedHCMR m250 : 19|1@1+ (1,0) [0|0] "" Vector__XXX
 SG_ VCFRONT_a271_resistanceEstimationHardFailTrigger m271 : 19|1@1+ (1,0) [0|0] "" Vector__XXX
 SG_ VCFRONT_a274_resistanceEstimationHardFailTrigger m274 : 19|1@1+ (1,0) [0|0] "" Vector__XXX
 SG_ VCFRONT_a279_snsRateChangeDown m279 : 19|1@1+ (1,0) [0|0] "" Vector__XXX
 SG_ VCFRONT_a280_snsRateChangeDown m280 : 19|1@1+ (1,0) [0|0] "" Vector__XXX
 SG_ VCFRONT_a290_underCurrent m290 : 19|1@1+ (1,0) [0|0] "" Vector__XXX
 SG_ VCFRONT_a291_underCurrent m291 : 19|1@1+ (1,0) [0|0] "" Vector__XXX
 SG_ VCFRONT_a292_underCurrent m292 : 19|1@1+ (1,0) [0|0] "" Vector__XXX
 SG_ VCFRONT_a293_underCurrent m293 : 19|1@1+ (1,0) [0|0] "" Vector__XXX
 SG_ VCFRONT_a294_underCurrent m294 : 19|1@1+ (1,0) [0|0] "" Vector__XXX
 SG_ VCFRONT_a295_underCurrent m295 : 19|1@1+ (1,0) [0|0] "" Vector__XXX
 SG_ VCFRONT_a299_writeFailed m299 : 19|1@1+ (1,0) [0|0] "" Vector__XXX
 SG_ VCFRONT_a355_factoryGated m355 : 19|1@1+ (1,0) [0|0] "" Vector__XXX
 SG_ VCFRONT_a356_factoryGated m356 : 19|1@1+ (1,0) [0|0] "" Vector__XXX
 SG_ VCFRONT_a366_exitingState m366 : 19|3@1+ (1,0) [0|0] "" Vector__XXX
 SG_ VCFRONT_a371_resistanceEstimationHardFailTrigger m371 : 19|1@1+ (1,0) [0|0] "" Vector__XXX
 SG_ VCFRONT_a378_wiperFault m378 : 19|1@1+ (1,0) [0|0] "" Vector__XXX
 SG_ VCFRONT_a387_minVoltageReached m387 : 19|12@1+ (0.005443676098,0) [0|0] "" Vector__XXX
 SG_ VCFRONT_a388_minVoltageReached m388 : 19|12@1+ (0.005443676098,0) [0|0] "" Vector__XXX
 SG_ VCFRONT_a389_vehicleSpeed m389 : 19|12@1+ (0.08,-40) [0|0] "" Vector__XXX
 SG_ VCFRONT_a391_switch2Shorted m391 : 19|1@1+ (1,0) [0|0] "" Vector__XXX
 SG_ VCFRONT_a394_offsetError m394 : 19|10@1- (0.05,0) [0|0] "" Vector__XXX
 SG_ VCFRONT_a397_offsetError m397 : 19|10@1- (0.2,0) [0|0] "" Vector__XXX
 SG_ VCFRONT_a421_leftHeadlampCurrentFiltered m421 : 19|10@1+ (0.027,0) [0|0] "" Vector__XXX
 SG_ VCFRONT_a446_compFaultPdHigh m446 : 19|1@1+ (1,0) [0|0] "" Vector__XXX
 SG_ VCFRONT_a447_coolantValveCompromised m447 : 19|1@1+ (1,0) [0|0] "" Vector__XXX
 SG_ VCFRONT_a462_CellUVLevel1 m462 : 19|1@1+ (1,0) [0|0] "" Vector__XXX
 SG_ VCFRONT_a463_switch2Shorted m463 : 19|1@1+ (1,0) [0|0] "" Vector__XXX
 SG_ VCFRONT_a476_FRM4_timedOut m476 : 19|1@1+ (1,0) [0|0] "" Vector__XXX
 SG_ VCFRONT_a478_battFaultCellUnderVoltage m478 : 19|1@1+ (1,0) [0|0] "" Vector__XXX
 SG_ VCFRONT_a479_factoryMode m479 : 19|1@1+ (1,0) [0|0] "" Vector__XXX
 SG_ VCFRONT_a480_reset m480 : 19|1@1+ (1,0) [0|0] "" Vector__XXX
 SG_ VCFRONT_a483_currentMovementState m483 : 19|4@1+ (1,0) [0|0] "" Vector__XXX
 SG_ VCFRONT_a488_currentMovementState m488 : 19|4@1+ (1,0) [0|0] "" Vector__XXX
 SG_ VCFRONT_a489_LCCEXV m489 : 19|1@1+ (1,0) [0|0] "" Vector__XXX
 SG_ VCFRONT_a495_LVBMSMIA m495 : 19|1@1+ (1,0) [0|0] "" Vector__XXX
 SG_ VCFRONT_a507_useRideHeightSensors m507 : 19|1@1+ (1,0) [0|0] "" Vector__XXX
 SG_ VCFRONT_a524_useRideHeightSensors m524 : 19|1@1+ (1,0) [0|0] "" Vector__XXX
 SG_ VCFRONT_a525_newLVBatteryType m525 : 19|3@1+ (1,0) [0|0] "" Vector__XXX
 SG_ VCFRONT_a528_serviceMode m528 : 19|1@1+ (1,0) [0|0] "" Vector__XXX
 SG_ VCFRONT_a545_newLVBatteryType m545 : 19|3@1+ (1,0) [0|0] "" Vector__XXX
 SG_ VCFRONT_a548_HVBlockingMismatch m548 : 19|1@1+ (1,0) [0|0] "" Vector__XXX
 SG_ VCFRONT_a556_frunkOpen m556 : 19|1@1+ (1,0) [0|0] "" Vector__XXX
 SG_ VCFRONT_a560_highSHCabinReheatHD m560 : 19|1@1+ (1,0) [0|0] "" Vector__XXX
 SG_ VCFRONT_a565_inDriveState m565 : 19|1@1+ (1,0) [0|0] "" Vector__XXX
 SG_ VCFRONT_a587_frunkOpen m587 : 19|1@1+ (1,0) [0|0] "" Vector__XXX
 SG_ VCFRONT_a595_frunkOpen m595 : 19|1@1+ (1,0) [0|0] "" Vector__XXX
 SG_ VCFRONT_a599_newLVBatteryType m599 : 19|3@1+ (1,0) [0|0] "" Vector__XXX
 SG_ VCFRONT_a600_frunkOpen m600 : 19|1@1+ (1,0) [0|0] "" Vector__XXX
 SG_ VCFRONT_a606_PdPsTsSHNotNominal m606 : 19|1@1+ (1,0) [0|0] "" Vector__XXX
 SG_ VCFRONT_a612_manualDrivingProhibited m612 : 19|1@1+ (1,0) [0|0] "" Vector__XXX
 SG_ VCFRONT_a614_octovalveNotAtTarget m614 : 19|1@1+ (1,0) [0|0] "" Vector__XXX
 SG_ VCFRONT_a623_manualDrivingProhibited m623 : 19|1@1+ (1,0) [0|0] "" Vector__XXX
 SG_ VCFRONT_a628_thermistorFailureReason m628 : 19|3@1+ (1,0) [0|0] "" Vector__XXX
 SG_ VCFRONT_a635_frontPrivBusAwake m635 : 19|1@1+ (1,0) [0|0] "" Vector__XXX
 SG_ VCFRONT_a643_rightHeadlampCurrentFiltered m643 : 19|10@1+ (0.027,0) [0|0] "" Vector__XXX
 SG_ VCFRONT_a669_defogEnabled m669 : 19|1@1+ (1,0) [0|0] "" Vector__XXX
 SG_ VCFRONT_a004_DASBendAngleMsgMIA m4 : 20|1@1+ (1,0) [0|0] "" Vector__XXX
 SG_ VCFRONT_a005_faults0 m5 : 20|12@1+ (1,0) [0|0] "" Vector__XXX
 SG_ VCFRONT_a006_fault m6 : 20|4@1+ (1,0) [0|0] "" Vector__XXX
 SG_ VCFRONT_a008_DASBendAngleMsgMIA m8 : 20|1@1+ (1,0) [0|0] "" Vector__XXX
 SG_ VCFRONT_a012_DebugReset m12 : 20|1@1+ (1,0) [0|0] "" Vector__XXX
 SG_ VCFRONT_a021_Task10msStarved m21 : 20|1@1+ (1,0) [0|0] "" Vector__XXX
 SG_ VCFRONT_a038_userExecute m38 : 20|1@1+ (1,0) [0|0] "" Vector__XXX
 SG_ VCFRONT_a047_SysReset m47 : 20|1@1+ (1,0) [0|0] "" Vector__XXX
 SG_ VCFRONT_a086_VEH_LVPowerState m86 : 20|1@1+ (1,0) [0|0] "" Vector__XXX
 SG_ VCFRONT_a087_PARTY_torque m87 : 20|1@1+ (1,0) [0|0] "" Vector__XXX
 SG_ VCFRONT_a088_PARTY_torque m88 : 20|1@1+ (1,0) [0|0] "" Vector__XXX
 SG_ VCFRONT_a089_BDY_status m89 : 20|1@1+ (1,0) [0|0] "" Vector__XXX
 SG_ VCFRONT_a098_VEH_temperature m98 : 20|1@1+ (1,0) [0|0] "" Vector__XXX
 SG_ VCFRONT_a100_OBD m100 : 20|1@1+ (1,0) [0|0] "" Vector__XXX
 SG_ VCFRONT_a101_BDY_locState m101 : 20|1@1+ (1,0) [0|0] "" Vector__XXX
 SG_ VCFRONT_a103_PT_status m103 : 20|1@1+ (1,0) [0|0] "" Vector__XXX
 SG_ VCFRONT_a104_BDY_bodyControls3 m104 : 20|1@1+ (1,0) [0|0] "" Vector__XXX
 SG_ VCFRONT_a106_CH_alertMatrix m106 : 20|1@1+ (1,0) [0|0] "" Vector__XXX
 SG_ VCFRONT_a107_VEH_bmbMinMax m107 : 20|1@1+ (1,0) [0|0] "" Vector__XXX
 SG_ VCFRONT_a108_VEH_status m108 : 20|1@1+ (1,0) [0|0] "" Vector__XXX
 SG_ VCFRONT_a109_VEH_status m109 : 20|1@1+ (1,0) [0|0] "" Vector__XXX
 SG_ VCFRONT_a110_VEH_updateStatus m110 : 20|1@1+ (1,0) [0|0] "" Vector__XXX
 SG_ VCFRONT_a111_RIPC_epbPrivateState m111 : 20|1@1+ (1,0) [0|0] "" Vector__XXX
 SG_ VCFRONT_a112_LIPC_epbPrivateState m112 : 20|1@1+ (1,0) [0|0] "" Vector__XXX
 SG_ VCFRONT_a113_VEH_vehicleControl2 m113 : 20|1@1+ (1,0) [0|0] "" Vector__XXX
 SG_ VCFRONT_a114_PARTY_party3 m114 : 20|1@1+ (1,0) [0|0] "" Vector__XXX
 SG_ VCFRONT_a115_VEH_requests2 m115 : 20|1@1+ (1,0) [0|0] "" Vector__XXX
 SG_ VCFRONT_a116_VEH_LVPowerState m116 : 20|1@1+ (1,0) [0|0] "" Vector__XXX
 SG_ VCFRONT_a117_VEH_vehNm m117 : 20|1@1+ (1,0) [0|0] "" Vector__XXX
 SG_ VCFRONT_a118_VEH_okToUseHighPwr m118 : 20|1@1+ (1,0) [0|0] "" Vector__XXX
 SG_ VCFRONT_a119_CH_steerAngle m119 : 20|1@1+ (1,0) [0|0] "" Vector__XXX
 SG_ VCFRONT_a120_PARTY_torque m120 : 20|1@1+ (1,0) [0|0] "" Vector__XXX
 SG_ VCFRONT_a122_vccUnderVoltage m122 : 20|1@1+ (1,0) [0|0] "" Vector__XXX
 SG_ VCFRONT_a124_vccUnderVoltage m124 : 20|1@1+ (1,0) [0|0] "" Vector__XXX
 SG_ VCFRONT_a126_vccUnderVoltage m126 : 20|1@1+ (1,0) [0|0] "" Vector__XXX
 SG_ VCFRONT_a142_driverThermWarn m142 : 20|1@1+ (1,0) [0|0] "" Vector__XXX
 SG_ VCFRONT_a143_thOverTemperature m143 : 20|1@1+ (1,0) [0|0] "" Vector__XXX
 SG_ VCFRONT_a144_thOverTemperature m144 : 20|1@1+ (1,0) [0|0] "" Vector__XXX
 SG_ VCFRONT_a145_thOverTemperature m145 : 20|1@1+ (1,0) [0|0] "" Vector__XXX
 SG_ VCFRONT_a153_steeringWheelButtonInteraction m153 : 20|1@1+ (1,0) [0|0] "" Vector__XXX
 SG_ VCFRONT_a160_faultSnsDischPress m160 : 20|1@1+ (1,0) [0|0] "" Vector__XXX
 SG_ VCFRONT_a161_overTemperature m161 : 20|1@1+ (1,0) [0|0] "" Vector__XXX
 SG_ VCFRONT_a171_BMS m171 : 20|1@1+ (1,0) [0|0] "" Vector__XXX
 SG_ VCFRONT_a182_shortedCell m182 : 20|1@1+ (1,0) [0|0] "" Vector__XXX
 SG_ VCFRONT_a183_shortedCell m183 : 20|1@1+ (1,0) [0|0] "" Vector__XXX
 SG_ VCFRONT_a196_vehiclePowerState m196 : 20|2@1+ (1,0) [0|0] "" Vector__XXX
 SG_ VCFRONT_a216_vcleftFastBlowImminent m216 : 20|1@1+ (1,0) [0|0] "" Vector__XXX
 SG_ VCFRONT_a221_overCurrent m221 : 20|1@1+ (1,0) [0|0] "" Vector__XXX
 SG_ VCFRONT_a222_overCurrent m222 : 20|1@1+ (1,0) [0|0] "" Vector__XXX
 SG_ VCFRONT_a237_watchdogTimeout m237 : 20|1@1+ (1,0) [0|0] "" Vector__XXX
 SG_ VCFRONT_a238_watchdogTimeout m238 : 20|1@1+ (1,0) [0|0] "" Vector__XXX
 SG_ VCFRONT_a239_watchdogTimeout m239 : 20|1@1+ (1,0) [0|0] "" Vector__XXX
 SG_ VCFRONT_a240_cabinHeatASCompromisedLowSide m240 : 20|1@1+ (1,0) [0|0] "" Vector__XXX
 SG_ VCFRONT_a250_calibratedVerticalPositionHCML m250 : 20|10@1+ (1,0) [0|0] "" Vector__XXX
 SG_ VCFRONT_a259_minVoltageReached m259 : 20|12@1+ (0.005443676098,0) [0|0] "" Vector__XXX
 SG_ VCFRONT_a271_dcrMilliOhmsAboveThresholdTrigger m271 : 20|1@1+ (1,0) [0|0] "" Vector__XXX
 SG_ VCFRONT_a274_dcrMilliOhmsAboveThresholdTrigger m274 : 20|1@1+ (1,0) [0|0] "" Vector__XXX
 SG_ VCFRONT_a284_driverThermWarn m284 : 20|1@1+ (1,0) [0|0] "" Vector__XXX
 SG_ VCFRONT_a285_driverThermWarn m285 : 20|1@1+ (1,0) [0|0] "" Vector__XXX
 SG_ VCFRONT_a286_driverThermWarn m286 : 20|1@1+ (1,0) [0|0] "" Vector__XXX
 SG_ VCFRONT_a287_driverThermWarn m287 : 20|1@1+ (1,0) [0|0] "" Vector__XXX
 SG_ VCFRONT_a288_driverThermWarn m288 : 20|1@1+ (1,0) [0|0] "" Vector__XXX
 SG_ VCFRONT_a289_driverThermWarn m289 : 20|1@1+ (1,0) [0|0] "" Vector__XXX
 SG_ VCFRONT_a290_overCurrent m290 : 20|1@1+ (1,0) [0|0] "" Vector__XXX
 SG_ VCFRONT_a291_overCurrent m291 : 20|1@1+ (1,0) [0|0] "" Vector__XXX
 SG_ VCFRONT_a292_overCurrent m292 : 20|1@1+ (1,0) [0|0] "" Vector__XXX
 SG_ VCFRONT_a293_overCurrent m293 : 20|1@1+ (1,0) [0|0] "" Vector__XXX
 SG_ VCFRONT_a294_overCurrent m294 : 20|1@1+ (1,0) [0|0] "" Vector__XXX
 SG_ VCFRONT_a295_overCurrent m295 : 20|1@1+ (1,0) [0|0] "" Vector__XXX
 SG_ VCFRONT_a356_refCommissionStatus m356 : 20|1@1+ (1,0) [0|0] "" Vector__XXX
 SG_ VCFRONT_a364_newHeaterType m364 : 20|3@1+ (1,0) [0|0] "" Vector__XXX
 SG_ VCFRONT_a365_exitingState m365 : 20|3@1+ (1,0) [0|0] "" Vector__XXX
 SG_ VCFRONT_a368_exitingState m368 : 20|3@1+ (1,0) [0|0] "" Vector__XXX
 SG_ VCFRONT_a371_dcrMilliOhmsAboveThresholdTrigger m371 : 20|1@1+ (1,0) [0|0] "" Vector__XXX
 SG_ VCFRONT_a378_wiperOvertemperature m378 : 20|2@1+ (1,0) [0|0] "" Vector__XXX
 SG_ VCFRONT_a380_driverStagnantFeedback m380 : 20|1@1+ (1,0) [0|0] "" Vector__XXX
 SG_ VCFRONT_a381_driverStagnantFeedback m381 : 20|1@1+ (1,0) [0|0] "" Vector__XXX
 SG_ VCFRONT_a382_driverStagnantFeedback m382 : 20|1@1+ (1,0) [0|0] "" Vector__XXX
 SG_ VCFRONT_a383_driverStagnantFeedback m383 : 20|1@1+ (1,0) [0|0] "" Vector__XXX
 SG_ VCFRONT_a384_driverStagnantFeedback m384 : 20|1@1+ (1,0) [0|0] "" Vector__XXX
 SG_ VCFRONT_a385_driverStagnantFeedback m385 : 20|1@1+ (1,0) [0|0] "" Vector__XXX
 SG_ VCFRONT_a386_driverStagnantFeedback m386 : 20|1@1+ (1,0) [0|0] "" Vector__XXX
 SG_ VCFRONT_a390_highSideHX m390 : 20|2@1+ (1,0) [0|0] "" Vector__XXX
 SG_ VCFRONT_a391_switch2Disconnected m391 : 20|1@1+ (1,0) [0|0] "" Vector__XXX
 SG_ VCFRONT_a429_depthOfDischarge m429 : 20|10@1+ (0.1,-0.1) [0|0] "" Vector__XXX
 SG_ VCFRONT_a443_maxDieTemp m443 : 20|10@1+ (0.2,-20) [0|0] "" Vector__XXX
 SG_ VCFRONT_a446_compFaultPsLow m446 : 20|1@1+ (1,0) [0|0] "" Vector__XXX
 SG_ VCFRONT_a447_ambientSourcingCompromised m447 : 20|1@1+ (1,0) [0|0] "" Vector__XXX
 SG_ VCFRONT_a462_CellUVLevel2 m462 : 20|1@1+ (1,0) [0|0] "" Vector__XXX
 SG_ VCFRONT_a463_switch2Disconnected m463 : 20|1@1+ (1,0) [0|0] "" Vector__XXX
 SG_ VCFRONT_a474_ssl100Bank3Status m474 : 20|2@1+ (1,0) [0|0] "" Vector__XXX
 SG_ VCFRONT_a475_ssl100Bank3Status m475 : 20|2@1+ (1,0) [0|0] "" Vector__XXX
 SG_ VCFRONT_a476_FRM5_timedOut m476 : 20|1@1+ (1,0) [0|0] "" Vector__XXX
 SG_ VCFRONT_a478_battFaultCellOverVoltage m478 : 20|1@1+ (1,0) [0|0] "" Vector__XXX
 SG_ VCFRONT_a479_serviceMode m479 : 20|1@1+ (1,0) [0|0] "" Vector__XXX
 SG_ VCFRONT_a480_spiError m480 : 20|1@1+ (1,0) [0|0] "" Vector__XXX
 SG_ VCFRONT_a489_CCLEXV m489 : 20|1@1+ (1,0) [0|0] "" Vector__XXX
 SG_ VCFRONT_a495_reverseBatteryEFuseFault m495 : 20|1@1+ (1,0) [0|0] "" Vector__XXX
 SG_ VCFRONT_a496_serviceMode m496 : 20|1@1+ (1,0) [0|0] "" Vector__XXX
 SG_ VCFRONT_a507_useVirtualPitchSensor m507 : 20|1@1+ (1,0) [0|0] "" Vector__XXX
 SG_ VCFRONT_a524_useVirtualPitchSensor m524 : 20|1@1+ (1,0) [0|0] "" Vector__XXX
 SG_ VCFRONT_a528_frunkOpen m528 : 20|1@1+ (1,0) [0|0] "" Vector__XXX
 SG_ VCFRONT_a548_LVBatteryCannotSupportVehicle m548 : 20|1@1+ (1,0) [0|0] "" Vector__XXX
 SG_ VCFRONT_a552_epas3pSelfTestResult m552 : 20|4@1+ (1,0) [0|0] "" Vector__XXX
 SG_ VCFRONT_a556_vehiclePowerState m556 : 20|2@1+ (1,0) [0|0] "" Vector__XXX
 SG_ VCFRONT_a560_highSHCabinCooling m560 : 20|1@1+ (1,0) [0|0] "" Vector__XXX
 SG_ VCFRONT_a565_steeringWheelButtonInteraction m565 : 20|1@1+ (1,0) [0|0] "" Vector__XXX
 SG_ VCFRONT_a583_shadowSwitchGroupStateNext m583 : 20|2@1+ (1,0) [0|0] "" Vector__XXX
 SG_ VCFRONT_a584_frunkSwitchGroupRequestCurrent m584 : 20|2@1+ (1,0) [0|0] "" Vector__XXX
 SG_ VCFRONT_a587_LVBMS_packCurrent_valid m587 : 20|1@1+ (1,0) [0|0] "" Vector__XXX
 SG_ VCFRONT_a595_vehiclePowerState m595 : 20|2@1+ (1,0) [0|0] "" Vector__XXX
 SG_ VCFRONT_a600_vehiclePowerState m600 : 20|2@1+ (1,0) [0|0] "" Vector__XXX
 SG_ VCFRONT_a606_coolantTempTooHigh m606 : 20|1@1+ (1,0) [0|0] "" Vector__XXX
 SG_ VCFRONT_a610_dataBufferBits m610 : 20|10@1+ (1,0) [0|0] "" Vector__XXX
 SG_ VCFRONT_a612_vehicleSpeed m612 : 20|12@1+ (0.08,-40) [0|0] "" Vector__XXX
 SG_ VCFRONT_a614_octovalveFaulted m614 : 20|1@1+ (1,0) [0|0] "" Vector__XXX
 SG_ VCFRONT_a619_switchTransitionTimeMS m619 : 20|12@1+ (1,0) [0|0] "" Vector__XXX
 SG_ VCFRONT_a623_vehicleSpeed m623 : 20|12@1+ (0.08,-40) [0|0] "" Vector__XXX
 SG_ VCFRONT_a635_chBusAwake m635 : 20|1@1+ (1,0) [0|0] "" Vector__XXX
 SG_ VCFRONT_a644_washPumpHealthState m644 : 20|3@1+ (1,0) [0|0] "" Vector__XXX
 SG_ VCFRONT_a665_retryCount m665 : 20|3@1+ (1,0) [0|0] "" Vector__XXX
 SG_ VCFRONT_a666_retryCount m666 : 20|3@1+ (1,0) [0|0] "" Vector__XXX
 SG_ VCFRONT_a669_defrostEnabled m669 : 20|1@1+ (1,0) [0|0] "" Vector__XXX
 SG_ VCFRONT_a004_EPAS3PNotInSpecOrMIA m4 : 21|1@1+ (1,0) [0|0] "" Vector__XXX
 SG_ VCFRONT_a008_EPAS3PNotInSpecOrMIA m8 : 21|1@1+ (1,0) [0|0] "" Vector__XXX
 SG_ VCFRONT_a009_completed m9 : 21|1@1+ (1,0) [0|0] "" Vector__XXX
 SG_ VCFRONT_a012_ExternalReset m12 : 21|1@1+ (1,0) [0|0] "" Vector__XXX
 SG_ VCFRONT_a021_Task10msMissed m21 : 21|1@1+ (1,0) [0|0] "" Vector__XXX
 SG_ VCFRONT_a032_sleeping m32 : 21|1@1+ (1,0) [0|0] "" Vector__XXX
 SG_ VCFRONT_a038_privilegedRead m38 : 21|1@1+ (1,0) [0|0] "" Vector__XXX
 SG_ VCFRONT_a047_Mcwdt0 m47 : 21|1@1+ (1,0) [0|0] "" Vector__XXX
 SG_ VCFRONT_a086_VEH_lightStatus m86 : 21|1@1+ (1,0) [0|0] "" Vector__XXX
 SG_ VCFRONT_a087_PARTY_status m87 : 21|1@1+ (1,0) [0|0] "" Vector__XXX
 SG_ VCFRONT_a088_PARTY_status m88 : 21|1@1+ (1,0) [0|0] "" Vector__XXX
 SG_ VCFRONT_a089_CH_status m89 : 21|1@1+ (1,0) [0|0] "" Vector__XXX
 SG_ VCFRONT_a098_VEH_torque m98 : 21|1@1+ (1,0) [0|0] "" Vector__XXX
 SG_ VCFRONT_a103_VEH_evseStatus m103 : 21|1@1+ (1,0) [0|0] "" Vector__XXX
 SG_ VCFRONT_a104_VEH_thermalStatus m104 : 21|1@1+ (1,0) [0|0] "" Vector__XXX
 SG_ VCFRONT_a107_VEH_powerAvailable m107 : 21|1@1+ (1,0) [0|0] "" Vector__XXX
 SG_ VCFRONT_a108_PARTY_torque m108 : 21|1@1+ (1,0) [0|0] "" Vector__XXX
 SG_ VCFRONT_a109_VEH_imuOffsets m109 : 21|1@1+ (1,0) [0|0] "" Vector__XXX
 SG_ VCFRONT_a110_VEH_vehNm m110 : 21|1@1+ (1,0) [0|0] "" Vector__XXX
 SG_ VCFRONT_a111_RIPC_railStatus m111 : 21|1@1+ (1,0) [0|0] "" Vector__XXX
 SG_ VCFRONT_a112_LIPC_railStatus m112 : 21|1@1+ (1,0) [0|0] "" Vector__XXX
 SG_ VCFRONT_a113_VEH_peripheralPowerRequests m113 : 21|1@1+ (1,0) [0|0] "" Vector__XXX
 SG_ VCFRONT_a114_VEH_party3 m114 : 21|1@1+ (1,0) [0|0] "" Vector__XXX
 SG_ VCFRONT_a115_REM_authentication m115 : 21|1@1+ (1,0) [0|0] "" Vector__XXX
 SG_ VCFRONT_a116_VEH_lightStatus m116 : 21|1@1+ (1,0) [0|0] "" Vector__XXX
 SG_ VCFRONT_a117_VEH_hvacBlowerFdb m117 : 21|1@1+ (1,0) [0|0] "" Vector__XXX
 SG_ VCFRONT_a118_VEH_LVPowerState m118 : 21|1@1+ (1,0) [0|0] "" Vector__XXX
 SG_ VCFRONT_a119_PARTY_steerAngle m119 : 21|1@1+ (1,0) [0|0] "" Vector__XXX
 SG_ VCFRONT_a120_VEH_torque m120 : 21|1@1+ (1,0) [0|0] "" Vector__XXX
 SG_ VCFRONT_a142_driverThermShutdown m142 : 21|1@1+ (1,0) [0|0] "" Vector__XXX
 SG_ VCFRONT_a153_frontDriverDoorOpen m153 : 21|1@1+ (1,0) [0|0] "" Vector__XXX
 SG_ VCFRONT_a160_faultSnsDischTemp m160 : 21|1@1+ (1,0) [0|0] "" Vector__XXX
 SG_ VCFRONT_a161_shortCircuit m161 : 21|1@1+ (1,0) [0|0] "" Vector__XXX
 SG_ VCFRONT_a171_HVP m171 : 21|1@1+ (1,0) [0|0] "" Vector__XXX
 SG_ VCFRONT_a178_abortCompNeverOn m178 : 21|1@1+ (1,0) [0|0] "" Vector__XXX
 SG_ VCFRONT_a182_postPORExcessiveAh m182 : 21|1@1+ (1,0) [0|0] "" Vector__XXX
 SG_ VCFRONT_a183_postPORExcessiveAh m183 : 21|1@1+ (1,0) [0|0] "" Vector__XXX
 SG_ VCFRONT_a191_reverseBatteryEFuseFault m191 : 21|1@1+ (1,0) [0|0] "" Vector__XXX
 SG_ VCFRONT_a192_notEnoughPowerForSupport m192 : 21|1@1+ (1,0) [0|0] "" Vector__XXX
 SG_ VCFRONT_a216_vcleftFastBlowDebounceImminent m216 : 21|1@1+ (1,0) [0|0] "" Vector__XXX
 SG_ VCFRONT_a221_overTemperature m221 : 21|1@1+ (1,0) [0|0] "" Vector__XXX
 SG_ VCFRONT_a222_overTemperature m222 : 21|1@1+ (1,0) [0|0] "" Vector__XXX
 SG_ VCFRONT_a271_prechargeLVLoadReductionTrigger m271 : 21|1@1+ (1,0) [0|0] "" Vector__XXX
 SG_ VCFRONT_a274_prechargeLVLoadReductionTrigger m274 : 21|1@1+ (1,0) [0|0] "" Vector__XXX
 SG_ VCFRONT_a275_bmbCommStatusTypeA m275 : 21|2@1+ (1,0) [0|0] "" Vector__XXX
 SG_ VCFRONT_a276_bmbCommStatusTypeA m276 : 21|2@1+ (1,0) [0|0] "" Vector__XXX
 SG_ VCFRONT_a284_driverThermShutdown m284 : 21|1@1+ (1,0) [0|0] "" Vector__XXX
 SG_ VCFRONT_a285_driverThermShutdown m285 : 21|1@1+ (1,0) [0|0] "" Vector__XXX
 SG_ VCFRONT_a286_driverThermShutdown m286 : 21|1@1+ (1,0) [0|0] "" Vector__XXX
 SG_ VCFRONT_a287_driverThermShutdown m287 : 21|1@1+ (1,0) [0|0] "" Vector__XXX
 SG_ VCFRONT_a288_driverThermShutdown m288 : 21|1@1+ (1,0) [0|0] "" Vector__XXX
 SG_ VCFRONT_a289_driverThermShutdown m289 : 21|1@1+ (1,0) [0|0] "" Vector__XXX
 SG_ VCFRONT_a290_overTemperature m290 : 21|1@1+ (1,0) [0|0] "" Vector__XXX
 SG_ VCFRONT_a291_overTemperature m291 : 21|1@1+ (1,0) [0|0] "" Vector__XXX
 SG_ VCFRONT_a292_overTemperature m292 : 21|1@1+ (1,0) [0|0] "" Vector__XXX
 SG_ VCFRONT_a293_overTemperature m293 : 21|1@1+ (1,0) [0|0] "" Vector__XXX
 SG_ VCFRONT_a294_overTemperature m294 : 21|1@1+ (1,0) [0|0] "" Vector__XXX
 SG_ VCFRONT_a295_overTemperature m295 : 21|1@1+ (1,0) [0|0] "" Vector__XXX
 SG_ VCFRONT_a371_prechargeLVLoadReductionTrigger m371 : 21|1@1+ (1,0) [0|0] "" Vector__XXX
 SG_ VCFRONT_a380_driverOpenLoad m380 : 21|1@1+ (1,0) [0|0] "" Vector__XXX
 SG_ VCFRONT_a381_driverOpenLoad m381 : 21|1@1+ (1,0) [0|0] "" Vector__XXX
 SG_ VCFRONT_a382_driverOpenLoad m382 : 21|1@1+ (1,0) [0|0] "" Vector__XXX
 SG_ VCFRONT_a383_driverOpenLoad m383 : 21|1@1+ (1,0) [0|0] "" Vector__XXX
 SG_ VCFRONT_a384_driverOpenLoad m384 : 21|1@1+ (1,0) [0|0] "" Vector__XXX
 SG_ VCFRONT_a385_driverOpenLoad m385 : 21|1@1+ (1,0) [0|0] "" Vector__XXX
 SG_ VCFRONT_a386_driverOpenLoad m386 : 21|1@1+ (1,0) [0|0] "" Vector__XXX
 SG_ VCFRONT_a391_switch1Voltage m391 : 21|10@1+ (5,0) [0|0] "" Vector__XXX
 SG_ VCFRONT_a446_compStandbyLowAmbient m446 : 21|1@1+ (1,0) [0|0] "" Vector__XXX
 SG_ VCFRONT_a447_scavengeLoopCompromised m447 : 21|1@1+ (1,0) [0|0] "" Vector__XXX
 SG_ VCFRONT_a462_ModuleOTLevel1 m462 : 21|1@1+ (1,0) [0|0] "" Vector__XXX
 SG_ VCFRONT_a463_switch1Voltage m463 : 21|10@1+ (5,0) [0|0] "" Vector__XXX
 SG_ VCFRONT_a476_FRM6_timedOut m476 : 21|1@1+ (1,0) [0|0] "" Vector__XXX
 SG_ VCFRONT_a478_vehiclePowerState m478 : 21|2@1+ (1,0) [0|0] "" Vector__XXX
 SG_ VCFRONT_a479_transportMode m479 : 21|1@1+ (1,0) [0|0] "" Vector__XXX
 SG_ VCFRONT_a480_autoOn m480 : 21|1@1+ (1,0) [0|0] "" Vector__XXX
 SG_ VCFRONT_a489_CCREXV m489 : 21|1@1+ (1,0) [0|0] "" Vector__XXX
 SG_ VCFRONT_a495_DCDCOff m495 : 21|1@1+ (1,0) [0|0] "" Vector__XXX
 SG_ VCFRONT_a496_frunkOpen m496 : 21|1@1+ (1,0) [0|0] "" Vector__XXX
 SG_ VCFRONT_a507_pitchEstimateValid m507 : 21|1@1+ (1,0) [0|0] "" Vector__XXX
 SG_ VCFRONT_a524_pitchEstimateValid m524 : 21|1@1+ (1,0) [0|0] "" Vector__XXX
 SG_ VCFRONT_a548_DI_gear m548 : 21|3@1+ (1,0) [0|0] "" Vector__XXX
 SG_ VCFRONT_a560_highSHCabinHeating m560 : 21|1@1+ (1,0) [0|0] "" Vector__XXX
 SG_ VCFRONT_a561_packTemperature m561 : 21|5@1+ (4,0) [0|0] "" Vector__XXX
 SG_ VCFRONT_a562_packTemperature m562 : 21|5@1+ (4,0) [0|0] "" Vector__XXX
 SG_ VCFRONT_a565_frontDriverDoorOpen m565 : 21|1@1+ (1,0) [0|0] "" Vector__XXX
 SG_ VCFRONT_a587_vehiclePowerState m587 : 21|2@1+ (1,0) [0|0] "" Vector__XXX
 SG_ VCFRONT_a606_chillerExitCoolantTempTooHigh m606 : 21|1@1+ (1,0) [0|0] "" Vector__XXX
 SG_ VCFRONT_a614_battPumpRpm m614 : 21|1@1+ (1,0) [0|0] "" Vector__XXX
 SG_ VCFRONT_a635_hvsBusAwake m635 : 21|1@1+ (1,0) [0|0] "" Vector__XXX
 SG_ VCFRONT_a669_vehiclePowerState m669 : 21|2@1+ (1,0) [0|0] "" Vector__XXX
 SG_ VCFRONT_a009_abortedDeviceFault m9 : 22|1@1+ (1,0) [0|0] "" Vector__XXX
 SG_ VCFRONT_a021_Task100msLate m21 : 22|1@1+ (1,0) [0|0] "" Vector__XXX
 SG_ VCFRONT_a032_sleepdeep m32 : 22|1@1+ (1,0) [0|0] "" Vector__XXX
 SG_ VCFRONT_a038_privilegedWrite m38 : 22|1@1+ (1,0) [0|0] "" Vector__XXX
 SG_ VCFRONT_a047_Mcwdt1 m47 : 22|1@1+ (1,0) [0|0] "" Vector__XXX
 SG_ VCFRONT_a086_VEH_systemStatus m86 : 22|1@1+ (1,0) [0|0] "" Vector__XXX
 SG_ VCFRONT_a087_PARTY_temperature m87 : 22|1@1+ (1,0) [0|0] "" Vector__XXX
 SG_ VCFRONT_a088_PARTY_temperature m88 : 22|1@1+ (1,0) [0|0] "" Vector__XXX
 SG_ VCFRONT_a089_CH_party1 m89 : 22|1@1+ (1,0) [0|0] "" Vector__XXX
 SG_ VCFRONT_a098_PARTY_status m98 : 22|1@1+ (1,0) [0|0] "" Vector__XXX
 SG_ VCFRONT_a104_CH_control m104 : 22|1@1+ (1,0) [0|0] "" Vector__XXX
 SG_ VCFRONT_a107_PT_ptNm m107 : 22|1@1+ (1,0) [0|0] "" Vector__XXX
 SG_ VCFRONT_a108_PARTY_status m108 : 22|1@1+ (1,0) [0|0] "" Vector__XXX
 SG_ VCFRONT_a109_PARTY_inertial1 m109 : 22|1@1+ (1,0) [0|0] "" Vector__XXX
 SG_ VCFRONT_a110_VEH_mismatchFault m110 : 22|1@1+ (1,0) [0|0] "" Vector__XXX
 SG_ VCFRONT_a111_RIPC_remoteADC m111 : 22|1@1+ (1,0) [0|0] "" Vector__XXX
 SG_ VCFRONT_a112_LIPC_remoteADC m112 : 22|1@1+ (1,0) [0|0] "" Vector__XXX
 SG_ VCFRONT_a113_VEH_corianderVehicleControl m113 : 22|1@1+ (1,0) [0|0] "" Vector__XXX
 SG_ VCFRONT_a114_VEH_status m114 : 22|1@1+ (1,0) [0|0] "" Vector__XXX
 SG_ VCFRONT_a115_UI_corianderVehicleControl m115 : 22|1@1+ (1,0) [0|0] "" Vector__XXX
 SG_ VCFRONT_a116_VEH_seatStatus m116 : 22|1@1+ (1,0) [0|0] "" Vector__XXX
 SG_ VCFRONT_a117_VEH_LVPowerState m117 : 22|1@1+ (1,0) [0|0] "" Vector__XXX
 SG_ VCFRONT_a118_VEH_coolant m118 : 22|1@1+ (1,0) [0|0] "" Vector__XXX
 SG_ VCFRONT_a120_PARTY_locStatus m120 : 22|1@1+ (1,0) [0|0] "" Vector__XXX
 SG_ VCFRONT_a142_undervoltage m142 : 22|1@1+ (1,0) [0|0] "" Vector__XXX
 SG_ VCFRONT_a153_frontPassengerDoorOpen m153 : 22|1@1+ (1,0) [0|0] "" Vector__XXX
 SG_ VCFRONT_a160_faultSnsSuctPress m160 : 22|1@1+ (1,0) [0|0] "" Vector__XXX
 SG_ VCFRONT_a161_underTemperature m161 : 22|1@1+ (1,0) [0|0] "" Vector__XXX
 SG_ VCFRONT_a162_chillerExvFlow m162 : 22|7@1+ (1,0) [0|0] "" Vector__XXX
 SG_ VCFRONT_a171_GTW m171 : 22|1@1+ (1,0) [0|0] "" Vector__XXX
 SG_ VCFRONT_a178_abortCompTurnedOff m178 : 22|1@1+ (1,0) [0|0] "" Vector__XXX
 SG_ VCFRONT_a182_resistanceEstimationHardFailure m182 : 22|1@1+ (1,0) [0|0] "" Vector__XXX
 SG_ VCFRONT_a183_resistanceEstimationHardFailure m183 : 22|1@1+ (1,0) [0|0] "" Vector__XXX
 SG_ VCFRONT_a190_bus m190 : 22|6@1+ (1,0) [0|0] "" Vector__XXX
 SG_ VCFRONT_a191_vehicleLoadShedActive m191 : 22|1@1+ (1,0) [0|0] "" Vector__XXX
 SG_ VCFRONT_a192_pcsEFuseStable m192 : 22|1@1+ (1,0) [0|0] "" Vector__XXX
 SG_ VCFRONT_a216_vcleftStaticImminent m216 : 22|1@1+ (1,0) [0|0] "" Vector__XXX
 SG_ VCFRONT_a271_instantPrechargeDCRTooHighTrigger m271 : 22|1@1+ (1,0) [0|0] "" Vector__XXX
 SG_ VCFRONT_a274_instantPrechargeDCRTooHighTrigger m274 : 22|1@1+ (1,0) [0|0] "" Vector__XXX
 SG_ VCFRONT_a284_undervoltage m284 : 22|1@1+ (1,0) [0|0] "" Vector__XXX
 SG_ VCFRONT_a285_undervoltage m285 : 22|1@1+ (1,0) [0|0] "" Vector__XXX
 SG_ VCFRONT_a286_undervoltage m286 : 22|1@1+ (1,0) [0|0] "" Vector__XXX
 SG_ VCFRONT_a287_undervoltage m287 : 22|1@1+ (1,0) [0|0] "" Vector__XXX
 SG_ VCFRONT_a288_undervoltage m288 : 22|1@1+ (1,0) [0|0] "" Vector__XXX
 SG_ VCFRONT_a289_undervoltage m289 : 22|1@1+ (1,0) [0|0] "" Vector__XXX
 SG_ VCFRONT_a366_timeout m366 : 22|1@1+ (1,0) [0|0] "" Vector__XXX
 SG_ VCFRONT_a371_instantPrechargeDCRTooHighTrigger m371 : 22|1@1+ (1,0) [0|0] "" Vector__XXX
 SG_ VCFRONT_a378_wiperUndervoltage m378 : 22|1@1+ (1,0) [0|0] "" Vector__XXX
 SG_ VCFRONT_a390_lowSideHX m390 : 22|2@1+ (1,0) [0|0] "" Vector__XXX
 SG_ VCFRONT_a415_LVBatteryTemp m415 : 22|7@1+ (1,-40) [0|0] "" Vector__XXX
 SG_ VCFRONT_a446_compStandbyLowDischPress m446 : 22|1@1+ (1,0) [0|0] "" Vector__XXX
 SG_ VCFRONT_a447_coolantSystemCompromised m447 : 22|1@1+ (1,0) [0|0] "" Vector__XXX
 SG_ VCFRONT_a462_PackOVLevel1 m462 : 22|1@1+ (1,0) [0|0] "" Vector__XXX
 SG_ VCFRONT_a474_ssl100Bank4Status m474 : 22|2@1+ (1,0) [0|0] "" Vector__XXX
 SG_ VCFRONT_a475_ssl100Bank4Status m475 : 22|2@1+ (1,0) [0|0] "" Vector__XXX
 SG_ VCFRONT_a476_FRM7_timedOut m476 : 22|1@1+ (1,0) [0|0] "" Vector__XXX
 SG_ VCFRONT_a480_diagnosticBit m480 : 22|1@1+ (1,0) [0|0] "" Vector__XXX
 SG_ VCFRONT_a489_SOV m489 : 22|1@1+ (1,0) [0|0] "" Vector__XXX
 SG_ VCFRONT_a495_HVOff m495 : 22|1@1+ (1,0) [0|0] "" Vector__XXX
 SG_ VCFRONT_a496_PCS_MIA m496 : 22|1@1+ (1,0) [0|0] "" Vector__XXX
 SG_ VCFRONT_a507_isAcceptableGear m507 : 22|1@1+ (1,0) [0|0] "" Vector__XXX
 SG_ VCFRONT_a524_isAcceptableGear m524 : 22|1@1+ (1,0) [0|0] "" Vector__XXX
 SG_ VCFRONT_a545_serviceMode m545 : 22|1@1+ (1,0) [0|0] "" Vector__XXX
 SG_ VCFRONT_a560_highSHCatchAll m560 : 22|1@1+ (1,0) [0|0] "" Vector__XXX
 SG_ VCFRONT_a565_frontPassengerDoorOpen m565 : 22|1@1+ (1,0) [0|0] "" Vector__XXX
 SG_ VCFRONT_a583_referenceSwitchGroupStateSimpleNext m583 : 22|2@1+ (1,0) [0|0] "" Vector__XXX
 SG_ VCFRONT_a584_frunkSwitchGroupRequestPrevious m584 : 22|2@1+ (1,0) [0|0] "" Vector__XXX
 SG_ VCFRONT_a606_ductTempOvershoot m606 : 22|1@1+ (1,0) [0|0] "" Vector__XXX
 SG_ VCFRONT_a614_battPumpFault m614 : 22|1@1+ (1,0) [0|0] "" Vector__XXX
 SG_ VCFRONT_a635_partyBusAwake m635 : 22|1@1+ (1,0) [0|0] "" Vector__XXX
 SG_ VCFRONT_a009_abortedLowPs m9 : 23|1@1+ (1,0) [0|0] "" Vector__XXX
 SG_ VCFRONT_a021_Task100msStarved m21 : 23|1@1+ (1,0) [0|0] "" Vector__XXX
 SG_ VCFRONT_a032_pwrDone m32 : 23|1@1+ (1,0) [0|0] "" Vector__XXX
 SG_ VCFRONT_a038_privilegedExecute m38 : 23|1@1+ (1,0) [0|0] "" Vector__XXX
 SG_ VCFRONT_a047_Mcwdt2 m47 : 23|1@1+ (1,0) [0|0] "" Vector__XXX
 SG_ VCFRONT_a086_VEH_thermalStatus m86 : 23|1@1+ (1,0) [0|0] "" Vector__XXX
 SG_ VCFRONT_a087_PARTY_thermalControl m87 : 23|1@1+ (1,0) [0|0] "" Vector__XXX
 SG_ VCFRONT_a088_PARTY_thermalControl m88 : 23|1@1+ (1,0) [0|0] "" Vector__XXX
 SG_ VCFRONT_a089_CH_party3 m89 : 23|1@1+ (1,0) [0|0] "" Vector__XXX
 SG_ VCFRONT_a098_PARTY_temperature m98 : 23|1@1+ (1,0) [0|0] "" Vector__XXX
 SG_ VCFRONT_a104_PARTY_control m104 : 23|1@1+ (1,0) [0|0] "" Vector__XXX
 SG_ VCFRONT_a107_PT_status m107 : 23|1@1+ (1,0) [0|0] "" Vector__XXX
 SG_ VCFRONT_a108_PARTY_temperature m108 : 23|1@1+ (1,0) [0|0] "" Vector__XXX
 SG_ VCFRONT_a109_BDY_imuOffsets m109 : 23|1@1+ (1,0) [0|0] "" Vector__XXX
 SG_ VCFRONT_a110_VEH_vin m110 : 23|1@1+ (1,0) [0|0] "" Vector__XXX
 SG_ VCFRONT_a111_RIPC_switchStatus m111 : 23|1@1+ (1,0) [0|0] "" Vector__XXX
 SG_ VCFRONT_a112_LIPC_switchStatus m112 : 23|1@1+ (1,0) [0|0] "" Vector__XXX
 SG_ VCFRONT_a113_VEH_solarData m113 : 23|1@1+ (1,0) [0|0] "" Vector__XXX
 SG_ VCFRONT_a114_PARTY_wheelRotation m114 : 23|1@1+ (1,0) [0|0] "" Vector__XXX
 SG_ VCFRONT_a115_CH_TPMSDisplay m115 : 23|1@1+ (1,0) [0|0] "" Vector__XXX
 SG_ VCFRONT_a116_VEH_thsStatus m116 : 23|1@1+ (1,0) [0|0] "" Vector__XXX
 SG_ VCFRONT_a117_VEH_restraintStatus m117 : 23|1@1+ (1,0) [0|0] "" Vector__XXX
 SG_ VCFRONT_a118_VEH_vehicleStatus m118 : 23|1@1+ (1,0) [0|0] "" Vector__XXX
 SG_ VCFRONT_a120_PARTY_speed m120 : 23|1@1+ (1,0) [0|0] "" Vector__XXX
 SG_ VCFRONT_a142_chargePumpUndervoltage m142 : 23|1@1+ (1,0) [0|0] "" Vector__XXX
 SG_ VCFRONT_a153_rearDriverDoorOpen m153 : 23|1@1+ (1,0) [0|0] "" Vector__XXX
 SG_ VCFRONT_a160_faultSnsSuctTemp m160 : 23|1@1+ (1,0) [0|0] "" Vector__XXX
 SG_ VCFRONT_a161_LVUnderVoltage m161 : 23|1@1+ (1,0) [0|0] "" Vector__XXX
 SG_ VCFRONT_a171_CP m171 : 23|1@1+ (1,0) [0|0] "" Vector__XXX
 SG_ VCFRONT_a178_abortCompOvershoot m178 : 23|1@1+ (1,0) [0|0] "" Vector__XXX
 SG_ VCFRONT_a182_dcrMilliOhmsAboveThreshold m182 : 23|1@1+ (1,0) [0|0] "" Vector__XXX
 SG_ VCFRONT_a183_dcrMilliOhmsAboveThreshold m183 : 23|1@1+ (1,0) [0|0] "" Vector__XXX
 SG_ VCFRONT_a191_vehicleLoadShedHvFaultActive m191 : 23|1@1+ (1,0) [0|0] "" Vector__XXX
 SG_ VCFRONT_a192_vcrightEFuseStable m192 : 23|1@1+ (1,0) [0|0] "" Vector__XXX
 SG_ VCFRONT_a216_vcleftDynamicImminent m216 : 23|1@1+ (1,0) [0|0] "" Vector__XXX
 SG_ VCFRONT_a284_chargePumpUndervoltage m284 : 23|1@1+ (1,0) [0|0] "" Vector__XXX
 SG_ VCFRONT_a285_chargePumpUndervoltage m285 : 23|1@1+ (1,0) [0|0] "" Vector__XXX
 SG_ VCFRONT_a286_chargePumpUndervoltage m286 : 23|1@1+ (1,0) [0|0] "" Vector__XXX
 SG_ VCFRONT_a287_chargePumpUndervoltage m287 : 23|1@1+ (1,0) [0|0] "" Vector__XXX
 SG_ VCFRONT_a288_chargePumpUndervoltage m288 : 23|1@1+ (1,0) [0|0] "" Vector__XXX
 SG_ VCFRONT_a289_chargePumpUndervoltage m289 : 23|1@1+ (1,0) [0|0] "" Vector__XXX
 SG_ VCFRONT_a365_timeout m365 : 23|1@1+ (1,0) [0|0] "" Vector__XXX
 SG_ VCFRONT_a366_notInConditioning m366 : 23|1@1+ (1,0) [0|0] "" Vector__XXX
 SG_ VCFRONT_a378_wiperOvervoltage m378 : 23|1@1+ (1,0) [0|0] "" Vector__XXX
 SG_ VCFRONT_a446_compStandbyHVNotReady m446 : 23|1@1+ (1,0) [0|0] "" Vector__XXX
 SG_ VCFRONT_a447_hvBattActiveDischgCompromised m447 : 23|1@1+ (1,0) [0|0] "" Vector__XXX
 SG_ VCFRONT_a462_PackOVLevel2 m462 : 23|1@1+ (1,0) [0|0] "" Vector__XXX
 SG_ VCFRONT_a476_FRM8_timedOut m476 : 23|1@1+ (1,0) [0|0] "" Vector__XXX
 SG_ VCFRONT_a480_deviceError m480 : 23|1@1+ (1,0) [0|0] "" Vector__XXX
 SG_ VCFRONT_a495_externalInteraction m495 : 23|1@1+ (1,0) [0|0] "" Vector__XXX
 SG_ VCFRONT_a496_NotEnoughPowerForSupport m496 : 23|1@1+ (1,0) [0|0] "" Vector__XXX
 SG_ VCFRONT_a507_isAcceptablePowerState m507 : 23|1@1+ (1,0) [0|0] "" Vector__XXX
 SG_ VCFRONT_a514_cell2Voltage m514 : 23|7@1+ (0.08,0) [0|0] "" Vector__XXX
 SG_ VCFRONT_a515_cell2Voltage m515 : 23|7@1+ (0.08,0) [0|0] "" Vector__XXX
 SG_ VCFRONT_a524_isAcceptablePowerState m524 : 23|1@1+ (1,0) [0|0] "" Vector__XXX
 SG_ VCFRONT_a545_factoryGated m545 : 23|1@1+ (1,0) [0|0] "" Vector__XXX
 SG_ VCFRONT_a565_rearDriverDoorOpen m565 : 23|1@1+ (1,0) [0|0] "" Vector__XXX
 SG_ VCFRONT_a606_chillerLoadBeforeEntry m606 : 23|7@1+ (50.38582677165354,0) [0|0] "" Vector__XXX
 SG_ VCFRONT_a614_ptPumpRpm m614 : 23|1@1+ (1,0) [0|0] "" Vector__XXX
 SG_ VCFRONT_a635_ethBusAwake m635 : 23|1@1+ (1,0) [0|0] "" Vector__XXX
 SG_ VCFRONT_a644_validWashCycle m644 : 23|1@1+ (1,0) [0|0] "" Vector__XXX
 SG_ VCFRONT_a665_isWaitingToClear m665 : 23|1@1+ (1,0) [0|0] "" Vector__XXX
 SG_ VCFRONT_a666_isWaitingToClear m666 : 23|1@1+ (1,0) [0|0] "" Vector__XXX
 SG_ VCFRONT_a669_hvState m669 : 23|3@1+ (1,0) [0|0] "" Vector__XXX
 SG_ VCFRONT_a006_mailboxID m6 : 24|8@1+ (1,0) [0|0] "" Vector__XXX
 SG_ VCFRONT_a009_abortedCOP1BattHeatRequested m9 : 24|1@1+ (1,0) [0|0] "" Vector__XXX
 SG_ VCFRONT_a021_Task100msMissed m21 : 24|1@1+ (1,0) [0|0] "" Vector__XXX
 SG_ VCFRONT_a022_TaskInitError0 m22 : 24|8@1+ (1,0) [0|0] "" Vector__XXX
 SG_ VCFRONT_a031_uds_bytes_1 m31 : 24|8@1+ (1,0) [0|0] "" Vector__XXX
 SG_ VCFRONT_a033_syndrome m33 : 24|8@1+ (1,0) [0|0] "" Vector__XXX
 SG_ VCFRONT_a038_nonSecure m38 : 24|1@1+ (1,0) [0|0] "" Vector__XXX
 SG_ VCFRONT_a039_faultAddress m39 : 24|32@1+ (1,0) [0|0] "" Vector__XXX
 SG_ VCFRONT_a040_programCounter m40 : 24|32@1+ (1,0) [0|0] "" Vector__XXX
 SG_ VCFRONT_a041_CPULoad1msTask m41 : 24|8@1+ (1,0) [0|0] "" Vector__XXX
 SG_ VCFRONT_a042_Usage10msTask m42 : 24|8@1+ (1,0) [0|0] "" Vector__XXX
 SG_ VCFRONT_a047_Mcwdt3 m47 : 24|1@1+ (1,0) [0|0] "" Vector__XXX
 SG_ VCFRONT_a063_switchType m63 : 24|8@1+ (1,0) [0|0] "" Vector__XXX
 SG_ VCFRONT_a086_VEH_vehNm m86 : 24|1@1+ (1,0) [0|0] "" Vector__XXX
 SG_ VCFRONT_a087_VEH_motorStatus m87 : 24|1@1+ (1,0) [0|0] "" Vector__XXX
 SG_ VCFRONT_a088_VEH_motorStatus m88 : 24|1@1+ (1,0) [0|0] "" Vector__XXX
 SG_ VCFRONT_a089_VEH_party1 m89 : 24|1@1+ (1,0) [0|0] "" Vector__XXX
 SG_ VCFRONT_a098_PARTY_thermalControl m98 : 24|1@1+ (1,0) [0|0] "" Vector__XXX
 SG_ VCFRONT_a104_PARTY_bodyControls m104 : 24|1@1+ (1,0) [0|0] "" Vector__XXX
 SG_ VCFRONT_a107_PT_thermalStatus m107 : 24|1@1+ (1,0) [0|0] "" Vector__XXX
 SG_ VCFRONT_a108_PARTY_thermalControl m108 : 24|1@1+ (1,0) [0|0] "" Vector__XXX
 SG_ VCFRONT_a109_BDY_inertial1 m109 : 24|1@1+ (1,0) [0|0] "" Vector__XXX
 SG_ VCFRONT_a110_VEH_bmpDebug m110 : 24|1@1+ (1,0) [0|0] "" Vector__XXX
 SG_ VCFRONT_a111_VEH_LVPowerState m111 : 24|1@1+ (1,0) [0|0] "" Vector__XXX
 SG_ VCFRONT_a112_VEH_LVPowerState m112 : 24|1@1+ (1,0) [0|0] "" Vector__XXX
 SG_ VCFRONT_a113_VEH_ventCntlReq m113 : 24|1@1+ (1,0) [0|0] "" Vector__XXX
 SG_ VCFRONT_a114_CH_wheelRotation m114 : 24|1@1+ (1,0) [0|0] "" Vector__XXX
 SG_ VCFRONT_a116_VEH_doorStatus m116 : 24|1@1+ (1,0) [0|0] "" Vector__XXX
 SG_ VCFRONT_a117_VEH_lightStatus m117 : 24|1@1+ (1,0) [0|0] "" Vector__XXX
 SG_ VCFRONT_a118_VEH_12VBatteryStatus m118 : 24|1@1+ (1,0) [0|0] "" Vector__XXX
 SG_ VCFRONT_a120_VEH_speed m120 : 24|1@1+ (1,0) [0|0] "" Vector__XXX
 SG_ VCFRONT_a142_isCoilOpenX m142 : 24|1@1+ (1,0) [0|0] "" Vector__XXX
 SG_ VCFRONT_a153_rearPassengerDoorOpen m153 : 24|1@1+ (1,0) [0|0] "" Vector__XXX
 SG_ VCFRONT_a155_minHVComingUpIBSVoltage m155 : 24|11@1+ (0.005,5) [0|0] "" Vector__XXX
 SG_ VCFRONT_a160_faultSnsAmbientTemp m160 : 24|1@1+ (1,0) [0|0] "" Vector__XXX
 SG_ VCFRONT_a161_LVOverVoltage m161 : 24|1@1+ (1,0) [0|0] "" Vector__XXX
 SG_ VCFRONT_a163_failureConfidence m163 : 24|7@1+ (1,0) [0|0] "" Vector__XXX
 SG_ VCFRONT_a171_PCS m171 : 24|1@1+ (1,0) [0|0] "" Vector__XXX
 SG_ VCFRONT_a178_abortCompLimited m178 : 24|1@1+ (1,0) [0|0] "" Vector__XXX
 SG_ VCFRONT_a180_bmsState m180 : 24|4@1+ (1,0) [0|0] "" Vector__XXX
 SG_ VCFRONT_a182_prechargeLVLoadReduction m182 : 24|1@1+ (1,0) [0|0] "" Vector__XXX
 SG_ VCFRONT_a183_prechargeLVLoadReduction m183 : 24|1@1+ (1,0) [0|0] "" Vector__XXX
 SG_ VCFRONT_a184_ptInlet m184 : 24|6@1+ (2,0) [0|0] "" Vector__XXX
 SG_ VCFRONT_a188_IBSCurrent m188 : 24|12@1- (0.02,0) [0|0] "" Vector__XXX
 SG_ VCFRONT_a191_vehicleLoadShedPostCrashActive m191 : 24|1@1+ (1,0) [0|0] "" Vector__XXX
 SG_ VCFRONT_a192_contactorEFuseStable m192 : 24|1@1+ (1,0) [0|0] "" Vector__XXX
 SG_ VCFRONT_a196_batterySMState m196 : 24|4@1+ (1,0) [0|0] "" Vector__XXX
 SG_ VCFRONT_a216_vcrightFastBlowImminent m216 : 24|1@1+ (1,0) [0|0] "" Vector__XXX
 SG_ VCFRONT_a242_IBSCurrent m242 : 24|12@1- (0.1,0) [0|0] "" Vector__XXX
 SG_ VCFRONT_a269_IBSCurrent m269 : 24|12@1- (0.1,0) [0|0] "" Vector__XXX
 SG_ VCFRONT_a275_breakLocationB m275 : 24|5@1+ (1,0) [0|0] "" Vector__XXX
 SG_ VCFRONT_a276_breakLocationB m276 : 24|5@1+ (1,0) [0|0] "" Vector__XXX
 SG_ VCFRONT_a283_thmlFanDemand m283 : 24|7@1+ (1,0) [0|0] "" Vector__XXX
 SG_ VCFRONT_a284_isCoilOpenX m284 : 24|1@1+ (1,0) [0|0] "" Vector__XXX
 SG_ VCFRONT_a285_isCoilOpenX m285 : 24|1@1+ (1,0) [0|0] "" Vector__XXX
 SG_ VCFRONT_a286_isCoilOpenX m286 : 24|1@1+ (1,0) [0|0] "" Vector__XXX
 SG_ VCFRONT_a287_isCoilOpenX m287 : 24|1@1+ (1,0) [0|0] "" Vector__XXX
 SG_ VCFRONT_a288_isCoilOpenX m288 : 24|1@1+ (1,0) [0|0] "" Vector__XXX
 SG_ VCFRONT_a289_isCoilOpenX m289 : 24|1@1+ (1,0) [0|0] "" Vector__XXX
 SG_ VCFRONT_a296_timeInDown2 m296 : 24|32@1+ (1,0) [0|0] "" Vector__XXX
 SG_ VCFRONT_a297_bmbDeviceFaultTempMask m297 : 24|8@1+ (1,0) [0|0] "" Vector__XXX
 SG_ VCFRONT_a304_temperature m304 : 24|8@1+ (0.5,-40) [0|0] "" Vector__XXX
 SG_ VCFRONT_a305_temperature m305 : 24|8@1+ (0.5,-40) [0|0] "" Vector__XXX
 SG_ VCFRONT_a306_temperature m306 : 24|8@1+ (0.5,-40) [0|0] "" Vector__XXX
 SG_ VCFRONT_a307_temperature m307 : 24|8@1+ (0.5,-40) [0|0] "" Vector__XXX
 SG_ VCFRONT_a308_temperature m308 : 24|8@1+ (0.5,-40) [0|0] "" Vector__XXX
 SG_ VCFRONT_a353_batteryVoltage m353 : 24|7@1+ (0.15,0) [0|0] "" Vector__XXX
 SG_ VCFRONT_a354_batteryVoltage m354 : 24|7@1+ (0.15,0) [0|0] "" Vector__XXX
 SG_ VCFRONT_a365_notInConditioning m365 : 24|1@1+ (1,0) [0|0] "" Vector__XXX
 SG_ VCFRONT_a366_heatPumpFlowRequest m366 : 24|1@1+ (1,0) [0|0] "" Vector__XXX
 SG_ VCFRONT_a368_bmsSoc m368 : 24|8@1+ (0.5,0) [0|0] "" Vector__XXX
 SG_ VCFRONT_a369_bmsSoc m369 : 24|8@1+ (0.5,0) [0|0] "" Vector__XXX
 SG_ VCFRONT_a372_bmbDeviceFaultBrickMask m372 : 24|16@1+ (1,0) [0|0] "" Vector__XXX
 SG_ VCFRONT_a378_wiperLINError m378 : 24|1@1+ (1,0) [0|0] "" Vector__XXX
 SG_ VCFRONT_a380_commLostError m380 : 24|3@1+ (1,0) [0|0] "" Vector__XXX
 SG_ VCFRONT_a381_commLostError m381 : 24|3@1+ (1,0) [0|0] "" Vector__XXX
 SG_ VCFRONT_a382_commLostError m382 : 24|3@1+ (1,0) [0|0] "" Vector__XXX
 SG_ VCFRONT_a383_commLostError m383 : 24|3@1+ (1,0) [0|0] "" Vector__XXX
 SG_ VCFRONT_a384_commLostError m384 : 24|3@1+ (1,0) [0|0] "" Vector__XXX
 SG_ VCFRONT_a385_commLostError m385 : 24|3@1+ (1,0) [0|0] "" Vector__XXX
 SG_ VCFRONT_a386_commLostError m386 : 24|3@1+ (1,0) [0|0] "" Vector__XXX
 SG_ VCFRONT_a390_dominantLoad m390 : 24|3@1+ (1,0) [0|0] "" Vector__XXX
 SG_ VCFRONT_a392_bmbDeviceFaultBrickMask m392 : 24|16@1+ (1,0) [0|0] "" Vector__XXX
 SG_ VCFRONT_a401_IBSCurrent m401 : 24|12@1- (0.1,0) [0|0] "" Vector__XXX
 SG_ VCFRONT_a402_batterySMState m402 : 24|4@1+ (1,0) [0|0] "" Vector__XXX
 SG_ VCFRONT_a405_intervalVoltage1 m405 : 24|8@1+ (0.02,9) [0|0] "" Vector__XXX
 SG_ VCFRONT_a406_pulseVoltage2 m406 : 24|8@1+ (0.02,9) [0|0] "" Vector__XXX
 SG_ VCFRONT_a407_dcr12VThreshold m407 : 24|4@1+ (1,0) [0|0] "" Vector__XXX
 SG_ VCFRONT_a410_IBSCurrent m410 : 24|12@1- (0.1,0) [0|0] "" Vector__XXX
 SG_ VCFRONT_a411_IBSCurrent m411 : 24|12@1- (0.1,0) [0|0] "" Vector__XXX
 SG_ VCFRONT_a412_pulseVoltage1Shifted m412 : 24|8@1+ (0.02,9) [0|0] "" Vector__XXX
 SG_ VCFRONT_a414_LVBatteryTemp m414 : 24|7@1+ (1,-40) [0|0] "" Vector__XXX
 SG_ VCFRONT_a428_minBrickCac m428 : 24|13@1+ (0.1,0) [0|0] "" Vector__XXX
 SG_ VCFRONT_a444_channel m444 : 24|8@1+ (1,0) [0|0] "" Vector__XXX
 SG_ VCFRONT_a445_expectedMSB m445 : 24|8@1+ (1,0) [0|0] "" Vector__XXX
 SG_ VCFRONT_a446_compStandbyCommunication m446 : 24|1@1+ (1,0) [0|0] "" Vector__XXX
 SG_ VCFRONT_a447_hvBatteryDischargingCompromised m447 : 24|1@1+ (1,0) [0|0] "" Vector__XXX
 SG_ VCFRONT_a462_DischrgOCLevel1 m462 : 24|1@1+ (1,0) [0|0] "" Vector__XXX
 SG_ VCFRONT_a464_flowIndexFiltered m464 : 24|8@1+ (1,0) [0|0] "" Vector__XXX
 SG_ VCFRONT_a465_flowIndexFiltered m465 : 24|8@1+ (1,0) [0|0] "" Vector__XXX
 SG_ VCFRONT_a466_flowIndexFiltered m466 : 24|8@1+ (1,0) [0|0] "" Vector__XXX
 SG_ VCFRONT_a469_pressureDischarge m469 : 24|8@1+ (0.2,0) [0|0] "" Vector__XXX
 SG_ VCFRONT_a470_pressureDischarge m470 : 24|8@1+ (0.2,0) [0|0] "" Vector__XXX
 SG_ VCFRONT_a474_ssl100Bank5Status m474 : 24|2@1+ (1,0) [0|0] "" Vector__XXX
 SG_ VCFRONT_a475_ssl100Bank5Status m475 : 24|2@1+ (1,0) [0|0] "" Vector__XXX
 SG_ VCFRONT_a476_FRM9_timedOut m476 : 24|1@1+ (1,0) [0|0] "" Vector__XXX
 SG_ VCFRONT_a478_batterySMState m478 : 24|4@1+ (1,0) [0|0] "" Vector__XXX
 SG_ VCFRONT_a479_frunkLatchStatus m479 : 24|4@1+ (1,0) [0|0] "" Vector__XXX
 SG_ VCFRONT_a480_overcurrent m480 : 24|1@1+ (1,0) [0|0] "" Vector__XXX
 SG_ VCFRONT_a481_timeout m481 : 24|1@1+ (1,0) [0|0] "" Vector__XXX
 SG_ VCFRONT_a483_headlampTemperature_C m483 : 24|8@1+ (0.5,-40) [0|0] "" Vector__XXX
 SG_ VCFRONT_a484_rearRideHeight m484 : 24|8@1- (1,0) [0|0] "" Vector__XXX
 SG_ VCFRONT_a488_headlampTemperature_C m488 : 24|8@1+ (0.5,-40) [0|0] "" Vector__XXX
 SG_ VCFRONT_a492_minBrickSoc m492 : 24|8@1+ (0.5,0) [0|0] "" Vector__XXX
 SG_ VCFRONT_a493_minBrickSocByOcvMax m493 : 24|8@1+ (0.5,0) [0|0] "" Vector__XXX
 SG_ VCFRONT_a495_serviceMode m495 : 24|1@1+ (1,0) [0|0] "" Vector__XXX
 SG_ VCFRONT_a496_bmsState m496 : 24|4@1+ (1,0) [0|0] "" Vector__XXX
 SG_ VCFRONT_a497_SOC m497 : 24|7@1+ (1,0) [0|0] "" Vector__XXX
 SG_ VCFRONT_a498_brickImpedanceNormalized m498 : 24|7@1+ (0.01,0.5) [0|0] "" Vector__XXX
 SG_ VCFRONT_a499_BMSFlowReq m499 : 24|1@1+ (1,0) [0|0] "" Vector__XXX
 SG_ VCFRONT_a500_mismatchedState m500 : 24|3@1+ (1,0) [0|0] "" Vector__XXX
 SG_ VCFRONT_a502_minBrickVDelta m502 : 24|15@1- (0.0005,0) [0|0] "" Vector__XXX
 SG_ VCFRONT_a507_headlampHealth m507 : 24|3@1+ (1,0) [0|0] "" Vector__XXX
 SG_ VCFRONT_a510_packVoltage m510 : 24|8@1+ (0.1,0) [0|0] "" Vector__XXX
 SG_ VCFRONT_a512_packVoltageIntervalMax m512 : 24|8@1+ (0.1,0) [0|0] "" Vector__XXX
 SG_ VCFRONT_a516_HVSoc m516 : 24|10@1+ (0.1,0) [0|0] "" Vector__XXX
 SG_ VCFRONT_a517_HVSoc m517 : 24|10@1+ (0.1,0) [0|0] "" Vector__XXX
 SG_ VCFRONT_a518_IBSVoltage m518 : 24|9@1+ (0.05,0) [0|0] "" Vector__XXX
 SG_ VCFRONT_a522_HVSoc m522 : 24|10@1+ (0.1,0) [0|0] "" Vector__XXX
 SG_ VCFRONT_a523_control2Byte1 m523 : 24|8@1+ (1,0) [0|0] "" Vector__XXX
 SG_ VCFRONT_a524_headlampHealth m524 : 24|3@1+ (1,0) [0|0] "" Vector__XXX
 SG_ VCFRONT_a525_initialLVBatteryType m525 : 24|3@1+ (1,0) [0|0] "" Vector__XXX
 SG_ VCFRONT_a529_rerunDisconnectedBattery m529 : 24|1@1+ (1,0) [0|0] "" Vector__XXX
 SG_ VCFRONT_a534_initialFlow m534 : 24|8@1+ (0.5,0) [0|0] "" Vector__XXX
 SG_ VCFRONT_a535_initialFlow m535 : 24|8@1+ (0.5,0) [0|0] "" Vector__XXX
 SG_ VCFRONT_a536_initialFlow m536 : 24|8@1+ (0.5,0) [0|0] "" Vector__XXX
 SG_ VCFRONT_a537_initialFlow m537 : 24|8@1+ (0.5,0) [0|0] "" Vector__XXX
 SG_ VCFRONT_a538_initialFlow m538 : 24|8@1+ (0.5,0) [0|0] "" Vector__XXX
 SG_ VCFRONT_a539_initialFlow m539 : 24|8@1+ (0.5,0) [0|0] "" Vector__XXX
 SG_ VCFRONT_a542_liquidPressure m542 : 24|6@1+ (0.5,0) [0|0] "" Vector__XXX
 SG_ VCFRONT_a545_frunkOpen m545 : 24|1@1+ (1,0) [0|0] "" Vector__XXX
 SG_ VCFRONT_a548_backstopBucketCount m548 : 24|5@1+ (0.035,0) [0|0] "" Vector__XXX
 SG_ VCFRONT_a552_epas3sSelfTestResult m552 : 24|4@1+ (1,0) [0|0] "" Vector__XXX
 SG_ VCFRONT_a556_disconnectedBatteryTestCurrent m556 : 24|12@1+ (0.004884004884004884,-10) [0|0] "" Vector__XXX
 SG_ VCFRONT_a559_PackCurrent m559 : 24|12@1+ (0.2,-600) [0|0] "" Vector__XXX
 SG_ VCFRONT_a565_rearPassengerDoorOpen m565 : 24|1@1+ (1,0) [0|0] "" Vector__XXX
 SG_ VCFRONT_a582_PCSCurrent m582 : 24|8@1+ (0.5,-127) [0|0] "" Vector__XXX
