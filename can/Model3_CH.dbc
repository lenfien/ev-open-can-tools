VERSION ""

NS_ :

BS_:

BU_: ETH

BO_ 1332 VCFRONT_alertLog: 8 Vector__XXX
 SG_ VCFRONT_alertID M : 0|10@1+ (1,0) [0|0] "" Vector__XXX
 SG_ VCFRONT_a372_bmbDeviceId m372 : 16|4@1+ (1,1) [0|0] "" Vector__XXX
 SG_ VCFRONT_a373_tempSuperheatActual m373 : 16|10@1+ (0.1,-20) [0|0] "" Vector__XXX
 SG_ VCFRONT_a374_lccInletSolenoidISense m374 : 16|8@1- (0.01,0) [0|0] "" Vector__XXX
 SG_ VCFRONT_a375_refVoltageScaleFactor m375 : 16|12@1+ (0.1,0) [0|0] "" Vector__XXX
 SG_ VCFRONT_a376_IBSCurrentSampleCount m376 : 16|16@1+ (1,0) [0|0] "" Vector__XXX
 SG_ VCFRONT_a377_wiperStuckOutOfPark m377 : 16|1@1+ (1,0) [0|0] "" Vector__XXX
 SG_ VCFRONT_a378_wiperBlocked m378 : 16|1@1+ (1,0) [0|0] "" Vector__XXX
 SG_ VCFRONT_a379_minVoltageReached m379 : 16|12@1+ (0.005443676098,0) [0|0] "" Vector__XXX
 SG_ VCFRONT_a380_driverState m380 : 16|4@1+ (1,0) [0|0] "" Vector__XXX
 SG_ VCFRONT_a381_driverState m381 : 16|4@1+ (1,0) [0|0] "" Vector__XXX
 SG_ VCFRONT_a382_driverState m382 : 16|4@1+ (1,0) [0|0] "" Vector__XXX
 SG_ VCFRONT_a383_driverState m383 : 16|4@1+ (1,0) [0|0] "" Vector__XXX
 SG_ VCFRONT_a384_driverState m384 : 16|4@1+ (1,0) [0|0] "" Vector__XXX
 SG_ VCFRONT_a385_driverState m385 : 16|4@1+ (1,0) [0|0] "" Vector__XXX
 SG_ VCFRONT_a386_driverState m386 : 16|4@1+ (1,0) [0|0] "" Vector__XXX
 SG_ VCFRONT_a387_shortedCellFaultCounter m387 : 16|3@1+ (1,0) [0|0] "" Vector__XXX
 SG_ VCFRONT_a388_shortedCellFaultCounter m388 : 16|3@1+ (1,0) [0|0] "" Vector__XXX
 SG_ VCFRONT_a389_closedAtSpeed m389 : 16|1@1+ (1,0) [0|0] "" Vector__XXX
 SG_ VCFRONT_a390_cabinLoadType m390 : 16|2@1+ (1,0) [0|0] "" Vector__XXX
 SG_ VCFRONT_a391_switchMismatch m391 : 16|1@1+ (1,0) [0|0] "" Vector__XXX
 SG_ VCFRONT_a392_bmbDeviceId m392 : 16|4@1+ (1,1) [0|0] "" Vector__XXX
 SG_ VCFRONT_a394_discharge m394 : 16|1@1+ (1,0) [0|0] "" Vector__XXX
 SG_ VCFRONT_a397_discharge m397 : 16|1@1+ (1,0) [0|0] "" Vector__XXX
 SG_ VCFRONT_a400_VrefSample m400 : 16|16@1+ (0.0001,0) [0|0] "" Vector__XXX
 SG_ VCFRONT_a401_LVBatteryTemp m401 : 16|7@1+ (1,-40) [0|0] "" Vector__XXX
 SG_ VCFRONT_a402_LVBatteryTemp m402 : 16|7@1+ (1,-40) [0|0] "" Vector__XXX
 SG_ VCFRONT_a403_IBSCurrent m403 : 16|15@1- (0.005,0) [0|0] "" Vector__XXX
 SG_ VCFRONT_a404_minVoltageReached m404 : 16|12@1+ (0.005443676098,0) [0|0] "" Vector__XXX
 SG_ VCFRONT_a405_dcrMilliOhms m405 : 16|8@1+ (0.2,0) [0|0] "" Vector__XXX
 SG_ VCFRONT_a406_pulseVoltage1 m406 : 16|8@1+ (0.02,9) [0|0] "" Vector__XXX
 SG_ VCFRONT_a407_dcrMilliOhms m407 : 16|8@1+ (0.2,0) [0|0] "" Vector__XXX
 SG_ VCFRONT_a408_IBSCurrent m408 : 16|16@1- (0.005,0) [0|0] "" Vector__XXX
 SG_ VCFRONT_a409_brushlessMotorConfigurationInvalid m409 : 16|1@1+ (1,0) [0|0] "" Vector__XXX
 SG_ VCFRONT_a410_LVBatteryTemp m410 : 16|7@1+ (1,-40) [0|0] "" Vector__XXX
 SG_ VCFRONT_a411_LVBatteryTemp m411 : 16|7@1+ (1,-40) [0|0] "" Vector__XXX
 SG_ VCFRONT_a412_dcrMilliOhmsShifted m412 : 16|8@1+ (0.2,0) [0|0] "" Vector__XXX
 SG_ VCFRONT_a413_VrefSample m413 : 16|16@1+ (0.0001,0) [0|0] "" Vector__XXX
 SG_ VCFRONT_a414_dcrMilliOhms m414 : 16|6@1+ (1,0) [0|0] "" Vector__XXX
 SG_ VCFRONT_a415_dcrMilliOhms m415 : 16|6@1+ (1,0) [0|0] "" Vector__XXX
 SG_ VCFRONT_a416_brickVoltageMin m416 : 16|10@1+ (0.005,0) [0|0] "" Vector__XXX
 SG_ VCFRONT_a417_brickVoltageMin m417 : 16|10@1+ (0.005,0) [0|0] "" Vector__XXX
 SG_ VCFRONT_a418_brickVoltageMin m418 : 16|10@1+ (0.005,0) [0|0] "" Vector__XXX
 SG_ VCFRONT_a419_brickVoltageMin m419 : 16|10@1+ (0.005,0) [0|0] "" Vector__XXX
 SG_ VCFRONT_a420_partyTimeS m420 : 16|10@1+ (1,0) [0|0] "" Vector__XXX
 SG_ VCFRONT_a421_inFactoryMode m421 : 16|1@1+ (1,0) [0|0] "" Vector__XXX
 SG_ VCFRONT_a423_brickVoltageMin m423 : 16|10@1+ (0.005,0) [0|0] "" Vector__XXX
 SG_ VCFRONT_a424_brickVoltageMin m424 : 16|10@1+ (0.005,0) [0|0] "" Vector__XXX
 SG_ VCFRONT_a425_busVoltage m425 : 16|16@1+ (0.002,0) [0|0] "" Vector__XXX
 SG_ VCFRONT_a426_busVoltage m426 : 16|16@1+ (0.002,0) [0|0] "" Vector__XXX
 SG_ VCFRONT_a427_initialSoc m427 : 16|9@1+ (0.2,0) [0|0] "" Vector__XXX
 SG_ VCFRONT_a428_minBrickCacId m428 : 16|7@1+ (1,1) [0|0] "" Vector__XXX
 SG_ VCFRONT_a429_sohTestEndMode m429 : 16|4@1+ (1,0) [0|0] "" Vector__XXX
 SG_ VCFRONT_a430_netPackCurrent m430 : 16|16@1- (0.1,0) [0|0] "" Vector__XXX
 SG_ VCFRONT_a431_netPackCurrent m431 : 16|16@1- (0.1,0) [0|0] "" Vector__XXX
 SG_ VCFRONT_a432_targetCurrent m432 : 16|16@1- (0.1,0) [0|0] "" Vector__XXX
 SG_ VCFRONT_a433_bmbModuleId m433 : 16|16@1+ (1,0) [0|0] "" Vector__XXX
 SG_ VCFRONT_a434_bmbModuleId m434 : 16|16@1+ (1,0) [0|0] "" Vector__XXX
 SG_ VCFRONT_a435_netPackCurrent m435 : 16|16@1- (0.1,0) [0|0] "" Vector__XXX
 SG_ VCFRONT_a436_netPackCurrent m436 : 16|16@1- (0.1,0) [0|0] "" Vector__XXX
 SG_ VCFRONT_a437_nvmDataMissingA m437 : 16|1@1+ (1,0) [0|0] "" Vector__XXX
 SG_ VCFRONT_a438_temperature m438 : 16|16@1+ (0.01,0) [0|0] "" Vector__XXX
 SG_ VCFRONT_a439_temperature m439 : 16|16@1+ (0.01,0) [0|0] "" Vector__XXX
 SG_ VCFRONT_a441_bmbModuleId m441 : 16|16@1+ (1,0) [0|0] "" Vector__XXX
 SG_ VCFRONT_a442_maxSocChange m442 : 16|11@1- (0.1,0) [0|0] "" Vector__XXX
 SG_ VCFRONT_a443_bmbDeviceId m443 : 16|4@1+ (1,1) [0|0] "" Vector__XXX
 SG_ VCFRONT_a444_retriesAvailable m444 : 16|8@1+ (1,0) [0|0] "" Vector__XXX
 SG_ VCFRONT_a445_checksFailedCount m445 : 16|2@1+ (1,0) [0|0] "" Vector__XXX
 SG_ VCFRONT_a446_compFaultRefrigerant m446 : 16|1@1+ (1,0) [0|0] "" Vector__XXX
 SG_ VCFRONT_a447_caseHVACUnavailable m447 : 16|1@1+ (1,0) [0|0] "" Vector__XXX
 SG_ VCFRONT_a448_bootpCount m448 : 16|8@1+ (1,0) [0|0] "" Vector__XXX
 SG_ VCFRONT_a459_coolantFillActive m459 : 16|1@1+ (1,0) [0|0] "" Vector__XXX
 SG_ VCFRONT_a461_socByAhRaw m461 : 16|11@1+ (0.1,0) [0|0] "" Vector__XXX
 SG_ VCFRONT_a462_CellOVLevel1 m462 : 16|1@1+ (1,0) [0|0] "" Vector__XXX
 SG_ VCFRONT_a463_switchMismatch m463 : 16|1@1+ (1,0) [0|0] "" Vector__XXX
 SG_ VCFRONT_a464_flowIndex m464 : 16|8@1+ (1,0) [0|0] "" Vector__XXX
 SG_ VCFRONT_a465_flowIndex m465 : 16|8@1+ (1,0) [0|0] "" Vector__XXX
 SG_ VCFRONT_a466_flowIndex m466 : 16|8@1+ (1,0) [0|0] "" Vector__XXX
 SG_ VCFRONT_a467_powerIndexFiltered m467 : 16|7@1+ (1,0) [0|0] "" Vector__XXX
 SG_ VCFRONT_a468_powerIndexFiltered m468 : 16|7@1+ (1,0) [0|0] "" Vector__XXX
 SG_ VCFRONT_a469_pressureDischargeEstimated m469 : 16|8@1+ (0.2,0) [0|0] "" Vector__XXX
 SG_ VCFRONT_a470_pressureLiquid m470 : 16|8@1+ (0.2,0) [0|0] "" Vector__XXX
 SG_ VCFRONT_a472_range m472 : 16|10@1+ (1,0) [0|0] "" Vector__XXX
 SG_ VCFRONT_a473_range m473 : 16|10@1+ (1,0) [0|0] "" Vector__XXX
 SG_ VCFRONT_a474_ssl100Bank1Status m474 : 16|2@1+ (1,0) [0|0] "" Vector__XXX
 SG_ VCFRONT_a475_ssl100Bank1Status m475 : 16|2@1+ (1,0) [0|0] "" Vector__XXX
 SG_ VCFRONT_a476_FRM1_timedOut m476 : 16|1@1+ (1,0) [0|0] "" Vector__XXX
 SG_ VCFRONT_a477_cell1Voltage m477 : 16|9@1+ (0.01,0) [0|0] "" Vector__XXX
 SG_ VCFRONT_a478_battFaultPackOverVoltage m478 : 16|1@1+ (1,0) [0|0] "" Vector__XXX
 SG_ VCFRONT_a479_FRM3_timedOut m479 : 16|1@1+ (1,0) [0|0] "" Vector__XXX
 SG_ VCFRONT_a480_channel m480 : 16|3@1+ (1,0) [0|0] "" Vector__XXX
 SG_ VCFRONT_a481_channel m481 : 16|8@1+ (1,0) [0|0] "" Vector__XXX
 SG_ VCFRONT_a482_migrationState m482 : 16|2@1+ (1,0) [0|0] "" Vector__XXX
 SG_ VCFRONT_a483_NCV70501Fault m483 : 16|3@1+ (1,0) [0|0] "" Vector__XXX
 SG_ VCFRONT_a484_frontRideHeight m484 : 16|8@1- (1,0) [0|0] "" Vector__XXX
 SG_ VCFRONT_a485_migrationState m485 : 16|2@1+ (1,0) [0|0] "" Vector__XXX
 SG_ VCFRONT_a486_mcuGraphicsEFuseCurrent m486 : 16|10@1+ (0.1,0) [0|0] "" Vector__XXX
 SG_ VCFRONT_a487_lastPosition m487 : 16|10@1+ (1,0) [0|0] "" Vector__XXX
 SG_ VCFRONT_a488_NCV70501Fault m488 : 16|3@1+ (1,0) [0|0] "" Vector__XXX
 SG_ VCFRONT_a489_ChillerEXV m489 : 16|1@1+ (1,0) [0|0] "" Vector__XXX
 SG_ VCFRONT_a490_coolantPumpType m490 : 16|3@1+ (1,0) [0|0] "" Vector__XXX
 SG_ VCFRONT_a491_lastPosition m491 : 16|10@1+ (1,0) [0|0] "" Vector__XXX
 SG_ VCFRONT_a492_minBrickSocId m492 : 16|7@1+ (1,1) [0|0] "" Vector__XXX
 SG_ VCFRONT_a493_minBrickSocId m493 : 16|7@1+ (1,1) [0|0] "" Vector__XXX
 SG_ VCFRONT_a495_SoCUnrecoverable m495 : 16|1@1+ (1,0) [0|0] "" Vector__XXX
 SG_ VCFRONT_a496_reverseBatteryEFuseFault m496 : 16|1@1+ (1,0) [0|0] "" Vector__XXX
 SG_ VCFRONT_a497_serviceMode m497 : 16|1@1+ (1,0) [0|0] "" Vector__XXX
 SG_ VCFRONT_a498_packTemp m498 : 16|8@1+ (0.5,-20) [0|0] "" Vector__XXX
 SG_ VCFRONT_a499_maxHVBMSCellTemp m499 : 16|8@1+ (1,0) [0|0] "" Vector__XXX
 SG_ VCFRONT_a500_channel m500 : 16|8@1+ (1,0) [0|0] "" Vector__XXX
 SG_ VCFRONT_a501_channel m501 : 16|8@1+ (1,0) [0|0] "" Vector__XXX
 SG_ VCFRONT_a502_worstBrickId m502 : 16|7@1+ (1,1) [0|0] "" Vector__XXX
 SG_ VCFRONT_a503_brickVoltageMin m503 : 16|10@1+ (0.005,0) [0|0] "" Vector__XXX
 SG_ VCFRONT_a505_voltageInmV m505 : 16|16@1+ (1,0) [0|0] "" Vector__XXX
 SG_ VCFRONT_a506_superManifoldType m506 : 16|2@1+ (1,0) [0|0] "" Vector__XXX
 SG_ VCFRONT_a507_headlampAimRequestSource m507 : 16|2@1+ (1,0) [0|0] "" Vector__XXX
 SG_ VCFRONT_a508_brickImpedance m508 : 16|14@1+ (2.5e-05,0) [0|0] "" Vector__XXX
 SG_ VCFRONT_a509_vcrightEFuseCurrent m509 : 16|16@1- (0.1,0) [0|0] "" Vector__XXX
 SG_ VCFRONT_a510_sumCellVoltage m510 : 16|8@1+ (0.1,0) [0|0] "" Vector__XXX
 SG_ VCFRONT_a511_PCSEFuseCurrent m511 : 16|16@1- (0.1,0) [0|0] "" Vector__XXX
 SG_ VCFRONT_a512_packVoltageIntervalMin m512 : 16|8@1+ (0.1,0) [0|0] "" Vector__XXX
 SG_ VCFRONT_a513_packCurrent m513 : 16|12@1+ (0.2,-600) [0|0] "" Vector__XXX
 SG_ VCFRONT_a514_cell1Voltage m514 : 16|7@1+ (0.08,0) [0|0] "" Vector__XXX
 SG_ VCFRONT_a515_cell1Voltage m515 : 16|7@1+ (0.08,0) [0|0] "" Vector__XXX
 SG_ VCFRONT_a516_IBSVoltage m516 : 16|8@1+ (0.1,0) [0|0] "" Vector__XXX
 SG_ VCFRONT_a517_IBSVoltage m517 : 16|8@1+ (0.1,0) [0|0] "" Vector__XXX
 SG_ VCFRONT_a518_packVoltage m518 : 16|8@1+ (0.1,0) [0|0] "" Vector__XXX
 SG_ VCFRONT_a521_vcleftEFuseCurrent m521 : 16|16@1- (0.1,0) [0|0] "" Vector__XXX
 SG_ VCFRONT_a522_IBSVoltage m522 : 16|8@1+ (0.1,0) [0|0] "" Vector__XXX
 SG_ VCFRONT_a523_channel m523 : 16|8@1+ (1,0) [0|0] "" Vector__XXX
 SG_ VCFRONT_a524_headlampAimRequestSource m524 : 16|2@1+ (1,0) [0|0] "" Vector__XXX
 SG_ VCFRONT_a525_GTW_twelveVBatteryType m525 : 16|3@1+ (1,0) [0|0] "" Vector__XXX
 SG_ VCFRONT_a527_cell1Voltage m527 : 16|10@1+ (0.01,0) [0|0] "" Vector__XXX
 SG_ VCFRONT_a528_ECPAStateSNA m528 : 16|1@1+ (1,0) [0|0] "" Vector__XXX
 SG_ VCFRONT_a529_sumCellVoltage m529 : 16|8@1+ (0.1,0) [0|0] "" Vector__XXX
 SG_ VCFRONT_a530_PCSCurrent m530 : 16|16@1- (0.1,0) [0|0] "" Vector__XXX
 SG_ VCFRONT_a531_powerIndexFiltered m531 : 16|7@1+ (1,0) [0|0] "" Vector__XXX
 SG_ VCFRONT_a532_eFuseFault m532 : 16|1@1+ (1,0) [0|0] "" Vector__XXX
 SG_ VCFRONT_a533_temperature m533 : 16|16@1+ (0.01,0) [0|0] "" Vector__XXX
 SG_ VCFRONT_a534_calibrationOffset m534 : 16|8@1- (4,0) [0|0] "" Vector__XXX
 SG_ VCFRONT_a535_calibrationOffset m535 : 16|8@1- (4,0) [0|0] "" Vector__XXX
 SG_ VCFRONT_a536_calibrationOffset m536 : 16|8@1- (4,0) [0|0] "" Vector__XXX
 SG_ VCFRONT_a537_calibrationOffset m537 : 16|8@1- (4,0) [0|0] "" Vector__XXX
 SG_ VCFRONT_a538_calibrationOffset m538 : 16|8@1- (4,0) [0|0] "" Vector__XXX
 SG_ VCFRONT_a539_calibrationOffset m539 : 16|8@1- (4,0) [0|0] "" Vector__XXX
 SG_ VCFRONT_a541_PackTemperature m541 : 16|9@1+ (0.5,-50) [0|0] "" Vector__XXX
 SG_ VCFRONT_a542_dischargePressure m542 : 16|6@1+ (0.5,0) [0|0] "" Vector__XXX
 SG_ VCFRONT_a544_serviceMode m544 : 16|1@1+ (1,0) [0|0] "" Vector__XXX
 SG_ VCFRONT_a545_GTW_twelveVBatteryType m545 : 16|3@1+ (1,0) [0|0] "" Vector__XXX
 SG_ VCFRONT_a547_serviceMode m547 : 16|1@1+ (1,0) [0|0] "" Vector__XXX
 SG_ VCFRONT_a548_vehiclePowerState m548 : 16|2@1+ (1,0) [0|0] "" Vector__XXX
 SG_ VCFRONT_a551_headlampCurrent m551 : 16|8@1+ (0.1,0) [0|0] "" Vector__XXX
 SG_ VCFRONT_a552_vcrightSelfTestResult m552 : 16|4@1+ (1,0) [0|0] "" Vector__XXX
 SG_ VCFRONT_a553_headlampCurrent m553 : 16|8@1+ (0.1,0) [0|0] "" Vector__XXX
 SG_ VCFRONT_a555_cell1Voltage m555 : 16|10@1+ (0.01,0) [0|0] "" Vector__XXX
 SG_ VCFRONT_a556_factoryMode m556 : 16|1@1+ (1,0) [0|0] "" Vector__XXX
 SG_ VCFRONT_a558_aimedVerticalPosition m558 : 16|10@1+ (1,0) [0|0] "" Vector__XXX
 SG_ VCFRONT_a559_SOC m559 : 16|7@1+ (1,0) [0|0] "" Vector__XXX
 SG_ VCFRONT_a560_highSHCOP1 m560 : 16|1@1+ (1,0) [0|0] "" Vector__XXX
 SG_ VCFRONT_a561_efuseTemperature m561 : 16|5@1+ (4,0) [0|0] "" Vector__XXX
 SG_ VCFRONT_a562_efuseTemperature m562 : 16|5@1+ (4,0) [0|0] "" Vector__XXX
 SG_ VCFRONT_a564_aimedVerticalPosition m564 : 16|10@1+ (1,0) [0|0] "" Vector__XXX
 SG_ VCFRONT_a565_userPresenceState m565 : 16|2@1+ (1,0) [0|0] "" Vector__XXX
 SG_ VCFRONT_a572_hvacCompressorCurrent m572 : 16|16@1+ (0.1,0) [0|0] "" Vector__XXX
 SG_ VCFRONT_a573_radarCurrent m573 : 16|16@1+ (0.1,0) [0|0] "" Vector__XXX
 SG_ VCFRONT_a574_frontDriveInverterCurrent m574 : 16|16@1+ (0.1,0) [0|0] "" Vector__XXX
 SG_ VCFRONT_a575_frontOilPumpCurrent m575 : 16|16@1+ (0.1,0) [0|0] "" Vector__XXX
 SG_ VCFRONT_a576_mcuLogicCurrent m576 : 16|16@1+ (0.1,0) [0|0] "" Vector__XXX
 SG_ VCFRONT_a577_tasCurrent m577 : 16|16@1+ (0.1,0) [0|0] "" Vector__XXX
 SG_ VCFRONT_a578_vbatFusedLowCurrentFeedCurrent m578 : 16|16@1+ (0.1,0) [0|0] "" Vector__XXX
 SG_ VCFRONT_a579_leftHeadlightCurrent m579 : 16|16@1+ (0.1,0) [0|0] "" Vector__XXX
 SG_ VCFRONT_a580_rightHeadlightCurrent m580 : 16|16@1+ (0.1,0) [0|0] "" Vector__XXX
 SG_ VCFRONT_a581_windshieldWiperCurrent m581 : 16|16@1+ (0.1,0) [0|0] "" Vector__XXX
 SG_ VCFRONT_a582_batterySMState m582 : 16|4@1+ (1,0) [0|0] "" Vector__XXX
 SG_ VCFRONT_a583_shadowSwitchGroupState m583 : 16|2@1+ (1,0) [0|0] "" Vector__XXX
 SG_ VCFRONT_a584_frunkSwitchGroupStateCurrent m584 : 16|2@1+ (1,0) [0|0] "" Vector__XXX
 SG_ VCFRONT_a585_leftHeadlampInternalErrorMask m585 : 16|20@1+ (1,0) [0|0] "" Vector__XXX
 SG_ VCFRONT_a587_factoryMode m587 : 16|1@1+ (1,0) [0|0] "" Vector__XXX
 SG_ VCFRONT_a588_vcleftEFuseCurveType m588 : 16|1@1+ (1,0) [0|0] "" Vector__XXX
 SG_ VCFRONT_a589_vcleftEFuseFastBlowType m589 : 16|1@1+ (1,0) [0|0] "" Vector__XXX
 SG_ VCFRONT_a590_vcrightEFuseCurveType m590 : 16|1@1+ (1,0) [0|0] "" Vector__XXX
 SG_ VCFRONT_a591_vcrightEFuseFastBlowType m591 : 16|1@1+ (1,0) [0|0] "" Vector__XXX
 SG_ VCFRONT_a592_vcleftCutoffEFuseCurveType m592 : 16|1@1+ (1,0) [0|0] "" Vector__XXX
 SG_ VCFRONT_a593_vcleftCutoffEFuseFastBlowType m593 : 16|1@1+ (1,0) [0|0] "" Vector__XXX
 SG_ VCFRONT_a594_maxOffsetFusionSession m594 : 16|8@1- (0.001,0) [0|0] "" Vector__XXX
 SG_ VCFRONT_a595_factoryMode m595 : 16|1@1+ (1,0) [0|0] "" Vector__XXX
 SG_ VCFRONT_a596_vcrightCutoffEFuseCurveType m596 : 16|1@1+ (1,0) [0|0] "" Vector__XXX
 SG_ VCFRONT_a597_vcrightCutoffEFuseFastBlowType m597 : 16|1@1+ (1,0) [0|0] "" Vector__XXX
 SG_ VCFRONT_a598_vcleftSelfTestResult m598 : 16|4@1+ (1,0) [0|0] "" Vector__XXX
 SG_ VCFRONT_a599_GTW_twelveVBatteryType m599 : 16|3@1+ (1,0) [0|0] "" Vector__XXX
 SG_ VCFRONT_a600_factoryMode m600 : 16|1@1+ (1,0) [0|0] "" Vector__XXX
 SG_ VCFRONT_a601_firstPurgeRequestTimestamp m601 : 16|32@1+ (1,0) [0|0] "" Vector__XXX
 SG_ VCFRONT_a605_vbatProtVoltage m605 : 16|10@1+ (0.1,0) [0|0] "" Vector__XXX
 SG_ VCFRONT_a606_expectedQChillerVeryHigh m606 : 16|1@1+ (1,0) [0|0] "" Vector__XXX
 SG_ VCFRONT_a607_avgSleepBypassCurrent m607 : 16|10@1+ (0.01,0) [0|0] "" Vector__XXX
 SG_ VCFRONT_a608_deltaV m608 : 16|16@1+ (0.0001,0) [0|0] "" Vector__XXX
 SG_ VCFRONT_a609_driverPresent m609 : 16|1@1+ (1,0) [0|0] "" Vector__XXX
 SG_ VCFRONT_a610_switch1State m610 : 16|2@1+ (1,0) [0|0] "" Vector__XXX
 SG_ VCFRONT_a611_isCoolantModeSeries m611 : 16|1@1+ (1,0) [0|0] "" Vector__XXX
 SG_ VCFRONT_a612_DI_gear m612 : 16|3@1+ (1,0) [0|0] "" Vector__XXX
 SG_ VCFRONT_a614_finalState m614 : 16|3@1+ (1,0) [0|0] "" Vector__XXX
 SG_ VCFRONT_a615_heaterCurrent m615 : 16|9@1- (0.25,0) [0|0] "" Vector__XXX
 SG_ VCFRONT_a618_ambientTemp m618 : 16|6@1+ (1,0) [0|0] "" Vector__XXX
 SG_ VCFRONT_a619_switch1State m619 : 16|2@1+ (1,0) [0|0] "" Vector__XXX
 SG_ VCFRONT_a623_DI_gear m623 : 16|3@1+ (1,0) [0|0] "" Vector__XXX
 SG_ VCFRONT_a626_dcrMilliOhms m626 : 16|8@1+ (0.2,0) [0|0] "" Vector__XXX
 SG_ VCFRONT_a627_cell1Voltage m627 : 16|9@1+ (0.01,0) [0|0] "" Vector__XXX
 SG_ VCFRONT_a628_thermistorId m628 : 16|3@1+ (1,1) [0|0] "" Vector__XXX
 SG_ VCFRONT_a630_faultBitfield m630 : 16|32@1+ (1,0) [0|0] "" Vector__XXX
 SG_ VCFRONT_a631_faultBitfield m631 : 16|32@1+ (1,0) [0|0] "" Vector__XXX
 SG_ VCFRONT_a634_ajar1OpeningDeltaV m634 : 16|10@1- (0.01,0) [0|0] "" Vector__XXX
 SG_ VCFRONT_a635_sleepRequest m635 : 16|1@1+ (1,0) [0|0] "" Vector__XXX
 SG_ VCFRONT_a643_inFactoryMode m643 : 16|1@1+ (1,0) [0|0] "" Vector__XXX
 SG_ VCFRONT_a644_washPumpChannel m644 : 16|4@1+ (1,0) [0|0] "" Vector__XXX
 SG_ VCFRONT_a645_washPumpChannel m645 : 16|4@1+ (1,0) [0|0] "" Vector__XXX
 SG_ VCFRONT_a646_washPumpChannel m646 : 16|4@1+ (1,0) [0|0] "" Vector__XXX
 SG_ VCFRONT_a649_vehicleLoadShedding m649 : 16|1@1+ (1,0) [0|0] "" Vector__XXX
 SG_ VCFRONT_a661_headlampCurrentFiltered m661 : 16|10@1+ (0.027,0) [0|0] "" Vector__XXX
 SG_ VCFRONT_a662_headlampCurrentFiltered m662 : 16|10@1+ (0.027,0) [0|0] "" Vector__XXX
 SG_ VCFRONT_a663_hcmlUartDmaQueueHighWaterMarkPercent m663 : 16|5@1+ (3.225806451612903,0) [0|0] "" Vector__XXX
 SG_ VCFRONT_a664_hcmrUartDmaQueueHighWaterMarkPercent m664 : 16|5@1+ (3.225806451612903,0) [0|0] "" Vector__XXX
 SG_ VCFRONT_a665_retryChannel m665 : 16|4@1+ (1,0) [0|0] "" Vector__XXX
 SG_ VCFRONT_a666_retryChannel m666 : 16|4@1+ (1,0) [0|0] "" Vector__XXX
 SG_ VCFRONT_a667_hcmRegionAndSide m667 : 16|3@1+ (1,0) [0|0] "" Vector__XXX
 SG_ VCFRONT_a668_hcmRegionAndSide m668 : 16|3@1+ (1,0) [0|0] "" Vector__XXX
 SG_ VCFRONT_a669_isEnforced m669 : 16|1@1+ (1,0) [0|0] "" Vector__XXX
 SG_ VCFRONT_a697_isGlobalHeadlamps m697 : 16|1@1+ (1,0) [0|0] "" Vector__XXX
 SG_ VCFRONT_a698_isGlobalHeadlamps m698 : 16|1@1+ (1,0) [0|0] "" Vector__XXX
 SG_ VCFRONT_a002_PowerOnReset m2 : 17|1@1+ (1,0) [0|0] "" Vector__XXX
 SG_ VCFRONT_a004_DASHighLowBeamDecisionSNA m4 : 17|1@1+ (1,0) [0|0] "" Vector__XXX
 SG_ VCFRONT_a008_DASHighLowBeamDecisionSNA m8 : 17|1@1+ (1,0) [0|0] "" Vector__XXX
 SG_ VCFRONT_a010_UnderVoltageTimeout m10 : 17|1@1+ (1,0) [0|0] "" Vector__XXX
 SG_ VCFRONT_a012_FlashError m12 : 17|1@1+ (1,0) [0|0] "" Vector__XXX
 SG_ VCFRONT_a013_ClearQueueFull m13 : 17|1@1+ (1,0) [0|0] "" Vector__XXX
 SG_ VCFRONT_a015_NVMMFilesystemError m15 : 17|1@1+ (1,0) [0|0] "" Vector__XXX
 SG_ VCFRONT_a021_Task1msStarved m21 : 17|1@1+ (1,0) [0|0] "" Vector__XXX
 SG_ VCFRONT_a047_ActFault m47 : 17|1@1+ (1,0) [0|0] "" Vector__XXX
 SG_ VCFRONT_a060_resetUnlocked m60 : 17|1@1+ (1,0) [0|0] "" Vector__XXX
 SG_ VCFRONT_a082_RIPC_remoteHSD m82 : 17|1@1+ (1,0) [0|0] "" Vector__XXX
 SG_ VCFRONT_a083_LIPC_remoteHSD m83 : 17|1@1+ (1,0) [0|0] "" Vector__XXX
 SG_ VCFRONT_a086_VEH_LVBMS_statusLow m86 : 17|1@1+ (1,0) [0|0] "" Vector__XXX
 SG_ VCFRONT_a087_VEH_thermalControl m87 : 17|1@1+ (1,0) [0|0] "" Vector__XXX
 SG_ VCFRONT_a088_VEH_thermalControl m88 : 17|1@1+ (1,0) [0|0] "" Vector__XXX
 SG_ VCFRONT_a089_PARTY_status m89 : 17|1@1+ (1,0) [0|0] "" Vector__XXX
 SG_ VCFRONT_a090_VEH_state m90 : 17|1@1+ (1,0) [0|0] "" Vector__XXX
 SG_ VCFRONT_a091_VEH_info m91 : 17|1@1+ (1,0) [0|0] "" Vector__XXX
 SG_ VCFRONT_a092_VEH_switchStatus m92 : 17|1@1+ (1,0) [0|0] "" Vector__XXX
 SG_ VCFRONT_a093_VEH_switchStatus m93 : 17|1@1+ (1,0) [0|0] "" Vector__XXX
 SG_ VCFRONT_a094_PARTY_sysStatus m94 : 17|1@1+ (1,0) [0|0] "" Vector__XXX
 SG_ VCFRONT_a095_PT_status m95 : 17|1@1+ (1,0) [0|0] "" Vector__XXX
 SG_ VCFRONT_a096_CH_status m96 : 17|1@1+ (1,0) [0|0] "" Vector__XXX
 SG_ VCFRONT_a097_VEH_state m97 : 17|1@1+ (1,0) [0|0] "" Vector__XXX
 SG_ VCFRONT_a098_VEH_hvStatus m98 : 17|1@1+ (1,0) [0|0] "" Vector__XXX
 SG_ VCFRONT_a100_PARTY m100 : 17|1@1+ (1,0) [0|0] "" Vector__XXX
 SG_ VCFRONT_a101_PARTY_locState m101 : 17|1@1+ (1,0) [0|0] "" Vector__XXX
 SG_ VCFRONT_a102_VEH_feedbackStatus m102 : 17|1@1+ (1,0) [0|0] "" Vector__XXX
 SG_ VCFRONT_a103_VEH_vehNm m103 : 17|1@1+ (1,0) [0|0] "" Vector__XXX
 SG_ VCFRONT_a104_VEH_chNm m104 : 17|1@1+ (1,0) [0|0] "" Vector__XXX
 SG_ VCFRONT_a105_VEH_chNm m105 : 17|1@1+ (1,0) [0|0] "" Vector__XXX
 SG_ VCFRONT_a106_VEH_thermalControl m106 : 17|1@1+ (1,0) [0|0] "" Vector__XXX
 SG_ VCFRONT_a107_VEH_vehNm m107 : 17|1@1+ (1,0) [0|0] "" Vector__XXX
 SG_ VCFRONT_a108_VEH_temperature m108 : 17|1@1+ (1,0) [0|0] "" Vector__XXX
 SG_ VCFRONT_a109_PARTY_inertial2 m109 : 17|1@1+ (1,0) [0|0] "" Vector__XXX
 SG_ VCFRONT_a110_VEH_carState m110 : 17|1@1+ (1,0) [0|0] "" Vector__XXX
 SG_ VCFRONT_a111_VEH_status m111 : 17|1@1+ (1,0) [0|0] "" Vector__XXX
 SG_ VCFRONT_a112_VEH_status m112 : 17|1@1+ (1,0) [0|0] "" Vector__XXX
 SG_ VCFRONT_a113_VEH_hvacRequest m113 : 17|1@1+ (1,0) [0|0] "" Vector__XXX
 SG_ VCFRONT_a114_PARTY_wheelSpeeds m114 : 17|1@1+ (1,0) [0|0] "" Vector__XXX
 SG_ VCFRONT_a115_VEH_authentication m115 : 17|1@1+ (1,0) [0|0] "" Vector__XXX
 SG_ VCFRONT_a116_VEH_vehNm m116 : 17|1@1+ (1,0) [0|0] "" Vector__XXX
 SG_ VCFRONT_a117_BDY_restraintStatus m117 : 17|1@1+ (1,0) [0|0] "" Vector__XXX
 SG_ VCFRONT_a118_VEH_lighting m118 : 17|1@1+ (1,0) [0|0] "" Vector__XXX
 SG_ VCFRONT_a119_VEH_leftStalk m119 : 17|1@1+ (1,0) [0|0] "" Vector__XXX
 SG_ VCFRONT_a120_VEH_systemStatus m120 : 17|1@1+ (1,0) [0|0] "" Vector__XXX
 SG_ VCFRONT_a121_fetShortCircuit m121 : 17|1@1+ (1,0) [0|0] "" Vector__XXX
 SG_ VCFRONT_a122_junctionOverTemp m122 : 17|1@1+ (1,0) [0|0] "" Vector__XXX
 SG_ VCFRONT_a123_fetShortCircuit m123 : 17|1@1+ (1,0) [0|0] "" Vector__XXX
 SG_ VCFRONT_a124_junctionOverTemp m124 : 17|1@1+ (1,0) [0|0] "" Vector__XXX
 SG_ VCFRONT_a125_fetShortCircuit m125 : 17|1@1+ (1,0) [0|0] "" Vector__XXX
 SG_ VCFRONT_a126_junctionOverTemp m126 : 17|1@1+ (1,0) [0|0] "" Vector__XXX
 SG_ VCFRONT_a136_snsDisconnect m136 : 17|1@1+ (1,0) [0|0] "" Vector__XXX
 SG_ VCFRONT_a137_snsDisconnect m137 : 17|1@1+ (1,0) [0|0] "" Vector__XXX
 SG_ VCFRONT_a138_snsDisconnect m138 : 17|1@1+ (1,0) [0|0] "" Vector__XXX
 SG_ VCFRONT_a139_snsDisconnect m139 : 17|1@1+ (1,0) [0|0] "" Vector__XXX
 SG_ VCFRONT_a140_snsDisconnect m140 : 17|1@1+ (1,0) [0|0] "" Vector__XXX
 SG_ VCFRONT_a141_snsDisconnect m141 : 17|1@1+ (1,0) [0|0] "" Vector__XXX
 SG_ VCFRONT_a143_vsOverVoltage m143 : 17|1@1+ (1,0) [0|0] "" Vector__XXX
 SG_ VCFRONT_a144_vsOverVoltage m144 : 17|1@1+ (1,0) [0|0] "" Vector__XXX
 SG_ VCFRONT_a145_vsOverVoltage m145 : 17|1@1+ (1,0) [0|0] "" Vector__XXX
 SG_ VCFRONT_a159_angleActual m159 : 17|10@1+ (0.25,-70) [0|0] "" Vector__XXX
 SG_ VCFRONT_a160_lowDischPressure m160 : 17|1@1+ (1,0) [0|0] "" Vector__XXX
 SG_ VCFRONT_a161_HVOverVoltage m161 : 17|1@1+ (1,0) [0|0] "" Vector__XXX
 SG_ VCFRONT_a163_compRecoverAfterFSR m163 : 17|1@1+ (1,0) [0|0] "" Vector__XXX
 SG_ VCFRONT_a168_rightECU m168 : 17|1@1+ (1,0) [0|0] "" Vector__XXX
 SG_ VCFRONT_a169_rightECU m169 : 17|1@1+ (1,0) [0|0] "" Vector__XXX
 SG_ VCFRONT_a170_rightECU m170 : 17|1@1+ (1,0) [0|0] "" Vector__XXX
 SG_ VCFRONT_a171_VCRIGHT m171 : 17|1@1+ (1,0) [0|0] "" Vector__XXX
 SG_ VCFRONT_a175_snsDisconnect m175 : 17|1@1+ (1,0) [0|0] "" Vector__XXX
 SG_ VCFRONT_a182_voltageDrop m182 : 17|1@1+ (1,0) [0|0] "" Vector__XXX
 SG_ VCFRONT_a183_voltageDrop m183 : 17|1@1+ (1,0) [0|0] "" Vector__XXX
 SG_ VCFRONT_a196_serviceMode m196 : 17|1@1+ (1,0) [0|0] "" Vector__XXX
 SG_ VCFRONT_a198_NVRAMState m198 : 17|1@1+ (1,0) [0|0] "" Vector__XXX
 SG_ VCFRONT_a199_NVRAMState m199 : 17|1@1+ (1,0) [0|0] "" Vector__XXX
 SG_ VCFRONT_a210_valveOverTravel m210 : 17|1@1+ (1,0) [0|0] "" Vector__XXX
 SG_ VCFRONT_a216_hvState m216 : 17|3@1+ (1,0) [0|0] "" Vector__XXX
 SG_ VCFRONT_a221_currentSenseFaulted m221 : 17|1@1+ (1,0) [0|0] "" Vector__XXX
 SG_ VCFRONT_a222_currentSenseFaulted m222 : 17|1@1+ (1,0) [0|0] "" Vector__XXX
 SG_ VCFRONT_a237_spiRegisterMismatch m237 : 17|1@1+ (1,0) [0|0] "" Vector__XXX
 SG_ VCFRONT_a238_spiRegisterMismatch m238 : 17|1@1+ (1,0) [0|0] "" Vector__XXX
 SG_ VCFRONT_a239_spiRegisterMismatch m239 : 17|1@1+ (1,0) [0|0] "" Vector__XXX
 SG_ VCFRONT_a240_lowPsCutoutCabinBattHeatDisabled m240 : 17|1@1+ (1,0) [0|0] "" Vector__XXX
 SG_ VCFRONT_a250_isVirtualPitchSensor m250 : 17|1@1+ (1,0) [0|0] "" Vector__XXX
 SG_ VCFRONT_a253_ampHourTargetNotReached m253 : 17|1@1+ (1,0) [0|0] "" Vector__XXX
 SG_ VCFRONT_a259_voltageDropCounter m259 : 17|3@1+ (2,0) [0|0] "" Vector__XXX
 SG_ VCFRONT_a271_voltDropOnHighCurrentTrigger m271 : 17|1@1+ (1,0) [0|0] "" Vector__XXX
 SG_ VCFRONT_a273_outwipePowerFailureToResolve m273 : 17|1@1+ (1,0) [0|0] "" Vector__XXX
 SG_ VCFRONT_a274_voltDropOnHighCurrentTrigger m274 : 17|1@1+ (1,0) [0|0] "" Vector__XXX
 SG_ VCFRONT_a279_snsDisconnect m279 : 17|1@1+ (1,0) [0|0] "" Vector__XXX
 SG_ VCFRONT_a280_snsDisconnect m280 : 17|1@1+ (1,0) [0|0] "" Vector__XXX
 SG_ VCFRONT_a283_thmlFanLimited m283 : 17|1@1+ (1,0) [0|0] "" Vector__XXX
 SG_ VCFRONT_a290_currentSenseFaulted m290 : 17|1@1+ (1,0) [0|0] "" Vector__XXX
 SG_ VCFRONT_a291_currentSenseFaulted m291 : 17|1@1+ (1,0) [0|0] "" Vector__XXX
 SG_ VCFRONT_a292_currentSenseFaulted m292 : 17|1@1+ (1,0) [0|0] "" Vector__XXX
 SG_ VCFRONT_a293_currentSenseFaulted m293 : 17|1@1+ (1,0) [0|0] "" Vector__XXX
 SG_ VCFRONT_a294_currentSenseFaulted m294 : 17|1@1+ (1,0) [0|0] "" Vector__XXX
 SG_ VCFRONT_a295_currentSenseFaulted m295 : 17|1@1+ (1,0) [0|0] "" Vector__XXX
 SG_ VCFRONT_a299_LINError m299 : 17|1@1+ (1,0) [0|0] "" Vector__XXX
 SG_ VCFRONT_a355_systemNotCommissioned m355 : 17|1@1+ (1,0) [0|0] "" Vector__XXX
 SG_ VCFRONT_a356_systemNotCommissioned m356 : 17|1@1+ (1,0) [0|0] "" Vector__XXX
 SG_ VCFRONT_a360_notEnoughPowerForSupport m360 : 17|1@1+ (1,0) [0|0] "" Vector__XXX
 SG_ VCFRONT_a364_previousHeaterType m364 : 17|3@1+ (1,0) [0|0] "" Vector__XXX
 SG_ VCFRONT_a365_enteringState m365 : 17|3@1+ (1,0) [0|0] "" Vector__XXX
 SG_ VCFRONT_a368_enteringState m368 : 17|3@1+ (1,0) [0|0] "" Vector__XXX
 SG_ VCFRONT_a369_heatRejectionLimited m369 : 17|1@1+ (1,0) [0|0] "" Vector__XXX
 SG_ VCFRONT_a371_voltDropOnHighCurrentTrigger m371 : 17|1@1+ (1,0) [0|0] "" Vector__XXX
 SG_ VCFRONT_a377_wiperStuckInPark m377 : 17|1@1+ (1,0) [0|0] "" Vector__XXX
 SG_ VCFRONT_a378_wiperOverload m378 : 17|2@1+ (1,0) [0|0] "" Vector__XXX
 SG_ VCFRONT_a389_faultedWhileOpenAtSpeed m389 : 17|1@1+ (1,0) [0|0] "" Vector__XXX
 SG_ VCFRONT_a391_switch1Shorted m391 : 17|1@1+ (1,0) [0|0] "" Vector__XXX
 SG_ VCFRONT_a394_suction m394 : 17|1@1+ (1,0) [0|0] "" Vector__XXX
 SG_ VCFRONT_a397_suction m397 : 17|1@1+ (1,0) [0|0] "" Vector__XXX
 SG_ VCFRONT_a421_inServiceMode m421 : 17|1@1+ (1,0) [0|0] "" Vector__XXX
 SG_ VCFRONT_a437_nvmDataMissingB m437 : 17|1@1+ (1,0) [0|0] "" Vector__XXX
 SG_ VCFRONT_a446_compFaultTdHigh m446 : 17|1@1+ (1,0) [0|0] "" Vector__XXX
 SG_ VCFRONT_a447_heatPumpHVACUnavailable m447 : 17|1@1+ (1,0) [0|0] "" Vector__XXX
 SG_ VCFRONT_a459_refrigerantFillActive m459 : 17|1@1+ (1,0) [0|0] "" Vector__XXX
 SG_ VCFRONT_a462_CellOVLevel2 m462 : 17|1@1+ (1,0) [0|0] "" Vector__XXX
 SG_ VCFRONT_a463_switch1Shorted m463 : 17|1@1+ (1,0) [0|0] "" Vector__XXX
 SG_ VCFRONT_a476_FRM2_timedOut m476 : 17|1@1+ (1,0) [0|0] "" Vector__XXX
 SG_ VCFRONT_a478_battFaultHardwareOverCurrent m478 : 17|1@1+ (1,0) [0|0] "" Vector__XXX
 SG_ VCFRONT_a479_ECPAState m479 : 17|2@1+ (1,0) [0|0] "" Vector__XXX
 SG_ VCFRONT_a489_EvapEXV m489 : 17|1@1+ (1,0) [0|0] "" Vector__XXX
 SG_ VCFRONT_a495_SocTooLow m495 : 17|1@1+ (1,0) [0|0] "" Vector__XXX
 SG_ VCFRONT_a496_vehicleLoadShedActive m496 : 17|1@1+ (1,0) [0|0] "" Vector__XXX
 SG_ VCFRONT_a497_FactoryMode m497 : 17|1@1+ (1,0) [0|0] "" Vector__XXX
 SG_ VCFRONT_a528_ECPAFrameTimeout m528 : 17|1@1+ (1,0) [0|0] "" Vector__XXX
 SG_ VCFRONT_a544_frunkOpen m544 : 17|1@1+ (1,0) [0|0] "" Vector__XXX
 SG_ VCFRONT_a547_frunkOpen m547 : 17|1@1+ (1,0) [0|0] "" Vector__XXX
 SG_ VCFRONT_a556_serviceMode m556 : 17|1@1+ (1,0) [0|0] "" Vector__XXX
 SG_ VCFRONT_a560_highSHBattConditioning m560 : 17|1@1+ (1,0) [0|0] "" Vector__XXX
 SG_ VCFRONT_a587_serviceMode m587 : 17|1@1+ (1,0) [0|0] "" Vector__XXX
 SG_ VCFRONT_a588_vcleftCurveOffsetChannel m588 : 17|3@1+ (1,0) [0|0] "" Vector__XXX
 SG_ VCFRONT_a589_vcleftCurrentThreshold m589 : 17|12@1+ (0.1,0) [0|0] "" Vector__XXX
 SG_ VCFRONT_a590_vcrightCurveOffsetChannel m590 : 17|3@1+ (1,0) [0|0] "" Vector__XXX
 SG_ VCFRONT_a591_vcrightCurrentThreshold m591 : 17|12@1+ (0.1,0) [0|0] "" Vector__XXX
 SG_ VCFRONT_a592_vcleftCutoffCurveOffsetChannel m592 : 17|3@1+ (1,0) [0|0] "" Vector__XXX
 SG_ VCFRONT_a593_vcleftCutoffCurrentThreshold m593 : 17|12@1+ (0.1,0) [0|0] "" Vector__XXX
 SG_ VCFRONT_a595_serviceMode m595 : 17|1@1+ (1,0) [0|0] "" Vector__XXX
 SG_ VCFRONT_a596_vcrightCutoffCurveOffsetChannel m596 : 17|3@1+ (1,0) [0|0] "" Vector__XXX
 SG_ VCFRONT_a597_vcrightCutoffCurrentThreshold m597 : 17|12@1+ (0.1,0) [0|0] "" Vector__XXX
 SG_ VCFRONT_a600_serviceMode m600 : 17|1@1+ (1,0) [0|0] "" Vector__XXX
 SG_ VCFRONT_a606_tempDuctMissTooHigh m606 : 17|1@1+ (1,0) [0|0] "" Vector__XXX
 SG_ VCFRONT_a609_vehiclePowerState m609 : 17|2@1+ (1,0) [0|0] "" Vector__XXX
 SG_ VCFRONT_a611_isCoolantModeParallel m611 : 17|1@1+ (1,0) [0|0] "" Vector__XXX
 SG_ VCFRONT_a635_allBusesSleeping m635 : 17|1@1+ (1,0) [0|0] "" Vector__XXX
 SG_ VCFRONT_a643_inServiceMode m643 : 17|1@1+ (1,0) [0|0] "" Vector__XXX
 SG_ VCFRONT_a649_hvBlockingPersistAccPower m649 : 17|1@1+ (1,0) [0|0] "" Vector__XXX
 SG_ VCFRONT_a669_thermalHVDevicesLimited m669 : 17|1@1+ (1,0) [0|0] "" Vector__XXX
 SG_ VCFRONT_a697_isVirtualPitchSensor m697 : 17|1@1+ (1,0) [0|0] "" Vector__XXX
 SG_ VCFRONT_a698_isVirtualPitchSensor m698 : 17|1@1+ (1,0) [0|0] "" Vector__XXX
 SG_ VCFRONT_a004_DASAdaptiveHighBeamFault m4 : 18|1@1+ (1,0) [0|0] "" Vector__XXX
 SG_ VCFRONT_a008_DASAdaptiveHighBeamFault m8 : 18|1@1+ (1,0) [0|0] "" Vector__XXX
 SG_ VCFRONT_a012_SoftwareReset m12 : 18|1@1+ (1,0) [0|0] "" Vector__XXX
 SG_ VCFRONT_a015_NVMMRecordIDError m15 : 18|1@1+ (1,0) [0|0] "" Vector__XXX
 SG_ VCFRONT_a021_Task1msMissed m21 : 18|1@1+ (1,0) [0|0] "" Vector__XXX
 SG_ VCFRONT_a032_watchdogState m32 : 18|1@1+ (1,0) [0|0] "" Vector__XXX
 SG_ VCFRONT_a038_userRead m38 : 18|1@1+ (1,0) [0|0] "" Vector__XXX
 SG_ VCFRONT_a047_DpslpFault m47 : 18|1@1+ (1,0) [0|0] "" Vector__XXX
 SG_ VCFRONT_a082_RIPC_railStatus m82 : 18|1@1+ (1,0) [0|0] "" Vector__XXX
 SG_ VCFRONT_a083_LIPC_railStatus m83 : 18|1@1+ (1,0) [0|0] "" Vector__XXX
 SG_ VCFRONT_a086_VEH_status m86 : 18|1@1+ (1,0) [0|0] "" Vector__XXX
 SG_ VCFRONT_a087_VEH_torque m87 : 18|1@1+ (1,0) [0|0] "" Vector__XXX
 SG_ VCFRONT_a088_VEH_torque m88 : 18|1@1+ (1,0) [0|0] "" Vector__XXX
 SG_ VCFRONT_a089_VEH_status m89 : 18|1@1+ (1,0) [0|0] "" Vector__XXX
 SG_ VCFRONT_a090_PARTY_eacMonitor m90 : 18|1@1+ (1,0) [0|0] "" Vector__XXX
 SG_ VCFRONT_a091_VEH_state m91 : 18|1@1+ (1,0) [0|0] "" Vector__XXX
 SG_ VCFRONT_a092_VEH_seatStatus2 m92 : 18|1@1+ (1,0) [0|0] "" Vector__XXX
 SG_ VCFRONT_a093_VEH_seatStatus2 m93 : 18|1@1+ (1,0) [0|0] "" Vector__XXX
 SG_ VCFRONT_a098_VEH_status m98 : 18|1@1+ (1,0) [0|0] "" Vector__XXX
 SG_ VCFRONT_a100_PT m100 : 18|1@1+ (1,0) [0|0] "" Vector__XXX
 SG_ VCFRONT_a101_LIPC_externalWatchdogHeartBeat m101 : 18|1@1+ (1,0) [0|0] "" Vector__XXX
 SG_ VCFRONT_a102_VEH_sensorStatus m102 : 18|1@1+ (1,0) [0|0] "" Vector__XXX
 SG_ VCFRONT_a103_VEH_status m103 : 18|1@1+ (1,0) [0|0] "" Vector__XXX
 SG_ VCFRONT_a104_VEH_bodyControls m104 : 18|1@1+ (1,0) [0|0] "" Vector__XXX
 SG_ VCFRONT_a105_VEH_dampingStates m105 : 18|1@1+ (1,0) [0|0] "" Vector__XXX
 SG_ VCFRONT_a106_VEH_dcdcRailStatus m106 : 18|1@1+ (1,0) [0|0] "" Vector__XXX
 SG_ VCFRONT_a107_VEH_status m107 : 18|1@1+ (1,0) [0|0] "" Vector__XXX
 SG_ VCFRONT_a108_VEH_thermalControl m108 : 18|1@1+ (1,0) [0|0] "" Vector__XXX
 SG_ VCFRONT_a109_PARTY_nearDeploy m109 : 18|1@1+ (1,0) [0|0] "" Vector__XXX
 SG_ VCFRONT_a110_VEH_carConfig m110 : 18|1@1+ (1,0) [0|0] "" Vector__XXX
 SG_ VCFRONT_a111_VEH_vehNm m111 : 18|1@1+ (1,0) [0|0] "" Vector__XXX
 SG_ VCFRONT_a112_VEH_vehNm m112 : 18|1@1+ (1,0) [0|0] "" Vector__XXX
 SG_ VCFRONT_a113_VEH_chargeRequest m113 : 18|1@1+ (1,0) [0|0] "" Vector__XXX
 SG_ VCFRONT_a114_VEH_wheelSpeeds m114 : 18|1@1+ (1,0) [0|0] "" Vector__XXX
 SG_ VCFRONT_a115_VEH_BLEResetRequest m115 : 18|1@1+ (1,0) [0|0] "" Vector__XXX
 SG_ VCFRONT_a116_VEH_hvacRequest m116 : 18|1@1+ (1,0) [0|0] "" Vector__XXX
 SG_ VCFRONT_a117_VEH_prndStatus m117 : 18|1@1+ (1,0) [0|0] "" Vector__XXX
 SG_ VCFRONT_a118_VEH_sensors m118 : 18|1@1+ (1,0) [0|0] "" Vector__XXX
 SG_ VCFRONT_a119_VEH_rightStalk m119 : 18|1@1+ (1,0) [0|0] "" Vector__XXX
 SG_ VCFRONT_a120_CH_chassisCntl m120 : 18|1@1+ (1,0) [0|0] "" Vector__XXX
 SG_ VCFRONT_a121_lockedRotor m121 : 18|1@1+ (1,0) [0|0] "" Vector__XXX
 SG_ VCFRONT_a122_startUpOperation m122 : 18|1@1+ (1,0) [0|0] "" Vector__XXX
 SG_ VCFRONT_a123_lockedRotor m123 : 18|1@1+ (1,0) [0|0] "" Vector__XXX
 SG_ VCFRONT_a124_startUpOperation m124 : 18|1@1+ (1,0) [0|0] "" Vector__XXX
 SG_ VCFRONT_a125_lockedRotor m125 : 18|1@1+ (1,0) [0|0] "" Vector__XXX
 SG_ VCFRONT_a126_startUpOperation m126 : 18|1@1+ (1,0) [0|0] "" Vector__XXX
 SG_ VCFRONT_a136_snsRateChangeUp m136 : 18|1@1+ (1,0) [0|0] "" Vector__XXX
 SG_ VCFRONT_a137_snsRateChangeUp m137 : 18|1@1+ (1,0) [0|0] "" Vector__XXX
 SG_ VCFRONT_a138_snsRateChangeUp m138 : 18|1@1+ (1,0) [0|0] "" Vector__XXX
 SG_ VCFRONT_a139_snsRateChangeUp m139 : 18|1@1+ (1,0) [0|0] "" Vector__XXX
 SG_ VCFRONT_a140_snsRateChangeUp m140 : 18|1@1+ (1,0) [0|0] "" Vector__XXX
 SG_ VCFRONT_a141_snsRateChangeUp m141 : 18|1@1+ (1,0) [0|0] "" Vector__XXX
 SG_ VCFRONT_a143_chpUnderVoltage m143 : 18|1@1+ (1,0) [0|0] "" Vector__XXX
 SG_ VCFRONT_a144_chpUnderVoltage m144 : 18|1@1+ (1,0) [0|0] "" Vector__XXX
 SG_ VCFRONT_a145_chpUnderVoltage m145 : 18|1@1+ (1,0) [0|0] "" Vector__XXX
 SG_ VCFRONT_a153_UIDisplayOnForUser m153 : 18|1@1+ (1,0) [0|0] "" Vector__XXX
 SG_ VCFRONT_a160_highDischPressure m160 : 18|1@1+ (1,0) [0|0] "" Vector__XXX
 SG_ VCFRONT_a161_HVUnderVoltage m161 : 18|1@1+ (1,0) [0|0] "" Vector__XXX
 SG_ VCFRONT_a163_compressorType m163 : 18|4@1+ (1,0) [0|0] "" Vector__XXX
 SG_ VCFRONT_a171_VCLEFT m171 : 18|1@1+ (1,0) [0|0] "" Vector__XXX
 SG_ VCFRONT_a175_snsRateChangeUp m175 : 18|1@1+ (1,0) [0|0] "" Vector__XXX
 SG_ VCFRONT_a180_hvState m180 : 18|3@1+ (1,0) [0|0] "" Vector__XXX
 SG_ VCFRONT_a182_overcharge m182 : 18|1@1+ (1,0) [0|0] "" Vector__XXX
 SG_ VCFRONT_a183_overcharge m183 : 18|1@1+ (1,0) [0|0] "" Vector__XXX
 SG_ VCFRONT_a191_hvState m191 : 18|3@1+ (1,0) [0|0] "" Vector__XXX
 SG_ VCFRONT_a192_hvState m192 : 18|3@1+ (1,0) [0|0] "" Vector__XXX
 SG_ VCFRONT_a196_transportMode m196 : 18|1@1+ (1,0) [0|0] "" Vector__XXX
 SG_ VCFRONT_a198_lockoutState m198 : 18|1@1+ (1,0) [0|0] "" Vector__XXX
 SG_ VCFRONT_a199_lockoutState m199 : 18|1@1+ (1,0) [0|0] "" Vector__XXX
 SG_ VCFRONT_a210_valveNoTravel m210 : 18|1@1+ (1,0) [0|0] "" Vector__XXX
 SG_ VCFRONT_a221_tempSenseFaulted m221 : 18|1@1+ (1,0) [0|0] "" Vector__XXX
 SG_ VCFRONT_a222_tempSenseFaulted m222 : 18|1@1+ (1,0) [0|0] "" Vector__XXX
 SG_ VCFRONT_a237_spiDiagError m237 : 18|1@1+ (1,0) [0|0] "" Vector__XXX
 SG_ VCFRONT_a238_spiDiagError m238 : 18|1@1+ (1,0) [0|0] "" Vector__XXX
 SG_ VCFRONT_a239_spiDiagError m239 : 18|1@1+ (1,0) [0|0] "" Vector__XXX
 SG_ VCFRONT_a240_lowPsCutoutScavenge m240 : 18|1@1+ (1,0) [0|0] "" Vector__XXX
 SG_ VCFRONT_a250_isAimedHCML m250 : 18|1@1+ (1,0) [0|0] "" Vector__XXX
 SG_ VCFRONT_a253_IBSCurrent m253 : 18|16@1- (0.005,0) [0|0] "" Vector__XXX
 SG_ VCFRONT_a271_deadLVMinimalAhDischargedTrigger m271 : 18|1@1+ (1,0) [0|0] "" Vector__XXX
 SG_ VCFRONT_a274_deadLVMinimalAhDischargedTrigger m274 : 18|1@1+ (1,0) [0|0] "" Vector__XXX
 SG_ VCFRONT_a279_snsRateChangeUp m279 : 18|1@1+ (1,0) [0|0] "" Vector__XXX
 SG_ VCFRONT_a280_snsRateChangeUp m280 : 18|1@1+ (1,0) [0|0] "" Vector__XXX
 SG_ VCFRONT_a290_tempSenseFaulted m290 : 18|1@1+ (1,0) [0|0] "" Vector__XXX
 SG_ VCFRONT_a291_tempSenseFaulted m291 : 18|1@1+ (1,0) [0|0] "" Vector__XXX
 SG_ VCFRONT_a292_tempSenseFaulted m292 : 18|1@1+ (1,0) [0|0] "" Vector__XXX
 SG_ VCFRONT_a293_tempSenseFaulted m293 : 18|1@1+ (1,0) [0|0] "" Vector__XXX
 SG_ VCFRONT_a294_tempSenseFaulted m294 : 18|1@1+ (1,0) [0|0] "" Vector__XXX
 SG_ VCFRONT_a295_tempSenseFaulted m295 : 18|1@1+ (1,0) [0|0] "" Vector__XXX
 SG_ VCFRONT_a299_unsupportedCountry m299 : 18|1@1+ (1,0) [0|0] "" Vector__XXX
 SG_ VCFRONT_a300_newType m300 : 18|2@1+ (1,0) [0|0] "" Vector__XXX
 SG_ VCFRONT_a355_serviceLockout m355 : 18|1@1+ (1,0) [0|0] "" Vector__XXX
 SG_ VCFRONT_a356_serviceLockout m356 : 18|1@1+ (1,0) [0|0] "" Vector__XXX
 SG_ VCFRONT_a371_deadLVMinimalAhDischargedTrigger m371 : 18|1@1+ (1,0) [0|0] "" Vector__XXX
 SG_ VCFRONT_a389_possiblyStuckClosed m389 : 18|1@1+ (1,0) [0|0] "" Vector__XXX
 SG_ VCFRONT_a390_batteryLoadType m390 : 18|2@1+ (1,0) [0|0] "" Vector__XXX
 SG_ VCFRONT_a391_switch1Disconnected m391 : 18|1@1+ (1,0) [0|0] "" Vector__XXX
 SG_ VCFRONT_a394_liquid m394 : 18|1@1+ (1,0) [0|0] "" Vector__XXX
 SG_ VCFRONT_a397_liquid m397 : 18|1@1+ (1,0) [0|0] "" Vector__XXX
 SG_ VCFRONT_a421_frunkOpen m421 : 18|1@1+ (1,0) [0|0] "" Vector__XXX
 SG_ VCFRONT_a445_SPIFaultCount m445 : 18|2@1+ (1,0) [0|0] "" Vector__XXX
 SG_ VCFRONT_a446_compFaultPdLow m446 : 18|1@1+ (1,0) [0|0] "" Vector__XXX
 SG_ VCFRONT_a447_activeLouverCompromised m447 : 18|1@1+ (1,0) [0|0] "" Vector__XXX
 SG_ VCFRONT_a462_CellOVLevel3 m462 : 18|1@1+ (1,0) [0|0] "" Vector__XXX
 SG_ VCFRONT_a463_switch1Disconnected m463 : 18|1@1+ (1,0) [0|0] "" Vector__XXX
 SG_ VCFRONT_a474_ssl100Bank2Status m474 : 18|2@1+ (1,0) [0|0] "" Vector__XXX
 SG_ VCFRONT_a475_ssl100Bank2Status m475 : 18|2@1+ (1,0) [0|0] "" Vector__XXX
 SG_ VCFRONT_a476_FRM3_timedOut m476 : 18|1@1+ (1,0) [0|0] "" Vector__XXX
 SG_ VCFRONT_a478_battFaultChargeOverCurrent m478 : 18|1@1+ (1,0) [0|0] "" Vector__XXX
 SG_ VCFRONT_a482_lastPosition m482 : 18|10@1+ (1,0) [0|0] "" Vector__XXX
 SG_ VCFRONT_a485_lastPosition m485 : 18|10@1+ (1,0) [0|0] "" Vector__XXX
 SG_ VCFRONT_a489_RecircEXV m489 : 18|1@1+ (1,0) [0|0] "" Vector__XXX
 SG_ VCFRONT_a495_retryExpended m495 : 18|1@1+ (1,0) [0|0] "" Vector__XXX
 SG_ VCFRONT_a496_MOSState m496 : 18|2@1+ (1,0) [0|0] "" Vector__XXX
 SG_ VCFRONT_a506_refrigLccType m506 : 18|1@1+ (1,0) [0|0] "" Vector__XXX
 SG_ VCFRONT_a507_aimingAllowed m507 : 18|1@1+ (1,0) [0|0] "" Vector__XXX
 SG_ VCFRONT_a524_aimingAllowed m524 : 18|1@1+ (1,0) [0|0] "" Vector__XXX
 SG_ VCFRONT_a528_currentSenseFaulted m528 : 18|1@1+ (1,0) [0|0] "" Vector__XXX
 SG_ VCFRONT_a544_LVBMSSOC m544 : 18|5@1+ (3,0) [0|0] "" Vector__XXX
 SG_ VCFRONT_a548_notEnoughPowerForSupport m548 : 18|1@1+ (1,0) [0|0] "" Vector__XXX
 SG_ VCFRONT_a556_transportMode m556 : 18|1@1+ (1,0) [0|0] "" Vector__XXX
 SG_ VCFRONT_a560_highSHCabinReheatCD m560 : 18|1@1+ (1,0) [0|0] "" Vector__XXX
 SG_ VCFRONT_a565_UIDisplayOnForUser m565 : 18|1@1+ (1,0) [0|0] "" Vector__XXX
 SG_ VCFRONT_a583_referenceSwitchGroupStateSimple m583 : 18|2@1+ (1,0) [0|0] "" Vector__XXX
 SG_ VCFRONT_a584_frunkSwitchGroupStatePrevious m584 : 18|2@1+ (1,0) [0|0] "" Vector__XXX
 SG_ VCFRONT_a587_transportMode m587 : 18|1@1+ (1,0) [0|0] "" Vector__XXX
 SG_ VCFRONT_a595_transportMode m595 : 18|1@1+ (1,0) [0|0] "" Vector__XXX
 SG_ VCFRONT_a600_transportMode m600 : 18|1@1+ (1,0) [0|0] "" Vector__XXX
 SG_ VCFRONT_a606_packTempTooWarm m606 : 18|1@1+ (1,0) [0|0] "" Vector__XXX
 SG_ VCFRONT_a610_switch2State m610 : 18|2@1+ (1,0) [0|0] "" Vector__XXX
 SG_ VCFRONT_a611_tempCoolantRadOutletActual m611 : 18|6@1+ (1,20) [0|0] "" Vector__XXX
 SG_ VCFRONT_a619_switch2State m619 : 18|2@1+ (1,0) [0|0] "" Vector__XXX
 SG_ VCFRONT_a635_vehBusAwake m635 : 18|1@1+ (1,0) [0|0] "" Vector__XXX
 SG_ VCFRONT_a643_frunkOpen m643 : 18|1@1+ (1,0) [0|0] "" Vector__XXX
 SG_ VCFRONT_a669_thermalHVDevicesDisabled m669 : 18|1@1+ (1,0) [0|0] "" Vector__XXX
 SG_ VCFRONT_a697_calibratedVerticalPositionHCML m697 : 18|10@1+ (1,0) [0|0] "" Vector__XXX
 SG_ VCFRONT_a698_calibratedVerticalPositionHCMR m698 : 18|10@1+ (1,0) [0|0] "" Vector__XXX
 SG_ VCFRONT_a004_DASMatrixColumnMsgMIA m4 : 19|1@1+ (1,0) [0|0] "" Vector__XXX
 SG_ VCFRONT_a008_DASMatrixColumnMsgMIA m8 : 19|1@1+ (1,0) [0|0] "" Vector__XXX
 SG_ VCFRONT_a012_CheckstopReset m12 : 19|1@1+ (1,0) [0|0] "" Vector__XXX
 SG_ VCFRONT_a021_Task10msLate m21 : 19|1@1+ (1,0) [0|0] "" Vector__XXX
 SG_ VCFRONT_a032_corePowerMode m32 : 19|2@1+ (1,0) [0|0] "" Vector__XXX
 SG_ VCFRONT_a038_userWrite m38 : 19|1@1+ (1,0) [0|0] "" Vector__XXX
 SG_ VCFRONT_a047_TcDbgreset m47 : 19|1@1+ (1,0) [0|0] "" Vector__XXX
 SG_ VCFRONT_a082_RIPC_remoteMux m82 : 19|1@1+ (1,0) [0|0] "" Vector__XXX
 SG_ VCFRONT_a083_LIPC_HSDFaults m83 : 19|1@1+ (1,0) [0|0] "" Vector__XXX
 SG_ VCFRONT_a086_VEH_12VBatteryStatus m86 : 19|1@1+ (1,0) [0|0] "" Vector__XXX
 SG_ VCFRONT_a087_VEH_status m87 : 19|1@1+ (1,0) [0|0] "" Vector__XXX
 SG_ VCFRONT_a088_VEH_status m88 : 19|1@1+ (1,0) [0|0] "" Vector__XXX
 SG_ VCFRONT_a089_BDY_party1 m89 : 19|1@1+ (1,0) [0|0] "" Vector__XXX
 SG_ VCFRONT_a090_CH_eacMonitor m90 : 19|1@1+ (1,0) [0|0] "" Vector__XXX
 SG_ VCFRONT_a092_VEH_vehNm m92 : 19|1@1+ (1,0) [0|0] "" Vector__XXX
 SG_ VCFRONT_a093_VEH_vehNm m93 : 19|1@1+ (1,0) [0|0] "" Vector__XXX
 SG_ VCFRONT_a098_VEH_thermalControl m98 : 19|1@1+ (1,0) [0|0] "" Vector__XXX
 SG_ VCFRONT_a100_CH m100 : 19|1@1+ (1,0) [0|0] "" Vector__XXX
 SG_ VCFRONT_a101_VEH_locState m101 : 19|1@1+ (1,0) [0|0] "" Vector__XXX
 SG_ VCFRONT_a102_VEH_rods m102 : 19|1@1+ (1,0) [0|0] "" Vector__XXX
 SG_ VCFRONT_a103_PT_ptNm m103 : 19|1@1+ (1,0) [0|0] "" Vector__XXX
 SG_ VCFRONT_a104_VEH_bodyControls3 m104 : 19|1@1+ (1,0) [0|0] "" Vector__XXX
 SG_ VCFRONT_a106_CH_dcdcRailStatus m106 : 19|1@1+ (1,0) [0|0] "" Vector__XXX
 SG_ VCFRONT_a107_VEH_thermalStatus m107 : 19|1@1+ (1,0) [0|0] "" Vector__XXX
 SG_ VCFRONT_a108_VEH_torque m108 : 19|1@1+ (1,0) [0|0] "" Vector__XXX
 SG_ VCFRONT_a109_PARTY_collision m109 : 19|1@1+ (1,0) [0|0] "" Vector__XXX
 SG_ VCFRONT_a110_VEH_time m110 : 19|1@1+ (1,0) [0|0] "" Vector__XXX
 SG_ VCFRONT_a111_RIPC_LVPowerState m111 : 19|1@1+ (1,0) [0|0] "" Vector__XXX
 SG_ VCFRONT_a112_LIPC_LVPowerState m112 : 19|1@1+ (1,0) [0|0] "" Vector__XXX
 SG_ VCFRONT_a113_VEH_vehicleControl m113 : 19|1@1+ (1,0) [0|0] "" Vector__XXX
 SG_ VCFRONT_a114_CH_wheelSpeeds m114 : 19|1@1+ (1,0) [0|0] "" Vector__XXX
 SG_ VCFRONT_a115_VEH_requests m115 : 19|1@1+ (1,0) [0|0] "" Vector__XXX
 SG_ VCFRONT_a116_VEH_hvacStatus m116 : 19|1@1+ (1,0) [0|0] "" Vector__XXX
 SG_ VCFRONT_a117_PARTY_epbmStatus m117 : 19|1@1+ (1,0) [0|0] "" Vector__XXX
 SG_ VCFRONT_a118_VEH_status m118 : 19|1@1+ (1,0) [0|0] "" Vector__XXX
 SG_ VCFRONT_a119_PARTY_rightStalk m119 : 19|1@1+ (1,0) [0|0] "" Vector__XXX
 SG_ VCFRONT_a120_PARTY_systemStatus m120 : 19|1@1+ (1,0) [0|0] "" Vector__XXX
 SG_ VCFRONT_a122_lossOfSpeedLock m122 : 19|1@1+ (1,0) [0|0] "" Vector__XXX
 SG_ VCFRONT_a124_lossOfSpeedLock m124 : 19|1@1+ (1,0) [0|0] "" Vector__XXX
 SG_ VCFRONT_a126_lossOfSpeedLock m126 : 19|1@1+ (1,0) [0|0] "" Vector__XXX
 SG_ VCFRONT_a136_snsRateChangeDown m136 : 19|1@1+ (1,0) [0|0] "" Vector__XXX
 SG_ VCFRONT_a137_snsRateChangeDown m137 : 19|1@1+ (1,0) [0|0] "" Vector__XXX
 SG_ VCFRONT_a138_snsRateChangeDown m138 : 19|1@1+ (1,0) [0|0] "" Vector__XXX
 SG_ VCFRONT_a139_snsRateChangeDown m139 : 19|1@1+ (1,0) [0|0] "" Vector__XXX
 SG_ VCFRONT_a140_snsRateChangeDown m140 : 19|1@1+ (1,0) [0|0] "" Vector__XXX
 SG_ VCFRONT_a141_snsRateChangeDown m141 : 19|1@1+ (1,0) [0|0] "" Vector__XXX
 SG_ VCFRONT_a143_vglUnderVoltage m143 : 19|1@1+ (1,0) [0|0] "" Vector__XXX
 SG_ VCFRONT_a144_vglUnderVoltage m144 : 19|1@1+ (1,0) [0|0] "" Vector__XXX
 SG_ VCFRONT_a145_vglUnderVoltage m145 : 19|1@1+ (1,0) [0|0] "" Vector__XXX
 SG_ VCFRONT_a153_inDriveState m153 : 19|1@1+ (1,0) [0|0] "" Vector__XXX
 SG_ VCFRONT_a160_lowSuctionPressure m160 : 19|1@1+ (1,0) [0|0] "" Vector__XXX
 SG_ VCFRONT_a161_overCurrent m161 : 19|1@1+ (1,0) [0|0] "" Vector__XXX
 SG_ VCFRONT_a171_VCBATT m171 : 19|1@1+ (1,0) [0|0] "" Vector__XXX
 SG_ VCFRONT_a175_snsRateChangeDown m175 : 19|1@1+ (1,0) [0|0] "" Vector__XXX
 SG_ VCFRONT_a178_compressorState m178 : 19|2@1+ (1,0) [0|0] "" Vector__XXX
 SG_ VCFRONT_a182_LVFloorReached m182 : 19|1@1+ (1,0) [0|0] "" Vector__XXX
 SG_ VCFRONT_a183_LVFloorReached m183 : 19|1@1+ (1,0) [0|0] "" Vector__XXX
 SG_ VCFRONT_a196_frunkOpen m196 : 19|1@1+ (1,0) [0|0] "" Vector__XXX
 SG_ VCFRONT_a221_underCurrent m221 : 19|1@1+ (1,0) [0|0] "" Vector__XXX
 SG_ VCFRONT_a222_underCurrent m222 : 19|1@1+ (1,0) [0|0] "" Vector__XXX
 SG_ VCFRONT_a237_pwmOutputFault m237 : 19|1@1+ (1,0) [0|0] "" Vector__XXX
 SG_ VCFRONT_a238_pwmOutputFault m238 : 19|1@1+ (1,0) [0|0] "" Vector__XXX
 SG_ VCFRONT_a239_pwmOutputFault m239 : 19|1@1+ (1,0) [0|0] "" Vector__XXX
 SG_ VCFRONT_a240_lowPsCutoutAS m240 : 19|1@1+ (1,0) [0|0] "" Vector__XXX
 SG_ VCFRONT_a250_isAimedHCMR m250 : 19|1@1+ (1,0) [0|0] "" Vector__XXX
 SG_ VCFRONT_a271_resistanceEstimationHardFailTrigger m271 : 19|1@1+ (1,0) [0|0] "" Vector__XXX
 SG_ VCFRONT_a274_resistanceEstimationHardFailTrigger m274 : 19|1@1+ (1,0) [0|0] "" Vector__XXX
 SG_ VCFRONT_a279_snsRateChangeDown m279 : 19|1@1+ (1,0) [0|0] "" Vector__XXX
 SG_ VCFRONT_a280_snsRateChangeDown m280 : 19|1@1+ (1,0) [0|0] "" Vector__XXX
 SG_ VCFRONT_a290_underCurrent m290 : 19|1@1+ (1,0) [0|0] "" Vector__XXX
 SG_ VCFRONT_a291_underCurrent m291 : 19|1@1+ (1,0) [0|0] "" Vector__XXX
 SG_ VCFRONT_a292_underCurrent m292 : 19|1@1+ (1,0) [0|0] "" Vector__XXX
 SG_ VCFRONT_a293_underCurrent m293 : 19|1@1+ (1,0) [0|0] "" Vector__XXX
 SG_ VCFRONT_a294_underCurrent m294 : 19|1@1+ (1,0) [0|0] "" Vector__XXX
 SG_ VCFRONT_a295_underCurrent m295 : 19|1@1+ (1,0) [0|0] "" Vector__XXX
 SG_ VCFRONT_a299_writeFailed m299 : 19|1@1+ (1,0) [0|0] "" Vector__XXX
 SG_ VCFRONT_a355_factoryGated m355 : 19|1@1+ (1,0) [0|0] "" Vector__XXX
 SG_ VCFRONT_a356_factoryGated m356 : 19|1@1+ (1,0) [0|0] "" Vector__XXX
 SG_ VCFRONT_a366_exitingState m366 : 19|3@1+ (1,0) [0|0] "" Vector__XXX
 SG_ VCFRONT_a371_resistanceEstimationHardFailTrigger m371 : 19|1@1+ (1,0) [0|0] "" Vector__XXX
 SG_ VCFRONT_a378_wiperFault m378 : 19|1@1+ (1,0) [0|0] "" Vector__XXX
 SG_ VCFRONT_a387_minVoltageReached m387 : 19|12@1+ (0.005443676098,0) [0|0] "" Vector__XXX
 SG_ VCFRONT_a388_minVoltageReached m388 : 19|12@1+ (0.005443676098,0) [0|0] "" Vector__XXX
 SG_ VCFRONT_a389_vehicleSpeed m389 : 19|12@1+ (0.08,-40) [0|0] "" Vector__XXX
 SG_ VCFRONT_a391_switch2Shorted m391 : 19|1@1+ (1,0) [0|0] "" Vector__XXX
 SG_ VCFRONT_a394_offsetError m394 : 19|10@1- (0.05,0) [0|0] "" Vector__XXX
 SG_ VCFRONT_a397_offsetError m397 : 19|10@1- (0.2,0) [0|0] "" Vector__XXX
 SG_ VCFRONT_a421_leftHeadlampCurrentFiltered m421 : 19|10@1+ (0.027,0) [0|0] "" Vector__XXX
 SG_ VCFRONT_a446_compFaultPdHigh m446 : 19|1@1+ (1,0) [0|0] "" Vector__XXX
 SG_ VCFRONT_a447_coolantValveCompromised m447 : 19|1@1+ (1,0) [0|0] "" Vector__XXX
 SG_ VCFRONT_a462_CellUVLevel1 m462 : 19|1@1+ (1,0) [0|0] "" Vector__XXX
 SG_ VCFRONT_a463_switch2Shorted m463 : 19|1@1+ (1,0) [0|0] "" Vector__XXX
 SG_ VCFRONT_a476_FRM4_timedOut m476 : 19|1@1+ (1,0) [0|0] "" Vector__XXX
 SG_ VCFRONT_a478_battFaultCellUnderVoltage m478 : 19|1@1+ (1,0) [0|0] "" Vector__XXX
 SG_ VCFRONT_a479_factoryMode m479 : 19|1@1+ (1,0) [0|0] "" Vector__XXX
 SG_ VCFRONT_a480_reset m480 : 19|1@1+ (1,0) [0|0] "" Vector__XXX
 SG_ VCFRONT_a483_currentMovementState m483 : 19|4@1+ (1,0) [0|0] "" Vector__XXX
 SG_ VCFRONT_a488_currentMovementState m488 : 19|4@1+ (1,0) [0|0] "" Vector__XXX
 SG_ VCFRONT_a489_LCCEXV m489 : 19|1@1+ (1,0) [0|0] "" Vector__XXX
 SG_ VCFRONT_a495_LVBMSMIA m495 : 19|1@1+ (1,0) [0|0] "" Vector__XXX
 SG_ VCFRONT_a507_useRideHeightSensors m507 : 19|1@1+ (1,0) [0|0] "" Vector__XXX
 SG_ VCFRONT_a524_useRideHeightSensors m524 : 19|1@1+ (1,0) [0|0] "" Vector__XXX
 SG_ VCFRONT_a525_newLVBatteryType m525 : 19|3@1+ (1,0) [0|0] "" Vector__XXX
 SG_ VCFRONT_a528_serviceMode m528 : 19|1@1+ (1,0) [0|0] "" Vector__XXX
 SG_ VCFRONT_a545_newLVBatteryType m545 : 19|3@1+ (1,0) [0|0] "" Vector__XXX
 SG_ VCFRONT_a548_HVBlockingMismatch m548 : 19|1@1+ (1,0) [0|0] "" Vector__XXX
 SG_ VCFRONT_a556_frunkOpen m556 : 19|1@1+ (1,0) [0|0] "" Vector__XXX
 SG_ VCFRONT_a560_highSHCabinReheatHD m560 : 19|1@1+ (1,0) [0|0] "" Vector__XXX
 SG_ VCFRONT_a565_inDriveState m565 : 19|1@1+ (1,0) [0|0] "" Vector__XXX
 SG_ VCFRONT_a587_frunkOpen m587 : 19|1@1+ (1,0) [0|0] "" Vector__XXX
 SG_ VCFRONT_a595_frunkOpen m595 : 19|1@1+ (1,0) [0|0] "" Vector__XXX
 SG_ VCFRONT_a599_newLVBatteryType m599 : 19|3@1+ (1,0) [0|0] "" Vector__XXX
 SG_ VCFRONT_a600_frunkOpen m600 : 19|1@1+ (1,0) [0|0] "" Vector__XXX
 SG_ VCFRONT_a606_PdPsTsSHNotNominal m606 : 19|1@1+ (1,0) [0|0] "" Vector__XXX
 SG_ VCFRONT_a612_manualDrivingProhibited m612 : 19|1@1+ (1,0) [0|0] "" Vector__XXX
 SG_ VCFRONT_a614_octovalveNotAtTarget m614 : 19|1@1+ (1,0) [0|0] "" Vector__XXX
 SG_ VCFRONT_a623_manualDrivingProhibited m623 : 19|1@1+ (1,0) [0|0] "" Vector__XXX
 SG_ VCFRONT_a628_thermistorFailureReason m628 : 19|3@1+ (1,0) [0|0] "" Vector__XXX
 SG_ VCFRONT_a635_frontPrivBusAwake m635 : 19|1@1+ (1,0) [0|0] "" Vector__XXX
 SG_ VCFRONT_a643_rightHeadlampCurrentFiltered m643 : 19|10@1+ (0.027,0) [0|0] "" Vector__XXX
 SG_ VCFRONT_a669_defogEnabled m669 : 19|1@1+ (1,0) [0|0] "" Vector__XXX
 SG_ VCFRONT_a004_DASBendAngleMsgMIA m4 : 20|1@1+ (1,0) [0|0] "" Vector__XXX
 SG_ VCFRONT_a005_faults0 m5 : 20|12@1+ (1,0) [0|0] "" Vector__XXX
 SG_ VCFRONT_a006_fault m6 : 20|4@1+ (1,0) [0|0] "" Vector__XXX
 SG_ VCFRONT_a008_DASBendAngleMsgMIA m8 : 20|1@1+ (1,0) [0|0] "" Vector__XXX
 SG_ VCFRONT_a012_DebugReset m12 : 20|1@1+ (1,0) [0|0] "" Vector__XXX
 SG_ VCFRONT_a021_Task10msStarved m21 : 20|1@1+ (1,0) [0|0] "" Vector__XXX
 SG_ VCFRONT_a038_userExecute m38 : 20|1@1+ (1,0) [0|0] "" Vector__XXX
 SG_ VCFRONT_a047_SysReset m47 : 20|1@1+ (1,0) [0|0] "" Vector__XXX
 SG_ VCFRONT_a086_VEH_LVPowerState m86 : 20|1@1+ (1,0) [0|0] "" Vector__XXX
 SG_ VCFRONT_a087_PARTY_torque m87 : 20|1@1+ (1,0) [0|0] "" Vector__XXX
 SG_ VCFRONT_a088_PARTY_torque m88 : 20|1@1+ (1,0) [0|0] "" Vector__XXX
 SG_ VCFRONT_a089_BDY_status m89 : 20|1@1+ (1,0) [0|0] "" Vector__XXX
 SG_ VCFRONT_a098_VEH_temperature m98 : 20|1@1+ (1,0) [0|0] "" Vector__XXX
 SG_ VCFRONT_a100_OBD m100 : 20|1@1+ (1,0) [0|0] "" Vector__XXX
 SG_ VCFRONT_a101_BDY_locState m101 : 20|1@1+ (1,0) [0|0] "" Vector__XXX
 SG_ VCFRONT_a103_PT_status m103 : 20|1@1+ (1,0) [0|0] "" Vector__XXX
 SG_ VCFRONT_a104_BDY_bodyControls3 m104 : 20|1@1+ (1,0) [0|0] "" Vector__XXX
 SG_ VCFRONT_a106_CH_alertMatrix m106 : 20|1@1+ (1,0) [0|0] "" Vector__XXX
 SG_ VCFRONT_a107_VEH_bmbMinMax m107 : 20|1@1+ (1,0) [0|0] "" Vector__XXX
 SG_ VCFRONT_a108_VEH_status m108 : 20|1@1+ (1,0) [0|0] "" Vector__XXX
 SG_ VCFRONT_a109_VEH_status m109 : 20|1@1+ (1,0) [0|0] "" Vector__XXX
 SG_ VCFRONT_a110_VEH_updateStatus m110 : 20|1@1+ (1,0) [0|0] "" Vector__XXX
 SG_ VCFRONT_a111_RIPC_epbPrivateState m111 : 20|1@1+ (1,0) [0|0] "" Vector__XXX
 SG_ VCFRONT_a112_LIPC_epbPrivateState m112 : 20|1@1+ (1,0) [0|0] "" Vector__XXX
 SG_ VCFRONT_a113_VEH_vehicleControl2 m113 : 20|1@1+ (1,0) [0|0] "" Vector__XXX
 SG_ VCFRONT_a114_PARTY_party3 m114 : 20|1@1+ (1,0) [0|0] "" Vector__XXX
 SG_ VCFRONT_a115_VEH_requests2 m115 : 20|1@1+ (1,0) [0|0] "" Vector__XXX
 SG_ VCFRONT_a116_VEH_LVPowerState m116 : 20|1@1+ (1,0) [0|0] "" Vector__XXX
 SG_ VCFRONT_a117_VEH_vehNm m117 : 20|1@1+ (1,0) [0|0] "" Vector__XXX
 SG_ VCFRONT_a118_VEH_okToUseHighPwr m118 : 20|1@1+ (1,0) [0|0] "" Vector__XXX
 SG_ VCFRONT_a119_CH_steerAngle m119 : 20|1@1+ (1,0) [0|0] "" Vector__XXX
 SG_ VCFRONT_a120_PARTY_torque m120 : 20|1@1+ (1,0) [0|0] "" Vector__XXX
 SG_ VCFRONT_a122_vccUnderVoltage m122 : 20|1@1+ (1,0) [0|0] "" Vector__XXX
 SG_ VCFRONT_a124_vccUnderVoltage m124 : 20|1@1+ (1,0) [0|0] "" Vector__XXX
 SG_ VCFRONT_a126_vccUnderVoltage m126 : 20|1@1+ (1,0) [0|0] "" Vector__XXX
 SG_ VCFRONT_a142_driverThermWarn m142 : 20|1@1+ (1,0) [0|0] "" Vector__XXX
 SG_ VCFRONT_a143_thOverTemperature m143 : 20|1@1+ (1,0) [0|0] "" Vector__XXX
 SG_ VCFRONT_a144_thOverTemperature m144 : 20|1@1+ (1,0) [0|0] "" Vector__XXX
 SG_ VCFRONT_a145_thOverTemperature m145 : 20|1@1+ (1,0) [0|0] "" Vector__XXX
 SG_ VCFRONT_a153_steeringWheelButtonInteraction m153 : 20|1@1+ (1,0) [0|0] "" Vector__XXX
 SG_ VCFRONT_a160_faultSnsDischPress m160 : 20|1@1+ (1,0) [0|0] "" Vector__XXX
 SG_ VCFRONT_a161_overTemperature m161 : 20|1@1+ (1,0) [0|0] "" Vector__XXX
 SG_ VCFRONT_a171_BMS m171 : 20|1@1+ (1,0) [0|0] "" Vector__XXX
 SG_ VCFRONT_a182_shortedCell m182 : 20|1@1+ (1,0) [0|0] "" Vector__XXX
 SG_ VCFRONT_a183_shortedCell m183 : 20|1@1+ (1,0) [0|0] "" Vector__XXX
 SG_ VCFRONT_a196_vehiclePowerState m196 : 20|2@1+ (1,0) [0|0] "" Vector__XXX
 SG_ VCFRONT_a216_vcleftFastBlowImminent m216 : 20|1@1+ (1,0) [0|0] "" Vector__XXX
 SG_ VCFRONT_a221_overCurrent m221 : 20|1@1+ (1,0) [0|0] "" Vector__XXX
 SG_ VCFRONT_a222_overCurrent m222 : 20|1@1+ (1,0) [0|0] "" Vector__XXX
 SG_ VCFRONT_a237_watchdogTimeout m237 : 20|1@1+ (1,0) [0|0] "" Vector__XXX
 SG_ VCFRONT_a238_watchdogTimeout m238 : 20|1@1+ (1,0) [0|0] "" Vector__XXX
 SG_ VCFRONT_a239_watchdogTimeout m239 : 20|1@1+ (1,0) [0|0] "" Vector__XXX
 SG_ VCFRONT_a240_cabinHeatASCompromisedLowSide m240 : 20|1@1+ (1,0) [0|0] "" Vector__XXX
 SG_ VCFRONT_a250_calibratedVerticalPositionHCML m250 : 20|10@1+ (1,0) [0|0] "" Vector__XXX
 SG_ VCFRONT_a259_minVoltageReached m259 : 20|12@1+ (0.005443676098,0) [0|0] "" Vector__XXX
 SG_ VCFRONT_a271_dcrMilliOhmsAboveThresholdTrigger m271 : 20|1@1+ (1,0) [0|0] "" Vector__XXX
 SG_ VCFRONT_a274_dcrMilliOhmsAboveThresholdTrigger m274 : 20|1@1+ (1,0) [0|0] "" Vector__XXX
 SG_ VCFRONT_a284_driverThermWarn m284 : 20|1@1+ (1,0) [0|0] "" Vector__XXX
 SG_ VCFRONT_a285_driverThermWarn m285 : 20|1@1+ (1,0) [0|0] "" Vector__XXX
 SG_ VCFRONT_a286_driverThermWarn m286 : 20|1@1+ (1,0) [0|0] "" Vector__XXX
 SG_ VCFRONT_a287_driverThermWarn m287 : 20|1@1+ (1,0) [0|0] "" Vector__XXX
 SG_ VCFRONT_a288_driverThermWarn m288 : 20|1@1+ (1,0) [0|0] "" Vector__XXX
 SG_ VCFRONT_a289_driverThermWarn m289 : 20|1@1+ (1,0) [0|0] "" Vector__XXX
 SG_ VCFRONT_a290_overCurrent m290 : 20|1@1+ (1,0) [0|0] "" Vector__XXX
 SG_ VCFRONT_a291_overCurrent m291 : 20|1@1+ (1,0) [0|0] "" Vector__XXX
 SG_ VCFRONT_a292_overCurrent m292 : 20|1@1+ (1,0) [0|0] "" Vector__XXX
 SG_ VCFRONT_a293_overCurrent m293 : 20|1@1+ (1,0) [0|0] "" Vector__XXX
 SG_ VCFRONT_a294_overCurrent m294 : 20|1@1+ (1,0) [0|0] "" Vector__XXX
 SG_ VCFRONT_a295_overCurrent m295 : 20|1@1+ (1,0) [0|0] "" Vector__XXX
 SG_ VCFRONT_a356_refCommissionStatus m356 : 20|1@1+ (1,0) [0|0] "" Vector__XXX
 SG_ VCFRONT_a364_newHeaterType m364 : 20|3@1+ (1,0) [0|0] "" Vector__XXX
 SG_ VCFRONT_a365_exitingState m365 : 20|3@1+ (1,0) [0|0] "" Vector__XXX
 SG_ VCFRONT_a368_exitingState m368 : 20|3@1+ (1,0) [0|0] "" Vector__XXX
 SG_ VCFRONT_a371_dcrMilliOhmsAboveThresholdTrigger m371 : 20|1@1+ (1,0) [0|0] "" Vector__XXX
 SG_ VCFRONT_a378_wiperOvertemperature m378 : 20|2@1+ (1,0) [0|0] "" Vector__XXX
 SG_ VCFRONT_a380_driverStagnantFeedback m380 : 20|1@1+ (1,0) [0|0] "" Vector__XXX
 SG_ VCFRONT_a381_driverStagnantFeedback m381 : 20|1@1+ (1,0) [0|0] "" Vector__XXX
 SG_ VCFRONT_a382_driverStagnantFeedback m382 : 20|1@1+ (1,0) [0|0] "" Vector__XXX
 SG_ VCFRONT_a383_driverStagnantFeedback m383 : 20|1@1+ (1,0) [0|0] "" Vector__XXX
 SG_ VCFRONT_a384_driverStagnantFeedback m384 : 20|1@1+ (1,0) [0|0] "" Vector__XXX
 SG_ VCFRONT_a385_driverStagnantFeedback m385 : 20|1@1+ (1,0) [0|0] "" Vector__XXX
 SG_ VCFRONT_a386_driverStagnantFeedback m386 : 20|1@1+ (1,0) [0|0] "" Vector__XXX
 SG_ VCFRONT_a390_highSideHX m390 : 20|2@1+ (1,0) [0|0] "" Vector__XXX
 SG_ VCFRONT_a391_switch2Disconnected m391 : 20|1@1+ (1,0) [0|0] "" Vector__XXX
 SG_ VCFRONT_a429_depthOfDischarge m429 : 20|10@1+ (0.1,-0.1) [0|0] "" Vector__XXX
 SG_ VCFRONT_a443_maxDieTemp m443 : 20|10@1+ (0.2,-20) [0|0] "" Vector__XXX
 SG_ VCFRONT_a446_compFaultPsLow m446 : 20|1@1+ (1,0) [0|0] "" Vector__XXX
 SG_ VCFRONT_a447_ambientSourcingCompromised m447 : 20|1@1+ (1,0) [0|0] "" Vector__XXX
 SG_ VCFRONT_a462_CellUVLevel2 m462 : 20|1@1+ (1,0) [0|0] "" Vector__XXX
 SG_ VCFRONT_a463_switch2Disconnected m463 : 20|1@1+ (1,0) [0|0] "" Vector__XXX
 SG_ VCFRONT_a474_ssl100Bank3Status m474 : 20|2@1+ (1,0) [0|0] "" Vector__XXX
 SG_ VCFRONT_a475_ssl100Bank3Status m475 : 20|2@1+ (1,0) [0|0] "" Vector__XXX
 SG_ VCFRONT_a476_FRM5_timedOut m476 : 20|1@1+ (1,0) [0|0] "" Vector__XXX
 SG_ VCFRONT_a478_battFaultCellOverVoltage m478 : 20|1@1+ (1,0) [0|0] "" Vector__XXX
 SG_ VCFRONT_a479_serviceMode m479 : 20|1@1+ (1,0) [0|0] "" Vector__XXX
 SG_ VCFRONT_a480_spiError m480 : 20|1@1+ (1,0) [0|0] "" Vector__XXX
 SG_ VCFRONT_a489_CCLEXV m489 : 20|1@1+ (1,0) [0|0] "" Vector__XXX
 SG_ VCFRONT_a495_reverseBatteryEFuseFault m495 : 20|1@1+ (1,0) [0|0] "" Vector__XXX
 SG_ VCFRONT_a496_serviceMode m496 : 20|1@1+ (1,0) [0|0] "" Vector__XXX
 SG_ VCFRONT_a507_useVirtualPitchSensor m507 : 20|1@1+ (1,0) [0|0] "" Vector__XXX
 SG_ VCFRONT_a524_useVirtualPitchSensor m524 : 20|1@1+ (1,0) [0|0] "" Vector__XXX
 SG_ VCFRONT_a528_frunkOpen m528 : 20|1@1+ (1,0) [0|0] "" Vector__XXX
 SG_ VCFRONT_a548_LVBatteryCannotSupportVehicle m548 : 20|1@1+ (1,0) [0|0] "" Vector__XXX
 SG_ VCFRONT_a552_epas3pSelfTestResult m552 : 20|4@1+ (1,0) [0|0] "" Vector__XXX
 SG_ VCFRONT_a556_vehiclePowerState m556 : 20|2@1+ (1,0) [0|0] "" Vector__XXX
 SG_ VCFRONT_a560_highSHCabinCooling m560 : 20|1@1+ (1,0) [0|0] "" Vector__XXX
 SG_ VCFRONT_a565_steeringWheelButtonInteraction m565 : 20|1@1+ (1,0) [0|0] "" Vector__XXX
 SG_ VCFRONT_a583_shadowSwitchGroupStateNext m583 : 20|2@1+ (1,0) [0|0] "" Vector__XXX
 SG_ VCFRONT_a584_frunkSwitchGroupRequestCurrent m584 : 20|2@1+ (1,0) [0|0] "" Vector__XXX
 SG_ VCFRONT_a587_LVBMS_packCurrent_valid m587 : 20|1@1+ (1,0) [0|0] "" Vector__XXX
 SG_ VCFRONT_a595_vehiclePowerState m595 : 20|2@1+ (1,0) [0|0] "" Vector__XXX
 SG_ VCFRONT_a600_vehiclePowerState m600 : 20|2@1+ (1,0) [0|0] "" Vector__XXX
 SG_ VCFRONT_a606_coolantTempTooHigh m606 : 20|1@1+ (1,0) [0|0] "" Vector__XXX
 SG_ VCFRONT_a610_dataBufferBits m610 : 20|10@1+ (1,0) [0|0] "" Vector__XXX
 SG_ VCFRONT_a612_vehicleSpeed m612 : 20|12@1+ (0.08,-40) [0|0] "" Vector__XXX
 SG_ VCFRONT_a614_octovalveFaulted m614 : 20|1@1+ (1,0) [0|0] "" Vector__XXX
 SG_ VCFRONT_a619_switchTransitionTimeMS m619 : 20|12@1+ (1,0) [0|0] "" Vector__XXX
 SG_ VCFRONT_a623_vehicleSpeed m623 : 20|12@1+ (0.08,-40) [0|0] "" Vector__XXX
 SG_ VCFRONT_a635_chBusAwake m635 : 20|1@1+ (1,0) [0|0] "" Vector__XXX
 SG_ VCFRONT_a644_washPumpHealthState m644 : 20|3@1+ (1,0) [0|0] "" Vector__XXX
 SG_ VCFRONT_a665_retryCount m665 : 20|3@1+ (1,0) [0|0] "" Vector__XXX
 SG_ VCFRONT_a666_retryCount m666 : 20|3@1+ (1,0) [0|0] "" Vector__XXX
 SG_ VCFRONT_a669_defrostEnabled m669 : 20|1@1+ (1,0) [0|0] "" Vector__XXX
 SG_ VCFRONT_a004_EPAS3PNotInSpecOrMIA m4 : 21|1@1+ (1,0) [0|0] "" Vector__XXX
 SG_ VCFRONT_a008_EPAS3PNotInSpecOrMIA m8 : 21|1@1+ (1,0) [0|0] "" Vector__XXX
 SG_ VCFRONT_a009_completed m9 : 21|1@1+ (1,0) [0|0] "" Vector__XXX
 SG_ VCFRONT_a012_ExternalReset m12 : 21|1@1+ (1,0) [0|0] "" Vector__XXX
 SG_ VCFRONT_a021_Task10msMissed m21 : 21|1@1+ (1,0) [0|0] "" Vector__XXX
 SG_ VCFRONT_a032_sleeping m32 : 21|1@1+ (1,0) [0|0] "" Vector__XXX
 SG_ VCFRONT_a038_privilegedRead m38 : 21|1@1+ (1,0) [0|0] "" Vector__XXX
 SG_ VCFRONT_a047_Mcwdt0 m47 : 21|1@1+ (1,0) [0|0] "" Vector__XXX
 SG_ VCFRONT_a086_VEH_lightStatus m86 : 21|1@1+ (1,0) [0|0] "" Vector__XXX
 SG_ VCFRONT_a087_PARTY_status m87 : 21|1@1+ (1,0) [0|0] "" Vector__XXX
 SG_ VCFRONT_a088_PARTY_status m88 : 21|1@1+ (1,0) [0|0] "" Vector__XXX
 SG_ VCFRONT_a089_CH_status m89 : 21|1@1+ (1,0) [0|0] "" Vector__XXX
 SG_ VCFRONT_a098_VEH_torque m98 : 21|1@1+ (1,0) [0|0] "" Vector__XXX
 SG_ VCFRONT_a103_VEH_evseStatus m103 : 21|1@1+ (1,0) [0|0] "" Vector__XXX
 SG_ VCFRONT_a104_VEH_thermalStatus m104 : 21|1@1+ (1,0) [0|0] "" Vector__XXX
 SG_ VCFRONT_a107_VEH_powerAvailable m107 : 21|1@1+ (1,0) [0|0] "" Vector__XXX
 SG_ VCFRONT_a108_PARTY_torque m108 : 21|1@1+ (1,0) [0|0] "" Vector__XXX
 SG_ VCFRONT_a109_VEH_imuOffsets m109 : 21|1@1+ (1,0) [0|0] "" Vector__XXX
 SG_ VCFRONT_a110_VEH_vehNm m110 : 21|1@1+ (1,0) [0|0] "" Vector__XXX
 SG_ VCFRONT_a111_RIPC_railStatus m111 : 21|1@1+ (1,0) [0|0] "" Vector__XXX
 SG_ VCFRONT_a112_LIPC_railStatus m112 : 21|1@1+ (1,0) [0|0] "" Vector__XXX
 SG_ VCFRONT_a113_VEH_peripheralPowerRequests m113 : 21|1@1+ (1,0) [0|0] "" Vector__XXX
 SG_ VCFRONT_a114_VEH_party3 m114 : 21|1@1+ (1,0) [0|0] "" Vector__XXX
 SG_ VCFRONT_a115_REM_authentication m115 : 21|1@1+ (1,0) [0|0] "" Vector__XXX
 SG_ VCFRONT_a116_VEH_lightStatus m116 : 21|1@1+ (1,0) [0|0] "" Vector__XXX
 SG_ VCFRONT_a117_VEH_hvacBlowerFdb m117 : 21|1@1+ (1,0) [0|0] "" Vector__XXX
 SG_ VCFRONT_a118_VEH_LVPowerState m118 : 21|1@1+ (1,0) [0|0] "" Vector__XXX
 SG_ VCFRONT_a119_PARTY_steerAngle m119 : 21|1@1+ (1,0) [0|0] "" Vector__XXX
 SG_ VCFRONT_a120_VEH_torque m120 : 21|1@1+ (1,0) [0|0] "" Vector__XXX
 SG_ VCFRONT_a142_driverThermShutdown m142 : 21|1@1+ (1,0) [0|0] "" Vector__XXX
 SG_ VCFRONT_a153_frontDriverDoorOpen m153 : 21|1@1+ (1,0) [0|0] "" Vector__XXX
 SG_ VCFRONT_a160_faultSnsDischTemp m160 : 21|1@1+ (1,0) [0|0] "" Vector__XXX
 SG_ VCFRONT_a161_shortCircuit m161 : 21|1@1+ (1,0) [0|0] "" Vector__XXX
 SG_ VCFRONT_a171_HVP m171 : 21|1@1+ (1,0) [0|0] "" Vector__XXX
 SG_ VCFRONT_a178_abortCompNeverOn m178 : 21|1@1+ (1,0) [0|0] "" Vector__XXX
 SG_ VCFRONT_a182_postPORExcessiveAh m182 : 21|1@1+ (1,0) [0|0] "" Vector__XXX
 SG_ VCFRONT_a183_postPORExcessiveAh m183 : 21|1@1+ (1,0) [0|0] "" Vector__XXX
 SG_ VCFRONT_a191_reverseBatteryEFuseFault m191 : 21|1@1+ (1,0) [0|0] "" Vector__XXX
 SG_ VCFRONT_a192_notEnoughPowerForSupport m192 : 21|1@1+ (1,0) [0|0] "" Vector__XXX
 SG_ VCFRONT_a216_vcleftFastBlowDebounceImminent m216 : 21|1@1+ (1,0) [0|0] "" Vector__XXX
 SG_ VCFRONT_a221_overTemperature m221 : 21|1@1+ (1,0) [0|0] "" Vector__XXX
 SG_ VCFRONT_a222_overTemperature m222 : 21|1@1+ (1,0) [0|0] "" Vector__XXX
 SG_ VCFRONT_a271_prechargeLVLoadReductionTrigger m271 : 21|1@1+ (1,0) [0|0] "" Vector__XXX
 SG_ VCFRONT_a274_prechargeLVLoadReductionTrigger m274 : 21|1@1+ (1,0) [0|0] "" Vector__XXX
 SG_ VCFRONT_a275_bmbCommStatusTypeA m275 : 21|2@1+ (1,0) [0|0] "" Vector__XXX
 SG_ VCFRONT_a276_bmbCommStatusTypeA m276 : 21|2@1+ (1,0) [0|0] "" Vector__XXX
 SG_ VCFRONT_a284_driverThermShutdown m284 : 21|1@1+ (1,0) [0|0] "" Vector__XXX
 SG_ VCFRONT_a285_driverThermShutdown m285 : 21|1@1+ (1,0) [0|0] "" Vector__XXX
 SG_ VCFRONT_a286_driverThermShutdown m286 : 21|1@1+ (1,0) [0|0] "" Vector__XXX
 SG_ VCFRONT_a287_driverThermShutdown m287 : 21|1@1+ (1,0) [0|0] "" Vector__XXX
 SG_ VCFRONT_a288_driverThermShutdown m288 : 21|1@1+ (1,0) [0|0] "" Vector__XXX
 SG_ VCFRONT_a289_driverThermShutdown m289 : 21|1@1+ (1,0) [0|0] "" Vector__XXX
 SG_ VCFRONT_a290_overTemperature m290 : 21|1@1+ (1,0) [0|0] "" Vector__XXX
 SG_ VCFRONT_a291_overTemperature m291 : 21|1@1+ (1,0) [0|0] "" Vector__XXX
 SG_ VCFRONT_a292_overTemperature m292 : 21|1@1+ (1,0) [0|0] "" Vector__XXX
 SG_ VCFRONT_a293_overTemperature m293 : 21|1@1+ (1,0) [0|0] "" Vector__XXX
 SG_ VCFRONT_a294_overTemperature m294 : 21|1@1+ (1,0) [0|0] "" Vector__XXX
 SG_ VCFRONT_a295_overTemperature m295 : 21|1@1+ (1,0) [0|0] "" Vector__XXX
 SG_ VCFRONT_a371_prechargeLVLoadReductionTrigger m371 : 21|1@1+ (1,0) [0|0] "" Vector__XXX
 SG_ VCFRONT_a380_driverOpenLoad m380 : 21|1@1+ (1,0) [0|0] "" Vector__XXX
 SG_ VCFRONT_a381_driverOpenLoad m381 : 21|1@1+ (1,0) [0|0] "" Vector__XXX
 SG_ VCFRONT_a382_driverOpenLoad m382 : 21|1@1+ (1,0) [0|0] "" Vector__XXX
 SG_ VCFRONT_a383_driverOpenLoad m383 : 21|1@1+ (1,0) [0|0] "" Vector__XXX
 SG_ VCFRONT_a384_driverOpenLoad m384 : 21|1@1+ (1,0) [0|0] "" Vector__XXX
 SG_ VCFRONT_a385_driverOpenLoad m385 : 21|1@1+ (1,0) [0|0] "" Vector__XXX
 SG_ VCFRONT_a386_driverOpenLoad m386 : 21|1@1+ (1,0) [0|0] "" Vector__XXX
 SG_ VCFRONT_a391_switch1Voltage m391 : 21|10@1+ (5,0) [0|0] "" Vector__XXX
 SG_ VCFRONT_a446_compStandbyLowAmbient m446 : 21|1@1+ (1,0) [0|0] "" Vector__XXX
 SG_ VCFRONT_a447_scavengeLoopCompromised m447 : 21|1@1+ (1,0) [0|0] "" Vector__XXX
 SG_ VCFRONT_a462_ModuleOTLevel1 m462 : 21|1@1+ (1,0) [0|0] "" Vector__XXX
 SG_ VCFRONT_a463_switch1Voltage m463 : 21|10@1+ (5,0) [0|0] "" Vector__XXX
 SG_ VCFRONT_a476_FRM6_timedOut m476 : 21|1@1+ (1,0) [0|0] "" Vector__XXX
 SG_ VCFRONT_a478_vehiclePowerState m478 : 21|2@1+ (1,0) [0|0] "" Vector__XXX
 SG_ VCFRONT_a479_transportMode m479 : 21|1@1+ (1,0) [0|0] "" Vector__XXX
 SG_ VCFRONT_a480_autoOn m480 : 21|1@1+ (1,0) [0|0] "" Vector__XXX
 SG_ VCFRONT_a489_CCREXV m489 : 21|1@1+ (1,0) [0|0] "" Vector__XXX
 SG_ VCFRONT_a495_DCDCOff m495 : 21|1@1+ (1,0) [0|0] "" Vector__XXX
 SG_ VCFRONT_a496_frunkOpen m496 : 21|1@1+ (1,0) [0|0] "" Vector__XXX
 SG_ VCFRONT_a507_pitchEstimateValid m507 : 21|1@1+ (1,0) [0|0] "" Vector__XXX
 SG_ VCFRONT_a524_pitchEstimateValid m524 : 21|1@1+ (1,0) [0|0] "" Vector__XXX
 SG_ VCFRONT_a548_DI_gear m548 : 21|3@1+ (1,0) [0|0] "" Vector__XXX
 SG_ VCFRONT_a560_highSHCabinHeating m560 : 21|1@1+ (1,0) [0|0] "" Vector__XXX
 SG_ VCFRONT_a561_packTemperature m561 : 21|5@1+ (4,0) [0|0] "" Vector__XXX
 SG_ VCFRONT_a562_packTemperature m562 : 21|5@1+ (4,0) [0|0] "" Vector__XXX
 SG_ VCFRONT_a565_frontDriverDoorOpen m565 : 21|1@1+ (1,0) [0|0] "" Vector__XXX
 SG_ VCFRONT_a587_vehiclePowerState m587 : 21|2@1+ (1,0) [0|0] "" Vector__XXX
 SG_ VCFRONT_a606_chillerExitCoolantTempTooHigh m606 : 21|1@1+ (1,0) [0|0] "" Vector__XXX
 SG_ VCFRONT_a614_battPumpRpm m614 : 21|1@1+ (1,0) [0|0] "" Vector__XXX
 SG_ VCFRONT_a635_hvsBusAwake m635 : 21|1@1+ (1,0) [0|0] "" Vector__XXX
 SG_ VCFRONT_a669_vehiclePowerState m669 : 21|2@1+ (1,0) [0|0] "" Vector__XXX
 SG_ VCFRONT_a009_abortedDeviceFault m9 : 22|1@1+ (1,0) [0|0] "" Vector__XXX
 SG_ VCFRONT_a021_Task100msLate m21 : 22|1@1+ (1,0) [0|0] "" Vector__XXX
 SG_ VCFRONT_a032_sleepdeep m32 : 22|1@1+ (1,0) [0|0] "" Vector__XXX
 SG_ VCFRONT_a038_privilegedWrite m38 : 22|1@1+ (1,0) [0|0] "" Vector__XXX
 SG_ VCFRONT_a047_Mcwdt1 m47 : 22|1@1+ (1,0) [0|0] "" Vector__XXX
 SG_ VCFRONT_a086_VEH_systemStatus m86 : 22|1@1+ (1,0) [0|0] "" Vector__XXX
 SG_ VCFRONT_a087_PARTY_temperature m87 : 22|1@1+ (1,0) [0|0] "" Vector__XXX
 SG_ VCFRONT_a088_PARTY_temperature m88 : 22|1@1+ (1,0) [0|0] "" Vector__XXX
 SG_ VCFRONT_a089_CH_party1 m89 : 22|1@1+ (1,0) [0|0] "" Vector__XXX
 SG_ VCFRONT_a098_PARTY_status m98 : 22|1@1+ (1,0) [0|0] "" Vector__XXX
 SG_ VCFRONT_a104_CH_control m104 : 22|1@1+ (1,0) [0|0] "" Vector__XXX
 SG_ VCFRONT_a107_PT_ptNm m107 : 22|1@1+ (1,0) [0|0] "" Vector__XXX
 SG_ VCFRONT_a108_PARTY_status m108 : 22|1@1+ (1,0) [0|0] "" Vector__XXX
 SG_ VCFRONT_a109_PARTY_inertial1 m109 : 22|1@1+ (1,0) [0|0] "" Vector__XXX
 SG_ VCFRONT_a110_VEH_mismatchFault m110 : 22|1@1+ (1,0) [0|0] "" Vector__XXX
 SG_ VCFRONT_a111_RIPC_remoteADC m111 : 22|1@1+ (1,0) [0|0] "" Vector__XXX
 SG_ VCFRONT_a112_LIPC_remoteADC m112 : 22|1@1+ (1,0) [0|0] "" Vector__XXX
 SG_ VCFRONT_a113_VEH_corianderVehicleControl m113 : 22|1@1+ (1,0) [0|0] "" Vector__XXX
 SG_ VCFRONT_a114_VEH_status m114 : 22|1@1+ (1,0) [0|0] "" Vector__XXX
 SG_ VCFRONT_a115_UI_corianderVehicleControl m115 : 22|1@1+ (1,0) [0|0] "" Vector__XXX
 SG_ VCFRONT_a116_VEH_seatStatus m116 : 22|1@1+ (1,0) [0|0] "" Vector__XXX
 SG_ VCFRONT_a117_VEH_LVPowerState m117 : 22|1@1+ (1,0) [0|0] "" Vector__XXX
 SG_ VCFRONT_a118_VEH_coolant m118 : 22|1@1+ (1,0) [0|0] "" Vector__XXX
 SG_ VCFRONT_a120_PARTY_locStatus m120 : 22|1@1+ (1,0) [0|0] "" Vector__XXX
 SG_ VCFRONT_a142_undervoltage m142 : 22|1@1+ (1,0) [0|0] "" Vector__XXX
 SG_ VCFRONT_a153_frontPassengerDoorOpen m153 : 22|1@1+ (1,0) [0|0] "" Vector__XXX
 SG_ VCFRONT_a160_faultSnsSuctPress m160 : 22|1@1+ (1,0) [0|0] "" Vector__XXX
 SG_ VCFRONT_a161_underTemperature m161 : 22|1@1+ (1,0) [0|0] "" Vector__XXX
 SG_ VCFRONT_a162_chillerExvFlow m162 : 22|7@1+ (1,0) [0|0] "" Vector__XXX
 SG_ VCFRONT_a171_GTW m171 : 22|1@1+ (1,0) [0|0] "" Vector__XXX
 SG_ VCFRONT_a178_abortCompTurnedOff m178 : 22|1@1+ (1,0) [0|0] "" Vector__XXX
 SG_ VCFRONT_a182_resistanceEstimationHardFailure m182 : 22|1@1+ (1,0) [0|0] "" Vector__XXX
 SG_ VCFRONT_a183_resistanceEstimationHardFailure m183 : 22|1@1+ (1,0) [0|0] "" Vector__XXX
 SG_ VCFRONT_a190_bus m190 : 22|6@1+ (1,0) [0|0] "" Vector__XXX
 SG_ VCFRONT_a191_vehicleLoadShedActive m191 : 22|1@1+ (1,0) [0|0] "" Vector__XXX
 SG_ VCFRONT_a192_pcsEFuseStable m192 : 22|1@1+ (1,0) [0|0] "" Vector__XXX
 SG_ VCFRONT_a216_vcleftStaticImminent m216 : 22|1@1+ (1,0) [0|0] "" Vector__XXX
 SG_ VCFRONT_a271_instantPrechargeDCRTooHighTrigger m271 : 22|1@1+ (1,0) [0|0] "" Vector__XXX
 SG_ VCFRONT_a274_instantPrechargeDCRTooHighTrigger m274 : 22|1@1+ (1,0) [0|0] "" Vector__XXX
 SG_ VCFRONT_a284_undervoltage m284 : 22|1@1+ (1,0) [0|0] "" Vector__XXX
 SG_ VCFRONT_a285_undervoltage m285 : 22|1@1+ (1,0) [0|0] "" Vector__XXX
 SG_ VCFRONT_a286_undervoltage m286 : 22|1@1+ (1,0) [0|0] "" Vector__XXX
 SG_ VCFRONT_a287_undervoltage m287 : 22|1@1+ (1,0) [0|0] "" Vector__XXX
 SG_ VCFRONT_a288_undervoltage m288 : 22|1@1+ (1,0) [0|0] "" Vector__XXX
 SG_ VCFRONT_a289_undervoltage m289 : 22|1@1+ (1,0) [0|0] "" Vector__XXX
 SG_ VCFRONT_a366_timeout m366 : 22|1@1+ (1,0) [0|0] "" Vector__XXX
 SG_ VCFRONT_a371_instantPrechargeDCRTooHighTrigger m371 : 22|1@1+ (1,0) [0|0] "" Vector__XXX
 SG_ VCFRONT_a378_wiperUndervoltage m378 : 22|1@1+ (1,0) [0|0] "" Vector__XXX
 SG_ VCFRONT_a390_lowSideHX m390 : 22|2@1+ (1,0) [0|0] "" Vector__XXX
 SG_ VCFRONT_a415_LVBatteryTemp m415 : 22|7@1+ (1,-40) [0|0] "" Vector__XXX
 SG_ VCFRONT_a446_compStandbyLowDischPress m446 : 22|1@1+ (1,0) [0|0] "" Vector__XXX
 SG_ VCFRONT_a447_coolantSystemCompromised m447 : 22|1@1+ (1,0) [0|0] "" Vector__XXX
 SG_ VCFRONT_a462_PackOVLevel1 m462 : 22|1@1+ (1,0) [0|0] "" Vector__XXX
 SG_ VCFRONT_a474_ssl100Bank4Status m474 : 22|2@1+ (1,0) [0|0] "" Vector__XXX
 SG_ VCFRONT_a475_ssl100Bank4Status m475 : 22|2@1+ (1,0) [0|0] "" Vector__XXX
 SG_ VCFRONT_a476_FRM7_timedOut m476 : 22|1@1+ (1,0) [0|0] "" Vector__XXX
 SG_ VCFRONT_a480_diagnosticBit m480 : 22|1@1+ (1,0) [0|0] "" Vector__XXX
 SG_ VCFRONT_a489_SOV m489 : 22|1@1+ (1,0) [0|0] "" Vector__XXX
 SG_ VCFRONT_a495_HVOff m495 : 22|1@1+ (1,0) [0|0] "" Vector__XXX
 SG_ VCFRONT_a496_PCS_MIA m496 : 22|1@1+ (1,0) [0|0] "" Vector__XXX
 SG_ VCFRONT_a507_isAcceptableGear m507 : 22|1@1+ (1,0) [0|0] "" Vector__XXX
 SG_ VCFRONT_a524_isAcceptableGear m524 : 22|1@1+ (1,0) [0|0] "" Vector__XXX
 SG_ VCFRONT_a545_serviceMode m545 : 22|1@1+ (1,0) [0|0] "" Vector__XXX
 SG_ VCFRONT_a560_highSHCatchAll m560 : 22|1@1+ (1,0) [0|0] "" Vector__XXX
 SG_ VCFRONT_a565_frontPassengerDoorOpen m565 : 22|1@1+ (1,0) [0|0] "" Vector__XXX
 SG_ VCFRONT_a583_referenceSwitchGroupStateSimpleNext m583 : 22|2@1+ (1,0) [0|0] "" Vector__XXX
 SG_ VCFRONT_a584_frunkSwitchGroupRequestPrevious m584 : 22|2@1+ (1,0) [0|0] "" Vector__XXX
 SG_ VCFRONT_a606_ductTempOvershoot m606 : 22|1@1+ (1,0) [0|0] "" Vector__XXX
 SG_ VCFRONT_a614_battPumpFault m614 : 22|1@1+ (1,0) [0|0] "" Vector__XXX
 SG_ VCFRONT_a635_partyBusAwake m635 : 22|1@1+ (1,0) [0|0] "" Vector__XXX
 SG_ VCFRONT_a009_abortedLowPs m9 : 23|1@1+ (1,0) [0|0] "" Vector__XXX
 SG_ VCFRONT_a021_Task100msStarved m21 : 23|1@1+ (1,0) [0|0] "" Vector__XXX
 SG_ VCFRONT_a032_pwrDone m32 : 23|1@1+ (1,0) [0|0] "" Vector__XXX
 SG_ VCFRONT_a038_privilegedExecute m38 : 23|1@1+ (1,0) [0|0] "" Vector__XXX
 SG_ VCFRONT_a047_Mcwdt2 m47 : 23|1@1+ (1,0) [0|0] "" Vector__XXX
 SG_ VCFRONT_a086_VEH_thermalStatus m86 : 23|1@1+ (1,0) [0|0] "" Vector__XXX
 SG_ VCFRONT_a087_PARTY_thermalControl m87 : 23|1@1+ (1,0) [0|0] "" Vector__XXX
 SG_ VCFRONT_a088_PARTY_thermalControl m88 : 23|1@1+ (1,0) [0|0] "" Vector__XXX
 SG_ VCFRONT_a089_CH_party3 m89 : 23|1@1+ (1,0) [0|0] "" Vector__XXX
 SG_ VCFRONT_a098_PARTY_temperature m98 : 23|1@1+ (1,0) [0|0] "" Vector__XXX
 SG_ VCFRONT_a104_PARTY_control m104 : 23|1@1+ (1,0) [0|0] "" Vector__XXX
 SG_ VCFRONT_a107_PT_status m107 : 23|1@1+ (1,0) [0|0] "" Vector__XXX
 SG_ VCFRONT_a108_PARTY_temperature m108 : 23|1@1+ (1,0) [0|0] "" Vector__XXX
 SG_ VCFRONT_a109_BDY_imuOffsets m109 : 23|1@1+ (1,0) [0|0] "" Vector__XXX
 SG_ VCFRONT_a110_VEH_vin m110 : 23|1@1+ (1,0) [0|0] "" Vector__XXX
 SG_ VCFRONT_a111_RIPC_switchStatus m111 : 23|1@1+ (1,0) [0|0] "" Vector__XXX
 SG_ VCFRONT_a112_LIPC_switchStatus m112 : 23|1@1+ (1,0) [0|0] "" Vector__XXX
 SG_ VCFRONT_a113_VEH_solarData m113 : 23|1@1+ (1,0) [0|0] "" Vector__XXX
 SG_ VCFRONT_a114_PARTY_wheelRotation m114 : 23|1@1+ (1,0) [0|0] "" Vector__XXX
 SG_ VCFRONT_a115_CH_TPMSDisplay m115 : 23|1@1+ (1,0) [0|0] "" Vector__XXX
 SG_ VCFRONT_a116_VEH_thsStatus m116 : 23|1@1+ (1,0) [0|0] "" Vector__XXX
 SG_ VCFRONT_a117_VEH_restraintStatus m117 : 23|1@1+ (1,0) [0|0] "" Vector__XXX
 SG_ VCFRONT_a118_VEH_vehicleStatus m118 : 23|1@1+ (1,0) [0|0] "" Vector__XXX
 SG_ VCFRONT_a120_PARTY_speed m120 : 23|1@1+ (1,0) [0|0] "" Vector__XXX
 SG_ VCFRONT_a142_chargePumpUndervoltage m142 : 23|1@1+ (1,0) [0|0] "" Vector__XXX
 SG_ VCFRONT_a153_rearDriverDoorOpen m153 : 23|1@1+ (1,0) [0|0] "" Vector__XXX
 SG_ VCFRONT_a160_faultSnsSuctTemp m160 : 23|1@1+ (1,0) [0|0] "" Vector__XXX
 SG_ VCFRONT_a161_LVUnderVoltage m161 : 23|1@1+ (1,0) [0|0] "" Vector__XXX
 SG_ VCFRONT_a171_CP m171 : 23|1@1+ (1,0) [0|0] "" Vector__XXX
 SG_ VCFRONT_a178_abortCompOvershoot m178 : 23|1@1+ (1,0) [0|0] "" Vector__XXX
 SG_ VCFRONT_a182_dcrMilliOhmsAboveThreshold m182 : 23|1@1+ (1,0) [0|0] "" Vector__XXX
 SG_ VCFRONT_a183_dcrMilliOhmsAboveThreshold m183 : 23|1@1+ (1,0) [0|0] "" Vector__XXX
 SG_ VCFRONT_a191_vehicleLoadShedHvFaultActive m191 : 23|1@1+ (1,0) [0|0] "" Vector__XXX
 SG_ VCFRONT_a192_vcrightEFuseStable m192 : 23|1@1+ (1,0) [0|0] "" Vector__XXX
 SG_ VCFRONT_a216_vcleftDynamicImminent m216 : 23|1@1+ (1,0) [0|0] "" Vector__XXX
 SG_ VCFRONT_a284_chargePumpUndervoltage m284 : 23|1@1+ (1,0) [0|0] "" Vector__XXX
 SG_ VCFRONT_a285_chargePumpUndervoltage m285 : 23|1@1+ (1,0) [0|0] "" Vector__XXX
 SG_ VCFRONT_a286_chargePumpUndervoltage m286 : 23|1@1+ (1,0) [0|0] "" Vector__XXX
 SG_ VCFRONT_a287_chargePumpUndervoltage m287 : 23|1@1+ (1,0) [0|0] "" Vector__XXX
 SG_ VCFRONT_a288_chargePumpUndervoltage m288 : 23|1@1+ (1,0) [0|0] "" Vector__XXX
 SG_ VCFRONT_a289_chargePumpUndervoltage m289 : 23|1@1+ (1,0) [0|0] "" Vector__XXX
 SG_ VCFRONT_a365_timeout m365 : 23|1@1+ (1,0) [0|0] "" Vector__XXX
 SG_ VCFRONT_a366_notInConditioning m366 : 23|1@1+ (1,0) [0|0] "" Vector__XXX
 SG_ VCFRONT_a378_wiperOvervoltage m378 : 23|1@1+ (1,0) [0|0] "" Vector__XXX
 SG_ VCFRONT_a446_compStandbyHVNotReady m446 : 23|1@1+ (1,0) [0|0] "" Vector__XXX
 SG_ VCFRONT_a447_hvBattActiveDischgCompromised m447 : 23|1@1+ (1,0) [0|0] "" Vector__XXX
 SG_ VCFRONT_a462_PackOVLevel2 m462 : 23|1@1+ (1,0) [0|0] "" Vector__XXX
 SG_ VCFRONT_a476_FRM8_timedOut m476 : 23|1@1+ (1,0) [0|0] "" Vector__XXX
 SG_ VCFRONT_a480_deviceError m480 : 23|1@1+ (1,0) [0|0] "" Vector__XXX
 SG_ VCFRONT_a495_externalInteraction m495 : 23|1@1+ (1,0) [0|0] "" Vector__XXX
 SG_ VCFRONT_a496_NotEnoughPowerForSupport m496 : 23|1@1+ (1,0) [0|0] "" Vector__XXX
 SG_ VCFRONT_a507_isAcceptablePowerState m507 : 23|1@1+ (1,0) [0|0] "" Vector__XXX
 SG_ VCFRONT_a514_cell2Voltage m514 : 23|7@1+ (0.08,0) [0|0] "" Vector__XXX
 SG_ VCFRONT_a515_cell2Voltage m515 : 23|7@1+ (0.08,0) [0|0] "" Vector__XXX
 SG_ VCFRONT_a524_isAcceptablePowerState m524 : 23|1@1+ (1,0) [0|0] "" Vector__XXX
 SG_ VCFRONT_a545_factoryGated m545 : 23|1@1+ (1,0) [0|0] "" Vector__XXX
 SG_ VCFRONT_a565_rearDriverDoorOpen m565 : 23|1@1+ (1,0) [0|0] "" Vector__XXX
 SG_ VCFRONT_a606_chillerLoadBeforeEntry m606 : 23|7@1+ (50.38582677165354,0) [0|0] "" Vector__XXX
 SG_ VCFRONT_a614_ptPumpRpm m614 : 23|1@1+ (1,0) [0|0] "" Vector__XXX
 SG_ VCFRONT_a635_ethBusAwake m635 : 23|1@1+ (1,0) [0|0] "" Vector__XXX
 SG_ VCFRONT_a644_validWashCycle m644 : 23|1@1+ (1,0) [0|0] "" Vector__XXX
 SG_ VCFRONT_a665_isWaitingToClear m665 : 23|1@1+ (1,0) [0|0] "" Vector__XXX
 SG_ VCFRONT_a666_isWaitingToClear m666 : 23|1@1+ (1,0) [0|0] "" Vector__XXX
 SG_ VCFRONT_a669_hvState m669 : 23|3@1+ (1,0) [0|0] "" Vector__XXX
 SG_ VCFRONT_a006_mailboxID m6 : 24|8@1+ (1,0) [0|0] "" Vector__XXX
 SG_ VCFRONT_a009_abortedCOP1BattHeatRequested m9 : 24|1@1+ (1,0) [0|0] "" Vector__XXX
 SG_ VCFRONT_a021_Task100msMissed m21 : 24|1@1+ (1,0) [0|0] "" Vector__XXX
 SG_ VCFRONT_a022_TaskInitError0 m22 : 24|8@1+ (1,0) [0|0] "" Vector__XXX
 SG_ VCFRONT_a031_uds_bytes_1 m31 : 24|8@1+ (1,0) [0|0] "" Vector__XXX
 SG_ VCFRONT_a033_syndrome m33 : 24|8@1+ (1,0) [0|0] "" Vector__XXX
 SG_ VCFRONT_a038_nonSecure m38 : 24|1@1+ (1,0) [0|0] "" Vector__XXX
 SG_ VCFRONT_a039_faultAddress m39 : 24|32@1+ (1,0) [0|0] "" Vector__XXX
 SG_ VCFRONT_a040_programCounter m40 : 24|32@1+ (1,0) [0|0] "" Vector__XXX
 SG_ VCFRONT_a041_CPULoad1msTask m41 : 24|8@1+ (1,0) [0|0] "" Vector__XXX
 SG_ VCFRONT_a042_Usage10msTask m42 : 24|8@1+ (1,0) [0|0] "" Vector__XXX
 SG_ VCFRONT_a047_Mcwdt3 m47 : 24|1@1+ (1,0) [0|0] "" Vector__XXX
 SG_ VCFRONT_a063_switchType m63 : 24|8@1+ (1,0) [0|0] "" Vector__XXX
 SG_ VCFRONT_a086_VEH_vehNm m86 : 24|1@1+ (1,0) [0|0] "" Vector__XXX
 SG_ VCFRONT_a087_VEH_motorStatus m87 : 24|1@1+ (1,0) [0|0] "" Vector__XXX
 SG_ VCFRONT_a088_VEH_motorStatus m88 : 24|1@1+ (1,0) [0|0] "" Vector__XXX
 SG_ VCFRONT_a089_VEH_party1 m89 : 24|1@1+ (1,0) [0|0] "" Vector__XXX
 SG_ VCFRONT_a098_PARTY_thermalControl m98 : 24|1@1+ (1,0) [0|0] "" Vector__XXX
 SG_ VCFRONT_a104_PARTY_bodyControls m104 : 24|1@1+ (1,0) [0|0] "" Vector__XXX
 SG_ VCFRONT_a107_PT_thermalStatus m107 : 24|1@1+ (1,0) [0|0] "" Vector__XXX
 SG_ VCFRONT_a108_PARTY_thermalControl m108 : 24|1@1+ (1,0) [0|0] "" Vector__XXX
 SG_ VCFRONT_a109_BDY_inertial1 m109 : 24|1@1+ (1,0) [0|0] "" Vector__XXX
 SG_ VCFRONT_a110_VEH_bmpDebug m110 : 24|1@1+ (1,0) [0|0] "" Vector__XXX
 SG_ VCFRONT_a111_VEH_LVPowerState m111 : 24|1@1+ (1,0) [0|0] "" Vector__XXX
 SG_ VCFRONT_a112_VEH_LVPowerState m112 : 24|1@1+ (1,0) [0|0] "" Vector__XXX
 SG_ VCFRONT_a113_VEH_ventCntlReq m113 : 24|1@1+ (1,0) [0|0] "" Vector__XXX
 SG_ VCFRONT_a114_CH_wheelRotation m114 : 24|1@1+ (1,0) [0|0] "" Vector__XXX
 SG_ VCFRONT_a116_VEH_doorStatus m116 : 24|1@1+ (1,0) [0|0] "" Vector__XXX
 SG_ VCFRONT_a117_VEH_lightStatus m117 : 24|1@1+ (1,0) [0|0] "" Vector__XXX
 SG_ VCFRONT_a118_VEH_12VBatteryStatus m118 : 24|1@1+ (1,0) [0|0] "" Vector__XXX
 SG_ VCFRONT_a120_VEH_speed m120 : 24|1@1+ (1,0) [0|0] "" Vector__XXX
 SG_ VCFRONT_a142_isCoilOpenX m142 : 24|1@1+ (1,0) [0|0] "" Vector__XXX
 SG_ VCFRONT_a153_rearPassengerDoorOpen m153 : 24|1@1+ (1,0) [0|0] "" Vector__XXX
 SG_ VCFRONT_a155_minHVComingUpIBSVoltage m155 : 24|11@1+ (0.005,5) [0|0] "" Vector__XXX
 SG_ VCFRONT_a160_faultSnsAmbientTemp m160 : 24|1@1+ (1,0) [0|0] "" Vector__XXX
 SG_ VCFRONT_a161_LVOverVoltage m161 : 24|1@1+ (1,0) [0|0] "" Vector__XXX
 SG_ VCFRONT_a163_failureConfidence m163 : 24|7@1+ (1,0) [0|0] "" Vector__XXX
 SG_ VCFRONT_a171_PCS m171 : 24|1@1+ (1,0) [0|0] "" Vector__XXX
 SG_ VCFRONT_a178_abortCompLimited m178 : 24|1@1+ (1,0) [0|0] "" Vector__XXX
 SG_ VCFRONT_a180_bmsState m180 : 24|4@1+ (1,0) [0|0] "" Vector__XXX
 SG_ VCFRONT_a182_prechargeLVLoadReduction m182 : 24|1@1+ (1,0) [0|0] "" Vector__XXX
 SG_ VCFRONT_a183_prechargeLVLoadReduction m183 : 24|1@1+ (1,0) [0|0] "" Vector__XXX
 SG_ VCFRONT_a184_ptInlet m184 : 24|6@1+ (2,0) [0|0] "" Vector__XXX
 SG_ VCFRONT_a188_IBSCurrent m188 : 24|12@1- (0.02,0) [0|0] "" Vector__XXX
 SG_ VCFRONT_a191_vehicleLoadShedPostCrashActive m191 : 24|1@1+ (1,0) [0|0] "" Vector__XXX
 SG_ VCFRONT_a192_contactorEFuseStable m192 : 24|1@1+ (1,0) [0|0] "" Vector__XXX
 SG_ VCFRONT_a196_batterySMState m196 : 24|4@1+ (1,0) [0|0] "" Vector__XXX
 SG_ VCFRONT_a216_vcrightFastBlowImminent m216 : 24|1@1+ (1,0) [0|0] "" Vector__XXX
 SG_ VCFRONT_a242_IBSCurrent m242 : 24|12@1- (0.1,0) [0|0] "" Vector__XXX
 SG_ VCFRONT_a269_IBSCurrent m269 : 24|12@1- (0.1,0) [0|0] "" Vector__XXX
 SG_ VCFRONT_a275_breakLocationB m275 : 24|5@1+ (1,0) [0|0] "" Vector__XXX
 SG_ VCFRONT_a276_breakLocationB m276 : 24|5@1+ (1,0) [0|0] "" Vector__XXX
 SG_ VCFRONT_a283_thmlFanDemand m283 : 24|7@1+ (1,0) [0|0] "" Vector__XXX
 SG_ VCFRONT_a284_isCoilOpenX m284 : 24|1@1+ (1,0) [0|0] "" Vector__XXX
 SG_ VCFRONT_a285_isCoilOpenX m285 : 24|1@1+ (1,0) [0|0] "" Vector__XXX
 SG_ VCFRONT_a286_isCoilOpenX m286 : 24|1@1+ (1,0) [0|0] "" Vector__XXX
 SG_ VCFRONT_a287_isCoilOpenX m287 : 24|1@1+ (1,0) [0|0] "" Vector__XXX
 SG_ VCFRONT_a288_isCoilOpenX m288 : 24|1@1+ (1,0) [0|0] "" Vector__XXX
 SG_ VCFRONT_a289_isCoilOpenX m289 : 24|1@1+ (1,0) [0|0] "" Vector__XXX
 SG_ VCFRONT_a296_timeInDown2 m296 : 24|32@1+ (1,0) [0|0] "" Vector__XXX
 SG_ VCFRONT_a297_bmbDeviceFaultTempMask m297 : 24|8@1+ (1,0) [0|0] "" Vector__XXX
 SG_ VCFRONT_a304_temperature m304 : 24|8@1+ (0.5,-40) [0|0] "" Vector__XXX
 SG_ VCFRONT_a305_temperature m305 : 24|8@1+ (0.5,-40) [0|0] "" Vector__XXX
 SG_ VCFRONT_a306_temperature m306 : 24|8@1+ (0.5,-40) [0|0] "" Vector__XXX
 SG_ VCFRONT_a307_temperature m307 : 24|8@1+ (0.5,-40) [0|0] "" Vector__XXX
 SG_ VCFRONT_a308_temperature m308 : 24|8@1+ (0.5,-40) [0|0] "" Vector__XXX
 SG_ VCFRONT_a353_batteryVoltage m353 : 24|7@1+ (0.15,0) [0|0] "" Vector__XXX
 SG_ VCFRONT_a354_batteryVoltage m354 : 24|7@1+ (0.15,0) [0|0] "" Vector__XXX
 SG_ VCFRONT_a365_notInConditioning m365 : 24|1@1+ (1,0) [0|0] "" Vector__XXX
 SG_ VCFRONT_a366_heatPumpFlowRequest m366 : 24|1@1+ (1,0) [0|0] "" Vector__XXX
 SG_ VCFRONT_a368_bmsSoc m368 : 24|8@1+ (0.5,0) [0|0] "" Vector__XXX
 SG_ VCFRONT_a369_bmsSoc m369 : 24|8@1+ (0.5,0) [0|0] "" Vector__XXX
 SG_ VCFRONT_a372_bmbDeviceFaultBrickMask m372 : 24|16@1+ (1,0) [0|0] "" Vector__XXX
 SG_ VCFRONT_a378_wiperLINError m378 : 24|1@1+ (1,0) [0|0] "" Vector__XXX
 SG_ VCFRONT_a380_commLostError m380 : 24|3@1+ (1,0) [0|0] "" Vector__XXX
 SG_ VCFRONT_a381_commLostError m381 : 24|3@1+ (1,0) [0|0] "" Vector__XXX
 SG_ VCFRONT_a382_commLostError m382 : 24|3@1+ (1,0) [0|0] "" Vector__XXX
 SG_ VCFRONT_a383_commLostError m383 : 24|3@1+ (1,0) [0|0] "" Vector__XXX
 SG_ VCFRONT_a384_commLostError m384 : 24|3@1+ (1,0) [0|0] "" Vector__XXX
 SG_ VCFRONT_a385_commLostError m385 : 24|3@1+ (1,0) [0|0] "" Vector__XXX
 SG_ VCFRONT_a386_commLostError m386 : 24|3@1+ (1,0) [0|0] "" Vector__XXX
 SG_ VCFRONT_a390_dominantLoad m390 : 24|3@1+ (1,0) [0|0] "" Vector__XXX
 SG_ VCFRONT_a392_bmbDeviceFaultBrickMask m392 : 24|16@1+ (1,0) [0|0] "" Vector__XXX
 SG_ VCFRONT_a401_IBSCurrent m401 : 24|12@1- (0.1,0) [0|0] "" Vector__XXX
 SG_ VCFRONT_a402_batterySMState m402 : 24|4@1+ (1,0) [0|0] "" Vector__XXX
 SG_ VCFRONT_a405_intervalVoltage1 m405 : 24|8@1+ (0.02,9) [0|0] "" Vector__XXX
 SG_ VCFRONT_a406_pulseVoltage2 m406 : 24|8@1+ (0.02,9) [0|0] "" Vector__XXX
 SG_ VCFRONT_a407_dcr12VThreshold m407 : 24|4@1+ (1,0) [0|0] "" Vector__XXX
 SG_ VCFRONT_a410_IBSCurrent m410 : 24|12@1- (0.1,0) [0|0] "" Vector__XXX
 SG_ VCFRONT_a411_IBSCurrent m411 : 24|12@1- (0.1,0) [0|0] "" Vector__XXX
 SG_ VCFRONT_a412_pulseVoltage1Shifted m412 : 24|8@1+ (0.02,9) [0|0] "" Vector__XXX
 SG_ VCFRONT_a414_LVBatteryTemp m414 : 24|7@1+ (1,-40) [0|0] "" Vector__XXX
 SG_ VCFRONT_a428_minBrickCac m428 : 24|13@1+ (0.1,0) [0|0] "" Vector__XXX
 SG_ VCFRONT_a444_channel m444 : 24|8@1+ (1,0) [0|0] "" Vector__XXX
 SG_ VCFRONT_a445_expectedMSB m445 : 24|8@1+ (1,0) [0|0] "" Vector__XXX
 SG_ VCFRONT_a446_compStandbyCommunication m446 : 24|1@1+ (1,0) [0|0] "" Vector__XXX
 SG_ VCFRONT_a447_hvBatteryDischargingCompromised m447 : 24|1@1+ (1,0) [0|0] "" Vector__XXX
 SG_ VCFRONT_a462_DischrgOCLevel1 m462 : 24|1@1+ (1,0) [0|0] "" Vector__XXX
 SG_ VCFRONT_a464_flowIndexFiltered m464 : 24|8@1+ (1,0) [0|0] "" Vector__XXX
 SG_ VCFRONT_a465_flowIndexFiltered m465 : 24|8@1+ (1,0) [0|0] "" Vector__XXX
 SG_ VCFRONT_a466_flowIndexFiltered m466 : 24|8@1+ (1,0) [0|0] "" Vector__XXX
 SG_ VCFRONT_a469_pressureDischarge m469 : 24|8@1+ (0.2,0) [0|0] "" Vector__XXX
 SG_ VCFRONT_a470_pressureDischarge m470 : 24|8@1+ (0.2,0) [0|0] "" Vector__XXX
 SG_ VCFRONT_a474_ssl100Bank5Status m474 : 24|2@1+ (1,0) [0|0] "" Vector__XXX
 SG_ VCFRONT_a475_ssl100Bank5Status m475 : 24|2@1+ (1,0) [0|0] "" Vector__XXX
 SG_ VCFRONT_a476_FRM9_timedOut m476 : 24|1@1+ (1,0) [0|0] "" Vector__XXX
 SG_ VCFRONT_a478_batterySMState m478 : 24|4@1+ (1,0) [0|0] "" Vector__XXX
 SG_ VCFRONT_a479_frunkLatchStatus m479 : 24|4@1+ (1,0) [0|0] "" Vector__XXX
 SG_ VCFRONT_a480_overcurrent m480 : 24|1@1+ (1,0) [0|0] "" Vector__XXX
 SG_ VCFRONT_a481_timeout m481 : 24|1@1+ (1,0) [0|0] "" Vector__XXX
 SG_ VCFRONT_a483_headlampTemperature_C m483 : 24|8@1+ (0.5,-40) [0|0] "" Vector__XXX
 SG_ VCFRONT_a484_rearRideHeight m484 : 24|8@1- (1,0) [0|0] "" Vector__XXX
 SG_ VCFRONT_a488_headlampTemperature_C m488 : 24|8@1+ (0.5,-40) [0|0] "" Vector__XXX
 SG_ VCFRONT_a492_minBrickSoc m492 : 24|8@1+ (0.5,0) [0|0] "" Vector__XXX
 SG_ VCFRONT_a493_minBrickSocByOcvMax m493 : 24|8@1+ (0.5,0) [0|0] "" Vector__XXX
 SG_ VCFRONT_a495_serviceMode m495 : 24|1@1+ (1,0) [0|0] "" Vector__XXX
 SG_ VCFRONT_a496_bmsState m496 : 24|4@1+ (1,0) [0|0] "" Vector__XXX
 SG_ VCFRONT_a497_SOC m497 : 24|7@1+ (1,0) [0|0] "" Vector__XXX
 SG_ VCFRONT_a498_brickImpedanceNormalized m498 : 24|7@1+ (0.01,0.5) [0|0] "" Vector__XXX
 SG_ VCFRONT_a499_BMSFlowReq m499 : 24|1@1+ (1,0) [0|0] "" Vector__XXX
 SG_ VCFRONT_a500_mismatchedState m500 : 24|3@1+ (1,0) [0|0] "" Vector__XXX
 SG_ VCFRONT_a502_minBrickVDelta m502 : 24|15@1- (0.0005,0) [0|0] "" Vector__XXX
 SG_ VCFRONT_a507_headlampHealth m507 : 24|3@1+ (1,0) [0|0] "" Vector__XXX
 SG_ VCFRONT_a510_packVoltage m510 : 24|8@1+ (0.1,0) [0|0] "" Vector__XXX
 SG_ VCFRONT_a512_packVoltageIntervalMax m512 : 24|8@1+ (0.1,0) [0|0] "" Vector__XXX
 SG_ VCFRONT_a516_HVSoc m516 : 24|10@1+ (0.1,0) [0|0] "" Vector__XXX
 SG_ VCFRONT_a517_HVSoc m517 : 24|10@1+ (0.1,0) [0|0] "" Vector__XXX
 SG_ VCFRONT_a518_IBSVoltage m518 : 24|9@1+ (0.05,0) [0|0] "" Vector__XXX
 SG_ VCFRONT_a522_HVSoc m522 : 24|10@1+ (0.1,0) [0|0] "" Vector__XXX
 SG_ VCFRONT_a523_control2Byte1 m523 : 24|8@1+ (1,0) [0|0] "" Vector__XXX
 SG_ VCFRONT_a524_headlampHealth m524 : 24|3@1+ (1,0) [0|0] "" Vector__XXX
 SG_ VCFRONT_a525_initialLVBatteryType m525 : 24|3@1+ (1,0) [0|0] "" Vector__XXX
 SG_ VCFRONT_a529_rerunDisconnectedBattery m529 : 24|1@1+ (1,0) [0|0] "" Vector__XXX
 SG_ VCFRONT_a534_initialFlow m534 : 24|8@1+ (0.5,0) [0|0] "" Vector__XXX
 SG_ VCFRONT_a535_initialFlow m535 : 24|8@1+ (0.5,0) [0|0] "" Vector__XXX
 SG_ VCFRONT_a536_initialFlow m536 : 24|8@1+ (0.5,0) [0|0] "" Vector__XXX
 SG_ VCFRONT_a537_initialFlow m537 : 24|8@1+ (0.5,0) [0|0] "" Vector__XXX
 SG_ VCFRONT_a538_initialFlow m538 : 24|8@1+ (0.5,0) [0|0] "" Vector__XXX
 SG_ VCFRONT_a539_initialFlow m539 : 24|8@1+ (0.5,0) [0|0] "" Vector__XXX
 SG_ VCFRONT_a542_liquidPressure m542 : 24|6@1+ (0.5,0) [0|0] "" Vector__XXX
 SG_ VCFRONT_a545_frunkOpen m545 : 24|1@1+ (1,0) [0|0] "" Vector__XXX
 SG_ VCFRONT_a548_backstopBucketCount m548 : 24|5@1+ (0.035,0) [0|0] "" Vector__XXX
 SG_ VCFRONT_a552_epas3sSelfTestResult m552 : 24|4@1+ (1,0) [0|0] "" Vector__XXX
 SG_ VCFRONT_a556_disconnectedBatteryTestCurrent m556 : 24|12@1+ (0.004884004884004884,-10) [0|0] "" Vector__XXX
 SG_ VCFRONT_a559_PackCurrent m559 : 24|12@1+ (0.2,-600) [0|0] "" Vector__XXX
 SG_ VCFRONT_a565_rearPassengerDoorOpen m565 : 24|1@1+ (1,0) [0|0] "" Vector__XXX
 SG_ VCFRONT_a582_PCSCurrent m582 : 24|8@1+ (0.5,-127) [0|0] "" Vector__XXX
 SG_ VCFRONT_a583_switch1State m583 : 24|3@1+ (1,0) [0|0] "" Vector__XXX
 SG_ VCFRONT_a584_switch1Voltage m584 : 24|9@1+ (10,0) [0|0] "" Vector__XXX
 SG_ VCFRONT_a587_batterySMState m587 : 24|4@1+ (1,0) [0|0] "" Vector__XXX
 SG_ VCFRONT_a588_vcleftATerm m588 : 24|16@1+ (50,0) [0|0] "" Vector__XXX
 SG_ VCFRONT_a590_vcrightATerm m590 : 24|16@1+ (50,0) [0|0] "" Vector__XXX
 SG_ VCFRONT_a592_vcleftCutoffATerm m592 : 24|16@1+ (50,0) [0|0] "" Vector__XXX
 SG_ VCFRONT_a594_minOffsetFusionSession m594 : 24|8@1- (0.001,0) [0|0] "" Vector__XXX
 SG_ VCFRONT_a595_batterySMState m595 : 24|4@1+ (1,0) [0|0] "" Vector__XXX
 SG_ VCFRONT_a596_vcrightCutoffATerm m596 : 24|16@1+ (50,0) [0|0] "" Vector__XXX
 SG_ VCFRONT_a599_initialLVBatteryType m599 : 24|3@1+ (1,0) [0|0] "" Vector__XXX
 SG_ VCFRONT_a600_batterySMState m600 : 24|4@1+ (1,0) [0|0] "" Vector__XXX
 SG_ VCFRONT_a611_tempCoolantRadOutletEst m611 : 24|6@1+ (1,20) [0|0] "" Vector__XXX
 SG_ VCFRONT_a614_ptPumpFault m614 : 24|1@1+ (1,0) [0|0] "" Vector__XXX
 SG_ VCFRONT_a618_evapInTemp m618 : 24|6@1+ (1,0) [0|0] "" Vector__XXX
 SG_ VCFRONT_a626_elevatedDcrThreshold m626 : 24|4@1+ (0.5,12) [0|0] "" Vector__XXX
 SG_ VCFRONT_a628_lastNominalTemp m628 : 24|8@1+ (0.5,-20) [0|0] "" Vector__XXX
 SG_ VCFRONT_a635_readyToSleepFailed m635 : 24|1@1+ (1,0) [0|0] "" Vector__XXX
 SG_ VCFRONT_a644_washpumpCycleSuccessEstimate m644 : 24|1@1+ (1,0) [0|0] "" Vector__XXX
 SG_ VCFRONT_a645_averageUnprimedFluidCurrent m645 : 24|8@1- (0.0984251968503937,5.807086614173229) [0|0] "" Vector__XXX
 SG_ VCFRONT_a646_timeDeltaBetweenComputations_min m646 : 24|14@1+ (1,0) [0|0] "" Vector__XXX
 SG_ VCFRONT_a663_hcmlGroupsHighWaterMarkPercent_IC400 m663 : 24|5@1+ (3.225806451612903,0) [0|0] "" Vector__XXX
 SG_ VCFRONT_a664_hcmrGroupsHighWaterMarkPercent_IC400 m664 : 24|5@1+ (3.225806451612903,0) [0|0] "" Vector__XXX
 SG_ VCFRONT_a665_isClearingFaults m665 : 24|1@1+ (1,0) [0|0] "" Vector__XXX
 SG_ VCFRONT_a666_isClearingFaults m666 : 24|1@1+ (1,0) [0|0] "" Vector__XXX
 SG_ VCFRONT_a667_country m667 : 24|16@1+ (1,0) [0|0] "" Vector__XXX
 SG_ VCFRONT_a668_country m668 : 24|16@1+ (1,0) [0|0] "" Vector__XXX
 SG_ VCFRONT_a009_abortedFaultTimeout m9 : 25|1@1+ (1,0) [0|0] "" Vector__XXX
 SG_ VCFRONT_a021_Task1000msLate m21 : 25|1@1+ (1,0) [0|0] "" Vector__XXX
 SG_ VCFRONT_a038_busMaster m38 : 25|4@1+ (1,0) [0|0] "" Vector__XXX
 SG_ VCFRONT_a047_Xres m47 : 25|1@1+ (1,0) [0|0] "" Vector__XXX
 SG_ VCFRONT_a089_VEH_party3 m89 : 25|1@1+ (1,0) [0|0] "" Vector__XXX
 SG_ VCFRONT_a098_PARTY_torque m98 : 25|1@1+ (1,0) [0|0] "" Vector__XXX
 SG_ VCFRONT_a104_PARTY_gpsAccuracies m104 : 25|1@1+ (1,0) [0|0] "" Vector__XXX
 SG_ VCFRONT_a107_PT_socStatus m107 : 25|1@1+ (1,0) [0|0] "" Vector__XXX
 SG_ VCFRONT_a108_PT_temperature m108 : 25|1@1+ (1,0) [0|0] "" Vector__XXX
 SG_ VCFRONT_a109_BDY_inertial2 m109 : 25|1@1+ (1,0) [0|0] "" Vector__XXX
 SG_ VCFRONT_a110_VEH_gearControl m110 : 25|1@1+ (1,0) [0|0] "" Vector__XXX
 SG_ VCFRONT_a111_VEH_seatStatus m111 : 25|1@1+ (1,0) [0|0] "" Vector__XXX
 SG_ VCFRONT_a112_PARTY_status m112 : 25|1@1+ (1,0) [0|0] "" Vector__XXX
 SG_ VCFRONT_a113_VEH_chassisControl m113 : 25|1@1+ (1,0) [0|0] "" Vector__XXX
 SG_ VCFRONT_a114_VEH_wheelRotation m114 : 25|1@1+ (1,0) [0|0] "" Vector__XXX
 SG_ VCFRONT_a116_VEH_seatHeatStatus m116 : 25|1@1+ (1,0) [0|0] "" Vector__XXX
 SG_ VCFRONT_a117_VEH_seatStatus m117 : 25|1@1+ (1,0) [0|0] "" Vector__XXX
 SG_ VCFRONT_a118_VEH_systemStatus m118 : 25|1@1+ (1,0) [0|0] "" Vector__XXX
 SG_ VCFRONT_a120_PARTY_status m120 : 25|1@1+ (1,0) [0|0] "" Vector__XXX
 SG_ VCFRONT_a142_isCoilOpenY m142 : 25|1@1+ (1,0) [0|0] "" Vector__XXX
 SG_ VCFRONT_a153_trunkOpen m153 : 25|1@1+ (1,0) [0|0] "" Vector__XXX
 SG_ VCFRONT_a160_faultValveEXV m160 : 25|1@1+ (1,0) [0|0] "" Vector__XXX
 SG_ VCFRONT_a161_tempSnsFaultIPM1 m161 : 25|1@1+ (1,0) [0|0] "" Vector__XXX
 SG_ VCFRONT_a171_PCSCPU2 m171 : 25|1@1+ (1,0) [0|0] "" Vector__XXX
 SG_ VCFRONT_a178_notRunInverterHot m178 : 25|1@1+ (1,0) [0|0] "" Vector__XXX
 SG_ VCFRONT_a182_factoryMode m182 : 25|1@1+ (1,0) [0|0] "" Vector__XXX
 SG_ VCFRONT_a183_factoryMode m183 : 25|1@1+ (1,0) [0|0] "" Vector__XXX
 SG_ VCFRONT_a187_partyBusRetryCount m187 : 25|9@1+ (1,0) [0|0] "" Vector__XXX
 SG_ VCFRONT_a191_IBSVoltage m191 : 25|8@1+ (0.08741903380905883,0) [0|0] "" Vector__XXX
 SG_ VCFRONT_a192_hvcEFuseStable m192 : 25|1@1+ (1,0) [0|0] "" Vector__XXX
 SG_ VCFRONT_a216_vcrightFastBlowDebounceImminent m216 : 25|1@1+ (1,0) [0|0] "" Vector__XXX
 SG_ VCFRONT_a284_isCoilOpenY m284 : 25|1@1+ (1,0) [0|0] "" Vector__XXX
 SG_ VCFRONT_a285_isCoilOpenY m285 : 25|1@1+ (1,0) [0|0] "" Vector__XXX
 SG_ VCFRONT_a286_isCoilOpenY m286 : 25|1@1+ (1,0) [0|0] "" Vector__XXX
 SG_ VCFRONT_a287_isCoilOpenY m287 : 25|1@1+ (1,0) [0|0] "" Vector__XXX
 SG_ VCFRONT_a288_isCoilOpenY m288 : 25|1@1+ (1,0) [0|0] "" Vector__XXX
 SG_ VCFRONT_a289_isCoilOpenY m289 : 25|1@1+ (1,0) [0|0] "" Vector__XXX
 SG_ VCFRONT_a365_heatPumpFlowRequest m365 : 25|1@1+ (1,0) [0|0] "" Vector__XXX
 SG_ VCFRONT_a366_sentryModeActive m366 : 25|1@1+ (1,0) [0|0] "" Vector__XXX
 SG_ VCFRONT_a427_endingSoc m427 : 25|9@1+ (0.2,0) [0|0] "" Vector__XXX
 SG_ VCFRONT_a446_compStandbySelfNotReady m446 : 25|1@1+ (1,0) [0|0] "" Vector__XXX
 SG_ VCFRONT_a447_lccSolenoidCompromised m447 : 25|1@1+ (1,0) [0|0] "" Vector__XXX
 SG_ VCFRONT_a462_HardwareOCLevel2 m462 : 25|1@1+ (1,0) [0|0] "" Vector__XXX
 SG_ VCFRONT_a476_FRM10_timedOut m476 : 25|1@1+ (1,0) [0|0] "" Vector__XXX
 SG_ VCFRONT_a477_cell2Voltage m477 : 25|9@1+ (0.01,0) [0|0] "" Vector__XXX
 SG_ VCFRONT_a480_unexpectedLock m480 : 25|1@1+ (1,0) [0|0] "" Vector__XXX
 SG_ VCFRONT_a481_outputOn m481 : 25|1@1+ (1,0) [0|0] "" Vector__XXX
 SG_ VCFRONT_a495_frunkOpen m495 : 25|1@1+ (1,0) [0|0] "" Vector__XXX
 SG_ VCFRONT_a499_DIFlowReq m499 : 25|1@1+ (1,0) [0|0] "" Vector__XXX
 SG_ VCFRONT_a529_disconnectedBatteryRunExpended m529 : 25|1@1+ (1,0) [0|0] "" Vector__XXX
 SG_ VCFRONT_a541_ChargeCurrentLimit m541 : 25|10@1+ (0.05,0) [0|0] "" Vector__XXX
 SG_ VCFRONT_a565_trunkOpen m565 : 25|1@1+ (1,0) [0|0] "" Vector__XXX
 SG_ VCFRONT_a614_ranFanRpm m614 : 25|1@1+ (1,0) [0|0] "" Vector__XXX
 SG_ VCFRONT_a627_cell2Voltage m627 : 25|9@1+ (0.01,0) [0|0] "" Vector__XXX
 SG_ VCFRONT_a635_requestSleepFailed m635 : 25|1@1+ (1,0) [0|0] "" Vector__XXX
 SG_ VCFRONT_a644_fluidLowEstimate m644 : 25|1@1+ (1,0) [0|0] "" Vector__XXX
 SG_ VCFRONT_a009_abortedRetryLimited m9 : 26|1@1+ (1,0) [0|0] "" Vector__XXX
 SG_ VCFRONT_a021_Task1000msStarved m21 : 26|1@1+ (1,0) [0|0] "" Vector__XXX
 SG_ VCFRONT_a047_Bodvddd m47 : 26|1@1+ (1,0) [0|0] "" Vector__XXX
 SG_ VCFRONT_a098_PT_thermalControl m98 : 26|1@1+ (1,0) [0|0] "" Vector__XXX
 SG_ VCFRONT_a104_CH_status m104 : 26|1@1+ (1,0) [0|0] "" Vector__XXX
 SG_ VCFRONT_a107_VEH_socStatus m107 : 26|1@1+ (1,0) [0|0] "" Vector__XXX
 SG_ VCFRONT_a108_PT_thermalControl m108 : 26|1@1+ (1,0) [0|0] "" Vector__XXX
 SG_ VCFRONT_a109_BDY_status m109 : 26|1@1+ (1,0) [0|0] "" Vector__XXX
 SG_ VCFRONT_a110_VEH_canLogAvailability m110 : 26|1@1+ (1,0) [0|0] "" Vector__XXX
 SG_ VCFRONT_a111_PARTY_status m111 : 26|1@1+ (1,0) [0|0] "" Vector__XXX
 SG_ VCFRONT_a112_CH_status m112 : 26|1@1+ (1,0) [0|0] "" Vector__XXX
 SG_ VCFRONT_a113_VEH_trackModeSettings m113 : 26|1@1+ (1,0) [0|0] "" Vector__XXX
 SG_ VCFRONT_a114_PARTY_brakeTorque m114 : 26|1@1+ (1,0) [0|0] "" Vector__XXX
 SG_ VCFRONT_a116_VEH_restraintStatus m116 : 26|1@1+ (1,0) [0|0] "" Vector__XXX
 SG_ VCFRONT_a117_BDY_falconSwitchStatus m117 : 26|1@1+ (1,0) [0|0] "" Vector__XXX
 SG_ VCFRONT_a118_PARTY_LVPowerState m118 : 26|1@1+ (1,0) [0|0] "" Vector__XXX
 SG_ VCFRONT_a120_PT_speed m120 : 26|1@1+ (1,0) [0|0] "" Vector__XXX
 SG_ VCFRONT_a142_isCoilShortXPGnd m142 : 26|1@1+ (1,0) [0|0] "" Vector__XXX
 SG_ VCFRONT_a146_RPMTarget m146 : 26|10@1+ (10,0) [0|0] "" Vector__XXX
 SG_ VCFRONT_a147_RPMTarget m147 : 26|10@1+ (10,0) [0|0] "" Vector__XXX
 SG_ VCFRONT_a148_RPMTarget m148 : 26|10@1+ (10,0) [0|0] "" Vector__XXX
 SG_ VCFRONT_a150_RPMTarget m150 : 26|10@1+ (10,0) [0|0] "" Vector__XXX
 SG_ VCFRONT_a151_RPMTarget m151 : 26|10@1+ (10,0) [0|0] "" Vector__XXX
 SG_ VCFRONT_a152_RPMTarget m152 : 26|10@1+ (10,0) [0|0] "" Vector__XXX
 SG_ VCFRONT_a153_inTransportMode m153 : 26|1@1+ (1,0) [0|0] "" Vector__XXX
 SG_ VCFRONT_a160_faultValveEvapSol m160 : 26|1@1+ (1,0) [0|0] "" Vector__XXX
 SG_ VCFRONT_a161_tempSnsFaultIPM2 m161 : 26|1@1+ (1,0) [0|0] "" Vector__XXX
 SG_ VCFRONT_a171_DI m171 : 26|1@1+ (1,0) [0|0] "" Vector__XXX
 SG_ VCFRONT_a178_notRunAmbientOutOfBounds m178 : 26|1@1+ (1,0) [0|0] "" Vector__XXX
 SG_ VCFRONT_a182_serviceMode m182 : 26|1@1+ (1,0) [0|0] "" Vector__XXX
 SG_ VCFRONT_a183_serviceMode m183 : 26|1@1+ (1,0) [0|0] "" Vector__XXX
 SG_ VCFRONT_a192_replaceLVBattery m192 : 26|1@1+ (1,0) [0|0] "" Vector__XXX
 SG_ VCFRONT_a216_vcrightStaticImminent m216 : 26|1@1+ (1,0) [0|0] "" Vector__XXX
 SG_ VCFRONT_a228_RPMTarget m228 : 26|10@1+ (10,0) [0|0] "" Vector__XXX
 SG_ VCFRONT_a229_RPMTarget m229 : 26|10@1+ (10,0) [0|0] "" Vector__XXX
 SG_ VCFRONT_a230_RPMTarget m230 : 26|10@1+ (10,0) [0|0] "" Vector__XXX
 SG_ VCFRONT_a249_tempCoolantPTInlet m249 : 26|11@1+ (0.125,-40) [0|0] "" Vector__XXX
 SG_ VCFRONT_a254_RPMTarget m254 : 26|10@1+ (10,0) [0|0] "" Vector__XXX
 SG_ VCFRONT_a255_RPMTarget m255 : 26|10@1+ (10,0) [0|0] "" Vector__XXX
 SG_ VCFRONT_a284_isCoilShortXPGnd m284 : 26|1@1+ (1,0) [0|0] "" Vector__XXX
 SG_ VCFRONT_a285_isCoilShortXPGnd m285 : 26|1@1+ (1,0) [0|0] "" Vector__XXX
 SG_ VCFRONT_a286_isCoilShortXPGnd m286 : 26|1@1+ (1,0) [0|0] "" Vector__XXX
 SG_ VCFRONT_a287_isCoilShortXPGnd m287 : 26|1@1+ (1,0) [0|0] "" Vector__XXX
 SG_ VCFRONT_a288_isCoilShortXPGnd m288 : 26|1@1+ (1,0) [0|0] "" Vector__XXX
 SG_ VCFRONT_a289_isCoilShortXPGnd m289 : 26|1@1+ (1,0) [0|0] "" Vector__XXX
 SG_ VCFRONT_a352_maxCurrent m352 : 26|8@1+ (0.1,0) [0|0] "" Vector__XXX
 SG_ VCFRONT_a365_sentryModeActive m365 : 26|1@1+ (1,0) [0|0] "" Vector__XXX
 SG_ VCFRONT_a366_hvacConditioning m366 : 26|1@1+ (1,0) [0|0] "" Vector__XXX
 SG_ VCFRONT_a373_tempSuperheatTarget m373 : 26|10@1+ (0.1,0) [0|0] "" Vector__XXX
 SG_ VCFRONT_a416_brickVoltageMax m416 : 26|10@1+ (0.005,0) [0|0] "" Vector__XXX
 SG_ VCFRONT_a417_brickVoltageMax m417 : 26|10@1+ (0.005,0) [0|0] "" Vector__XXX
 SG_ VCFRONT_a418_brickVoltageMax m418 : 26|10@1+ (0.005,0) [0|0] "" Vector__XXX
 SG_ VCFRONT_a419_brickVoltageMax m419 : 26|10@1+ (0.005,0) [0|0] "" Vector__XXX
 SG_ VCFRONT_a420_partyStopReason m420 : 26|3@1+ (1,0) [0|0] "" Vector__XXX
 SG_ VCFRONT_a423_brickVoltageMax m423 : 26|10@1+ (0.005,0) [0|0] "" Vector__XXX
 SG_ VCFRONT_a424_brickVoltageMax m424 : 26|10@1+ (0.005,0) [0|0] "" Vector__XXX
 SG_ VCFRONT_a446_compStandbyRefrigNotOk m446 : 26|1@1+ (1,0) [0|0] "" Vector__XXX
 SG_ VCFRONT_a447_refrigerantSystemCompromised m447 : 26|1@1+ (1,0) [0|0] "" Vector__XXX
 SG_ VCFRONT_a462_ChrgOCLevel1 m462 : 26|1@1+ (1,0) [0|0] "" Vector__XXX
 SG_ VCFRONT_a472_worstCaseRequiredRange m472 : 26|10@1+ (1,0) [0|0] "" Vector__XXX
 SG_ VCFRONT_a473_worstCaseRequiredRange m473 : 26|10@1+ (1,0) [0|0] "" Vector__XXX
 SG_ VCFRONT_a474_ssl100Bank6Status m474 : 26|2@1+ (1,0) [0|0] "" Vector__XXX
 SG_ VCFRONT_a475_ssl100Bank6Status m475 : 26|2@1+ (1,0) [0|0] "" Vector__XXX
 SG_ VCFRONT_a476_FRM11_timedOut m476 : 26|1@1+ (1,0) [0|0] "" Vector__XXX
 SG_ VCFRONT_a480_disableOutputFault m480 : 26|1@1+ (1,0) [0|0] "" Vector__XXX
 SG_ VCFRONT_a481_VDSDiff m481 : 26|8@1+ (1,0) [0|0] "" Vector__XXX
 SG_ VCFRONT_a487_previouslyReportedPosition m487 : 26|10@1+ (1,0) [0|0] "" Vector__XXX
 SG_ VCFRONT_a491_previouslyReportedPosition m491 : 26|10@1+ (1,0) [0|0] "" Vector__XXX
 SG_ VCFRONT_a495_externalPowerSupply m495 : 26|1@1+ (1,0) [0|0] "" Vector__XXX
 SG_ VCFRONT_a503_brickVoltageMax m503 : 26|10@1+ (0.005,0) [0|0] "" Vector__XXX
 SG_ VCFRONT_a527_cell2Voltage m527 : 26|10@1+ (0.01,0) [0|0] "" Vector__XXX
 SG_ VCFRONT_a555_cell2Voltage m555 : 26|10@1+ (0.01,0) [0|0] "" Vector__XXX
 SG_ VCFRONT_a558_aimedHorizontalPosition m558 : 26|10@1+ (1,0) [0|0] "" Vector__XXX
 SG_ VCFRONT_a561_ambientTemperature m561 : 26|6@1+ (4,0) [0|0] "" Vector__XXX
 SG_ VCFRONT_a562_ambientTemperature m562 : 26|6@1+ (4,0) [0|0] "" Vector__XXX
 SG_ VCFRONT_a564_aimedHorizontalPosition m564 : 26|10@1+ (1,0) [0|0] "" Vector__XXX
 SG_ VCFRONT_a565_inTransportMode m565 : 26|1@1+ (1,0) [0|0] "" Vector__XXX
 SG_ VCFRONT_a605_sleepBypassVoltage m605 : 26|10@1+ (0.1,0) [0|0] "" Vector__XXX
 SG_ VCFRONT_a614_radFanFault m614 : 26|1@1+ (1,0) [0|0] "" Vector__XXX
 SG_ VCFRONT_a634_ajar2OpeningDeltaV m634 : 26|10@1- (0.01,0) [0|0] "" Vector__XXX
 SG_ VCFRONT_a644_pumpPrimeDuration m644 : 26|10@1+ (9.775171065493646,0) [0|0] "" Vector__XXX
 SG_ VCFRONT_a661_headlampUndercurrentFault m661 : 26|1@1+ (1,0) [0|0] "" Vector__XXX
 SG_ VCFRONT_a662_headlampUndercurrentFault m662 : 26|1@1+ (1,0) [0|0] "" Vector__XXX
 SG_ VCFRONT_a669_hpMode m669 : 26|5@1+ (1,0) [0|0] "" Vector__XXX
 SG_ VCFRONT_a009_PdMax m9 : 27|5@1+ (1,0) [0|0] "" Vector__XXX
 SG_ VCFRONT_a021_Task1000msMissed m21 : 27|1@1+ (1,0) [0|0] "" Vector__XXX
 SG_ VCFRONT_a047_Bodvdda m47 : 27|1@1+ (1,0) [0|0] "" Vector__XXX
 SG_ VCFRONT_a098_PT_temperature m98 : 27|1@1+ (1,0) [0|0] "" Vector__XXX
 SG_ VCFRONT_a104_PARTY_status m104 : 27|1@1+ (1,0) [0|0] "" Vector__XXX
 SG_ VCFRONT_a107_VEH_packConfig m107 : 27|1@1+ (1,0) [0|0] "" Vector__XXX
 SG_ VCFRONT_a108_PARTY_motorStatus m108 : 27|1@1+ (1,0) [0|0] "" Vector__XXX
 SG_ VCFRONT_a109_VEH_inertial1 m109 : 27|1@1+ (1,0) [0|0] "" Vector__XXX
 SG_ VCFRONT_a110_CH_airbagCutoffStatus m110 : 27|1@1+ (1,0) [0|0] "" Vector__XXX
 SG_ VCFRONT_a111_CH_status m111 : 27|1@1+ (1,0) [0|0] "" Vector__XXX
 SG_ VCFRONT_a113_VEH_powertrainControl m113 : 27|1@1+ (1,0) [0|0] "" Vector__XXX
 SG_ VCFRONT_a114_PARTY_offsets m114 : 27|1@1+ (1,0) [0|0] "" Vector__XXX
 SG_ VCFRONT_a116_VEH_switchStatus m116 : 27|1@1+ (1,0) [0|0] "" Vector__XXX
 SG_ VCFRONT_a117_VEH_doorStatus m117 : 27|1@1+ (1,0) [0|0] "" Vector__XXX
 SG_ VCFRONT_a118_PARTY_outputPowerStatus m118 : 27|1@1+ (1,0) [0|0] "" Vector__XXX
 SG_ VCFRONT_a120_PT_systemStatus m120 : 27|1@1+ (1,0) [0|0] "" Vector__XXX
 SG_ VCFRONT_a142_isCoilShortXPVbb m142 : 27|1@1+ (1,0) [0|0] "" Vector__XXX
 SG_ VCFRONT_a153_anyClosureIsOpen m153 : 27|1@1+ (1,0) [0|0] "" Vector__XXX
 SG_ VCFRONT_a154_lastSilentWakeIBSCurrent m154 : 27|10@1+ (0.001953125,-1.59375) [0|0] "" Vector__XXX
 SG_ VCFRONT_a159_angleTarget m159 : 27|10@1+ (0.25,-10) [0|0] "" Vector__XXX
 SG_ VCFRONT_a160_highDischargePressureCutouts m160 : 27|1@1+ (1,0) [0|0] "" Vector__XXX
 SG_ VCFRONT_a161_tempSnsFaultCPU m161 : 27|1@1+ (1,0) [0|0] "" Vector__XXX
 SG_ VCFRONT_a171_DIS m171 : 27|1@1+ (1,0) [0|0] "" Vector__XXX
 SG_ VCFRONT_a178_isSummerPumpOut m178 : 27|1@1+ (1,0) [0|0] "" Vector__XXX
 SG_ VCFRONT_a182_transportMode m182 : 27|1@1+ (1,0) [0|0] "" Vector__XXX
 SG_ VCFRONT_a183_transportMode m183 : 27|1@1+ (1,0) [0|0] "" Vector__XXX
 SG_ VCFRONT_a192_BMS_MIA m192 : 27|1@1+ (1,0) [0|0] "" Vector__XXX
 SG_ VCFRONT_a216_vcrightDynamicImminent m216 : 27|1@1+ (1,0) [0|0] "" Vector__XXX
 SG_ VCFRONT_a284_isCoilShortXPVbb m284 : 27|1@1+ (1,0) [0|0] "" Vector__XXX
 SG_ VCFRONT_a285_isCoilShortXPVbb m285 : 27|1@1+ (1,0) [0|0] "" Vector__XXX
 SG_ VCFRONT_a286_isCoilShortXPVbb m286 : 27|1@1+ (1,0) [0|0] "" Vector__XXX
 SG_ VCFRONT_a287_isCoilShortXPVbb m287 : 27|1@1+ (1,0) [0|0] "" Vector__XXX
 SG_ VCFRONT_a288_isCoilShortXPVbb m288 : 27|1@1+ (1,0) [0|0] "" Vector__XXX
 SG_ VCFRONT_a289_isCoilShortXPVbb m289 : 27|1@1+ (1,0) [0|0] "" Vector__XXX
 SG_ VCFRONT_a310_maxTemp m310 : 27|11@1+ (0.125,-40) [0|0] "" Vector__XXX
 SG_ VCFRONT_a311_maxTemp m311 : 27|11@1+ (0.125,-40) [0|0] "" Vector__XXX
 SG_ VCFRONT_a312_maxTemp m312 : 27|11@1+ (0.125,-40) [0|0] "" Vector__XXX
 SG_ VCFRONT_a313_maxTemp m313 : 27|11@1+ (0.125,-40) [0|0] "" Vector__XXX
 SG_ VCFRONT_a314_maxTemp m314 : 27|11@1+ (0.125,-40) [0|0] "" Vector__XXX
 SG_ VCFRONT_a315_maxTemp m315 : 27|11@1+ (0.125,-40) [0|0] "" Vector__XXX
 SG_ VCFRONT_a316_maxTemp m316 : 27|11@1+ (0.125,-40) [0|0] "" Vector__XXX
 SG_ VCFRONT_a317_maxTemp m317 : 27|11@1+ (0.125,-40) [0|0] "" Vector__XXX
 SG_ VCFRONT_a318_maxTemp m318 : 27|11@1+ (0.125,-40) [0|0] "" Vector__XXX
 SG_ VCFRONT_a319_maxTemp m319 : 27|11@1+ (0.125,-40) [0|0] "" Vector__XXX
 SG_ VCFRONT_a320_maxTemp m320 : 27|11@1+ (0.125,-40) [0|0] "" Vector__XXX
 SG_ VCFRONT_a321_maxTemp m321 : 27|11@1+ (0.125,-40) [0|0] "" Vector__XXX
 SG_ VCFRONT_a322_maxTemp m322 : 27|11@1+ (0.125,-40) [0|0] "" Vector__XXX
 SG_ VCFRONT_a323_maxTemp m323 : 27|11@1+ (0.125,-40) [0|0] "" Vector__XXX
 SG_ VCFRONT_a324_maxTemp m324 : 27|11@1+ (0.125,-40) [0|0] "" Vector__XXX
 SG_ VCFRONT_a325_maxTemp m325 : 27|11@1+ (0.125,-40) [0|0] "" Vector__XXX
 SG_ VCFRONT_a365_hvacConditioning m365 : 27|1@1+ (1,0) [0|0] "" Vector__XXX
 SG_ VCFRONT_a366_coolantConditioning m366 : 27|1@1+ (1,0) [0|0] "" Vector__XXX
 SG_ VCFRONT_a390_blendType m390 : 27|2@1+ (1,0) [0|0] "" Vector__XXX
 SG_ VCFRONT_a446_compStandbyCoastDownMode m446 : 27|1@1+ (1,0) [0|0] "" Vector__XXX
 SG_ VCFRONT_a447_powertrainThermalFansCompromised m447 : 27|1@1+ (1,0) [0|0] "" Vector__XXX
 SG_ VCFRONT_a461_socByAhSaturated m461 : 27|10@1+ (0.1,0) [0|0] "" Vector__XXX
 SG_ VCFRONT_a462_ChrgOCLevel2 m462 : 27|1@1+ (1,0) [0|0] "" Vector__XXX
 SG_ VCFRONT_a476_FRM12_timedOut m476 : 27|1@1+ (1,0) [0|0] "" Vector__XXX
 SG_ VCFRONT_a480_vsUndervoltage m480 : 27|1@1+ (1,0) [0|0] "" Vector__XXX
 SG_ VCFRONT_a507_headlampFailedToFinishCalibration m507 : 27|1@1+ (1,0) [0|0] "" Vector__XXX
 SG_ VCFRONT_a524_headlampFailedToFinishCalibration m524 : 27|1@1+ (1,0) [0|0] "" Vector__XXX
 SG_ VCFRONT_a525_serviceMode m525 : 27|1@1+ (1,0) [0|0] "" Vector__XXX
 SG_ VCFRONT_a565_anyClosureIsOpen m565 : 27|1@1+ (1,0) [0|0] "" Vector__XXX
 SG_ VCFRONT_a583_switch2State m583 : 27|3@1+ (1,0) [0|0] "" Vector__XXX
 SG_ VCFRONT_a599_serviceMode m599 : 27|1@1+ (1,0) [0|0] "" Vector__XXX
 SG_ VCFRONT_a614_battPumpDryRun m614 : 27|1@1+ (1,0) [0|0] "" Vector__XXX
 SG_ VCFRONT_a661_headlampOvercurrentFault m661 : 27|1@1+ (1,0) [0|0] "" Vector__XXX
 SG_ VCFRONT_a662_headlampOvercurrentFault m662 : 27|1@1+ (1,0) [0|0] "" Vector__XXX
 SG_ VCFRONT_a047_Bodvccd m47 : 28|1@1+ (1,0) [0|0] "" Vector__XXX
 SG_ VCFRONT_a058_current m58 : 28|11@1+ (0.1,0) [0|0] "" Vector__XXX
 SG_ VCFRONT_a059_resistanceEstimate m59 : 28|12@1+ (0.00244,0) [0|0] "" Vector__XXX
 SG_ VCFRONT_a098_PARTY_motorStatus m98 : 28|1@1+ (1,0) [0|0] "" Vector__XXX
 SG_ VCFRONT_a104_PARTY_steeringControl m104 : 28|1@1+ (1,0) [0|0] "" Vector__XXX
 SG_ VCFRONT_a107_VEH_energyStatus m107 : 28|1@1+ (1,0) [0|0] "" Vector__XXX
 SG_ VCFRONT_a108_VEH_motorStatus m108 : 28|1@1+ (1,0) [0|0] "" Vector__XXX
 SG_ VCFRONT_a109_VEH_inertial2 m109 : 28|1@1+ (1,0) [0|0] "" Vector__XXX
 SG_ VCFRONT_a110_CH_carConfig m110 : 28|1@1+ (1,0) [0|0] "" Vector__XXX
 SG_ VCFRONT_a113_VEH_vehicleModes m113 : 28|1@1+ (1,0) [0|0] "" Vector__XXX
 SG_ VCFRONT_a114_BDY_offsets m114 : 28|1@1+ (1,0) [0|0] "" Vector__XXX
 SG_ VCFRONT_a116_VEH_logging1Hz m116 : 28|1@1+ (1,0) [0|0] "" Vector__XXX
 SG_ VCFRONT_a117_VEH_doorStatus2 m117 : 28|1@1+ (1,0) [0|0] "" Vector__XXX
 SG_ VCFRONT_a118_PARTY_vehicleTime m118 : 28|1@1+ (1,0) [0|0] "" Vector__XXX
 SG_ VCFRONT_a120_PARTY_vehicleEstimates m120 : 28|1@1+ (1,0) [0|0] "" Vector__XXX
 SG_ VCFRONT_a142_isCoilShortXNGnd m142 : 28|1@1+ (1,0) [0|0] "" Vector__XXX
 SG_ VCFRONT_a153_driverPresent m153 : 28|1@1+ (1,0) [0|0] "" Vector__XXX
 SG_ VCFRONT_a160_highDischargeTempCutouts m160 : 28|1@1+ (1,0) [0|0] "" Vector__XXX
 SG_ VCFRONT_a161_currentSnsError m161 : 28|1@1+ (1,0) [0|0] "" Vector__XXX
 SG_ VCFRONT_a171_PM m171 : 28|1@1+ (1,0) [0|0] "" Vector__XXX
 SG_ VCFRONT_a178_isWinterPumpOut m178 : 28|1@1+ (1,0) [0|0] "" Vector__XXX
 SG_ VCFRONT_a180_notEnoughPowerForSupport m180 : 28|1@1+ (1,0) [0|0] "" Vector__XXX
 SG_ VCFRONT_a182_frunkOpen m182 : 28|1@1+ (1,0) [0|0] "" Vector__XXX
 SG_ VCFRONT_a183_frunkOpen m183 : 28|1@1+ (1,0) [0|0] "" Vector__XXX
 SG_ VCFRONT_a190_timeouts m190 : 28|16@1+ (1,0) [0|0] "" Vector__XXX
 SG_ VCFRONT_a192_PCS_MIA m192 : 28|1@1+ (1,0) [0|0] "" Vector__XXX
 SG_ VCFRONT_a195_serviceMode m195 : 28|1@1+ (1,0) [0|0] "" Vector__XXX
 SG_ VCFRONT_a196_disconnectedBatteryTestCurrent m196 : 28|12@1+ (0.004884004884004884,-10) [0|0] "" Vector__XXX
 SG_ VCFRONT_a248_IBSVoltage m248 : 28|12@1+ (0.005443676098,0) [0|0] "" Vector__XXX
 SG_ VCFRONT_a258_IBSTemp m258 : 28|16@1- (0.01,0) [0|0] "" Vector__XXX
 SG_ VCFRONT_a260_IBSAh m260 : 28|12@1- (0.1,0) [0|0] "" Vector__XXX
 SG_ VCFRONT_a284_isCoilShortXNGnd m284 : 28|1@1+ (1,0) [0|0] "" Vector__XXX
 SG_ VCFRONT_a285_isCoilShortXNGnd m285 : 28|1@1+ (1,0) [0|0] "" Vector__XXX
 SG_ VCFRONT_a286_isCoilShortXNGnd m286 : 28|1@1+ (1,0) [0|0] "" Vector__XXX
 SG_ VCFRONT_a287_isCoilShortXNGnd m287 : 28|1@1+ (1,0) [0|0] "" Vector__XXX
 SG_ VCFRONT_a288_isCoilShortXNGnd m288 : 28|1@1+ (1,0) [0|0] "" Vector__XXX
 SG_ VCFRONT_a289_isCoilShortXNGnd m289 : 28|1@1+ (1,0) [0|0] "" Vector__XXX
 SG_ VCFRONT_a334_avgCurrent m334 : 28|12@1+ (0.1,0) [0|0] "" Vector__XXX
 SG_ VCFRONT_a335_avgCurrent m335 : 28|12@1+ (0.1,0) [0|0] "" Vector__XXX
 SG_ VCFRONT_a336_avgCurrent m336 : 28|12@1+ (0.1,0) [0|0] "" Vector__XXX
 SG_ VCFRONT_a337_avgCurrent m337 : 28|12@1+ (0.1,0) [0|0] "" Vector__XXX
 SG_ VCFRONT_a338_avgCurrent m338 : 28|12@1+ (0.1,0) [0|0] "" Vector__XXX
 SG_ VCFRONT_a339_avgCurrent m339 : 28|12@1+ (0.1,0) [0|0] "" Vector__XXX
 SG_ VCFRONT_a340_avgCurrent m340 : 28|12@1+ (0.1,0) [0|0] "" Vector__XXX
 SG_ VCFRONT_a341_avgCurrent m341 : 28|12@1+ (0.1,0) [0|0] "" Vector__XXX
 SG_ VCFRONT_a342_avgCurrent m342 : 28|12@1+ (0.1,0) [0|0] "" Vector__XXX
 SG_ VCFRONT_a343_avgCurrent m343 : 28|12@1+ (0.1,0) [0|0] "" Vector__XXX
 SG_ VCFRONT_a344_avgCurrent m344 : 28|12@1+ (0.1,0) [0|0] "" Vector__XXX
 SG_ VCFRONT_a345_avgCurrent m345 : 28|12@1+ (0.1,0) [0|0] "" Vector__XXX
 SG_ VCFRONT_a346_avgCurrent m346 : 28|12@1+ (0.1,0) [0|0] "" Vector__XXX
 SG_ VCFRONT_a347_avgCurrent m347 : 28|12@1+ (0.1,0) [0|0] "" Vector__XXX
 SG_ VCFRONT_a348_avgCurrent m348 : 28|12@1+ (0.1,0) [0|0] "" Vector__XXX
 SG_ VCFRONT_a349_avgCurrent m349 : 28|12@1+ (0.1,0) [0|0] "" Vector__XXX
 SG_ VCFRONT_a359_IBSAh m359 : 28|12@1- (0.1,0) [0|0] "" Vector__XXX
 SG_ VCFRONT_a365_coolantConditioning m365 : 28|1@1+ (1,0) [0|0] "" Vector__XXX
 SG_ VCFRONT_a366_chargeCableUnplugged m366 : 28|1@1+ (1,0) [0|0] "" Vector__XXX
 SG_ VCFRONT_a370_IBSAh m370 : 28|12@1- (0.1,0) [0|0] "" Vector__XXX
 SG_ VCFRONT_a379_IBSTemp m379 : 28|10@1+ (0.1,-10) [0|0] "" Vector__XXX
 SG_ VCFRONT_a402_failureToPrechargeRisk m402 : 28|1@1+ (1,0) [0|0] "" Vector__XXX
 SG_ VCFRONT_a407_avgIntervalCurrent m407 : 28|5@1+ (1,-31) [0|0] "" Vector__XXX
 SG_ VCFRONT_a446_compStandbyMultiplePdCutouts m446 : 28|1@1+ (1,0) [0|0] "" Vector__XXX
 SG_ VCFRONT_a447_refrigDischargePressCompromised m447 : 28|1@1+ (1,0) [0|0] "" Vector__XXX
 SG_ VCFRONT_a462_MOSFETOTLevel1 m462 : 28|1@1+ (1,0) [0|0] "" Vector__XXX
 SG_ VCFRONT_a474_ssl100Bank7Status m474 : 28|2@1+ (1,0) [0|0] "" Vector__XXX
 SG_ VCFRONT_a475_ssl100Bank7Status m475 : 28|2@1+ (1,0) [0|0] "" Vector__XXX
 SG_ VCFRONT_a476_factoryMode m476 : 28|1@1+ (1,0) [0|0] "" Vector__XXX
 SG_ VCFRONT_a478_bmsState m478 : 28|4@1+ (1,0) [0|0] "" Vector__XXX
 SG_ VCFRONT_a479_vehiclePowerState m479 : 28|2@1+ (1,0) [0|0] "" Vector__XXX
 SG_ VCFRONT_a480_hardShort m480 : 28|1@1+ (1,0) [0|0] "" Vector__XXX
 SG_ VCFRONT_a482_calibrationCycles m482 : 28|2@1+ (1,0) [0|0] "" Vector__XXX
 SG_ VCFRONT_a485_calibrationCycles m485 : 28|2@1+ (1,0) [0|0] "" Vector__XXX
 SG_ VCFRONT_a525_factoryGated m525 : 28|1@1+ (1,0) [0|0] "" Vector__XXX
 SG_ VCFRONT_a565_driverPresent m565 : 28|1@1+ (1,0) [0|0] "" Vector__XXX
 SG_ VCFRONT_a587_LVBMS_packCurrent m587 : 28|12@1+ (0.2,-600) [0|0] "" Vector__XXX
 SG_ VCFRONT_a595_LVBMS_packVoltage m595 : 28|10@1+ (0.1,-1) [0|0] "" Vector__XXX
 SG_ VCFRONT_a599_factoryGated m599 : 28|1@1+ (1,0) [0|0] "" Vector__XXX
 SG_ VCFRONT_a600_LVBMS_packCurrent m600 : 28|12@1+ (0.2,-600) [0|0] "" Vector__XXX
 SG_ VCFRONT_a614_ptPumpDryRun m614 : 28|1@1+ (1,0) [0|0] "" Vector__XXX
 SG_ VCFRONT_a626_avgIntervalCurrent m626 : 28|5@1+ (1,-31) [0|0] "" Vector__XXX
 SG_ VCFRONT_a697_calibratedHorizontalPositionHCML m697 : 28|10@1+ (1,0) [0|0] "" Vector__XXX
 SG_ VCFRONT_a698_calibratedHorizontalPositionHCMR m698 : 28|10@1+ (1,0) [0|0] "" Vector__XXX
 SG_ VCFRONT_a047_Ovdvddd m47 : 29|1@1+ (1,0) [0|0] "" Vector__XXX
 SG_ VCFRONT_a098_VEH_motorStatus m98 : 29|1@1+ (1,0) [0|0] "" Vector__XXX
 SG_ VCFRONT_a104_CH_steeringControl m104 : 29|1@1+ (1,0) [0|0] "" Vector__XXX
 SG_ VCFRONT_a107_VEH_chargeInfo m107 : 29|1@1+ (1,0) [0|0] "" Vector__XXX
 SG_ VCFRONT_a108_CH_torque m108 : 29|1@1+ (1,0) [0|0] "" Vector__XXX
 SG_ VCFRONT_a109_CH_inertial1 m109 : 29|1@1+ (1,0) [0|0] "" Vector__XXX
 SG_ VCFRONT_a110_CH_carState m110 : 29|1@1+ (1,0) [0|0] "" Vector__XXX
 SG_ VCFRONT_a113_VEH_driverProfileRecall m113 : 29|1@1+ (1,0) [0|0] "" Vector__XXX
 SG_ VCFRONT_a114_BDY_party3 m114 : 29|1@1+ (1,0) [0|0] "" Vector__XXX
 SG_ VCFRONT_a116_VEH_seatStatus2 m116 : 29|1@1+ (1,0) [0|0] "" Vector__XXX
 SG_ VCFRONT_a117_VEH_windowStatus m117 : 29|1@1+ (1,0) [0|0] "" Vector__XXX
 SG_ VCFRONT_a118_VEH_thermalCommand m118 : 29|1@1+ (1,0) [0|0] "" Vector__XXX
 SG_ VCFRONT_a120_VEH_aggregatedAxleSpeed m120 : 29|1@1+ (1,0) [0|0] "" Vector__XXX
 SG_ VCFRONT_a142_isCoilShortXNVbb m142 : 29|1@1+ (1,0) [0|0] "" Vector__XXX
 SG_ VCFRONT_a153_brakePressed m153 : 29|1@1+ (1,0) [0|0] "" Vector__XXX
 SG_ VCFRONT_a161_selfTestFailCPU m161 : 29|1@1+ (1,0) [0|0] "" Vector__XXX
 SG_ VCFRONT_a162_lccExvFlow m162 : 29|7@1+ (1,0) [0|0] "" Vector__XXX
 SG_ VCFRONT_a171_PMS m171 : 29|1@1+ (1,0) [0|0] "" Vector__XXX
 SG_ VCFRONT_a178_notRunPsPdRange m178 : 29|1@1+ (1,0) [0|0] "" Vector__XXX
 SG_ VCFRONT_a180_pcsEFuseStable m180 : 29|1@1+ (1,0) [0|0] "" Vector__XXX
 SG_ VCFRONT_a182_packOverDischarged m182 : 29|1@1+ (1,0) [0|0] "" Vector__XXX
 SG_ VCFRONT_a183_packOverDischarged m183 : 29|1@1+ (1,0) [0|0] "" Vector__XXX
 SG_ VCFRONT_a192_HVBlockingMismatch m192 : 29|1@1+ (1,0) [0|0] "" Vector__XXX
 SG_ VCFRONT_a195_frunkOpen m195 : 29|1@1+ (1,0) [0|0] "" Vector__XXX
 SG_ VCFRONT_a275_bmbCommStatusTypeB m275 : 29|2@1+ (1,0) [0|0] "" Vector__XXX
 SG_ VCFRONT_a276_bmbCommStatusTypeB m276 : 29|2@1+ (1,0) [0|0] "" Vector__XXX
 SG_ VCFRONT_a284_isCoilShortXNVbb m284 : 29|1@1+ (1,0) [0|0] "" Vector__XXX
 SG_ VCFRONT_a285_isCoilShortXNVbb m285 : 29|1@1+ (1,0) [0|0] "" Vector__XXX
 SG_ VCFRONT_a286_isCoilShortXNVbb m286 : 29|1@1+ (1,0) [0|0] "" Vector__XXX
 SG_ VCFRONT_a287_isCoilShortXNVbb m287 : 29|1@1+ (1,0) [0|0] "" Vector__XXX
 SG_ VCFRONT_a288_isCoilShortXNVbb m288 : 29|1@1+ (1,0) [0|0] "" Vector__XXX
 SG_ VCFRONT_a289_isCoilShortXNVbb m289 : 29|1@1+ (1,0) [0|0] "" Vector__XXX
 SG_ VCFRONT_a365_chargeCableUnplugged m365 : 29|1@1+ (1,0) [0|0] "" Vector__XXX
 SG_ VCFRONT_a366_DIReportsCompleted m366 : 29|1@1+ (1,0) [0|0] "" Vector__XXX
 SG_ VCFRONT_a390_coolantMode m390 : 29|2@1+ (1,0) [0|0] "" Vector__XXX
 SG_ VCFRONT_a394_runTimeOffSetDetected m394 : 29|1@1+ (1,0) [0|0] "" Vector__XXX
 SG_ VCFRONT_a397_runTimeOffSetDetected m397 : 29|1@1+ (1,0) [0|0] "" Vector__XXX
 SG_ VCFRONT_a402_electricalDisconnectLVBattery m402 : 29|1@1+ (1,0) [0|0] "" Vector__XXX
 SG_ VCFRONT_a415_IBSCurrent m415 : 29|9@1- (0.5,0) [0|0] "" Vector__XXX
 SG_ VCFRONT_a420_partyStaticSongSelection m420 : 29|3@1+ (1,0) [0|0] "" Vector__XXX
 SG_ VCFRONT_a446_compStandbyShowroomMode m446 : 29|1@1+ (1,0) [0|0] "" Vector__XXX
 SG_ VCFRONT_a447_refrigeDischargeTempCompromised m447 : 29|1@1+ (1,0) [0|0] "" Vector__XXX
 SG_ VCFRONT_a462_CPA_State m462 : 29|1@1+ (1,0) [0|0] "" Vector__XXX
 SG_ VCFRONT_a476_serviceMode m476 : 29|1@1+ (1,0) [0|0] "" Vector__XXX
 SG_ VCFRONT_a480_vdsMax m480 : 29|1@1+ (1,0) [0|0] "" Vector__XXX
 SG_ VCFRONT_a525_frunkOpen m525 : 29|1@1+ (1,0) [0|0] "" Vector__XXX
 SG_ VCFRONT_a548_hvState m548 : 29|3@1+ (1,0) [0|0] "" Vector__XXX
 SG_ VCFRONT_a565_brakePressed m565 : 29|1@1+ (1,0) [0|0] "" Vector__XXX
 SG_ VCFRONT_a599_frunkOpen m599 : 29|1@1+ (1,0) [0|0] "" Vector__XXX
 SG_ VCFRONT_a614_battInletCoolantTooHot m614 : 29|1@1+ (1,0) [0|0] "" Vector__XXX
 SG_ VCFRONT_a663_hcmlValidatedGroupsHighWaterMarkPercent_IC400 m663 : 29|5@1+ (3.225806451612903,0) [0|0] "" Vector__XXX
 SG_ VCFRONT_a664_hcmrValidatedGroupsHighWaterMarkPercent_IC400 m664 : 29|5@1+ (3.225806451612903,0) [0|0] "" Vector__XXX
 SG_ VCFRONT_a047_Ovdvdda m47 : 30|1@1+ (1,0) [0|0] "" Vector__XXX
 SG_ VCFRONT_a104_VEH_steeringControl m104 : 30|1@1+ (1,0) [0|0] "" Vector__XXX
 SG_ VCFRONT_a109_CH_inertial2 m109 : 30|1@1+ (1,0) [0|0] "" Vector__XXX
 SG_ VCFRONT_a110_CH_vin m110 : 30|1@1+ (1,0) [0|0] "" Vector__XXX
 SG_ VCFRONT_a113_VEH_driverProfileRecall2 m113 : 30|1@1+ (1,0) [0|0] "" Vector__XXX
 SG_ VCFRONT_a114_BDY_status m114 : 30|1@1+ (1,0) [0|0] "" Vector__XXX
 SG_ VCFRONT_a116_VEH_status m116 : 30|1@1+ (1,0) [0|0] "" Vector__XXX
 SG_ VCFRONT_a117_VEH_switchStatus m117 : 30|1@1+ (1,0) [0|0] "" Vector__XXX
 SG_ VCFRONT_a118_CH_LVPowerState m118 : 30|1@1+ (1,0) [0|0] "" Vector__XXX
 SG_ VCFRONT_a120_PARTY_aggregatedAxleSpeed m120 : 30|1@1+ (1,0) [0|0] "" Vector__XXX
 SG_ VCFRONT_a142_isCoilShortYPGnd m142 : 30|1@1+ (1,0) [0|0] "" Vector__XXX
 SG_ VCFRONT_a153_chargePortDoorOpen m153 : 30|1@1+ (1,0) [0|0] "" Vector__XXX
 SG_ VCFRONT_a161_internalPowerSupplyFault m161 : 30|1@1+ (1,0) [0|0] "" Vector__XXX
 SG_ VCFRONT_a171_EPBR m171 : 30|1@1+ (1,0) [0|0] "" Vector__XXX
 SG_ VCFRONT_a178_pressureDischarge m178 : 30|5@1+ (1,0) [0|0] "" Vector__XXX
 SG_ VCFRONT_a180_vcrightEFuseStable m180 : 30|1@1+ (1,0) [0|0] "" Vector__XXX
 SG_ VCFRONT_a182_cellImbalance m182 : 30|1@1+ (1,0) [0|0] "" Vector__XXX
 SG_ VCFRONT_a183_cellImbalance m183 : 30|1@1+ (1,0) [0|0] "" Vector__XXX
 SG_ VCFRONT_a192_disconnected12V m192 : 30|1@1+ (1,0) [0|0] "" Vector__XXX
 SG_ VCFRONT_a197_pctValidIBSSamples m197 : 30|8@1+ (0.5,0) [0|0] "" Vector__XXX
 SG_ VCFRONT_a250_calibratedVerticalPositionHCMR m250 : 30|10@1+ (1,0) [0|0] "" Vector__XXX
 SG_ VCFRONT_a284_isCoilShortYPGnd m284 : 30|1@1+ (1,0) [0|0] "" Vector__XXX
 SG_ VCFRONT_a285_isCoilShortYPGnd m285 : 30|1@1+ (1,0) [0|0] "" Vector__XXX
 SG_ VCFRONT_a286_isCoilShortYPGnd m286 : 30|1@1+ (1,0) [0|0] "" Vector__XXX
 SG_ VCFRONT_a287_isCoilShortYPGnd m287 : 30|1@1+ (1,0) [0|0] "" Vector__XXX
 SG_ VCFRONT_a288_isCoilShortYPGnd m288 : 30|1@1+ (1,0) [0|0] "" Vector__XXX
 SG_ VCFRONT_a289_isCoilShortYPGnd m289 : 30|1@1+ (1,0) [0|0] "" Vector__XXX
 SG_ VCFRONT_a365_DIReportsCompleted m365 : 30|1@1+ (1,0) [0|0] "" Vector__XXX
 SG_ VCFRONT_a366_DIReportsUnavailable m366 : 30|1@1+ (1,0) [0|0] "" Vector__XXX
 SG_ VCFRONT_a394_droopDetected m394 : 30|1@1+ (1,0) [0|0] "" Vector__XXX
 SG_ VCFRONT_a402_communicationDisconnectLVBattery m402 : 30|1@1+ (1,0) [0|0] "" Vector__XXX
 SG_ VCFRONT_a429_usableCapacity m429 : 30|10@1+ (0.025,-0.025) [0|0] "" Vector__XXX
 SG_ VCFRONT_a446_compStandbyMultipleTdCutouts m446 : 30|1@1+ (1,0) [0|0] "" Vector__XXX
 SG_ VCFRONT_a447_refrigSuctionPressCompromised m447 : 30|1@1+ (1,0) [0|0] "" Vector__XXX
 SG_ VCFRONT_a462_NTCTempDiffWarnLevel1 m462 : 30|1@1+ (1,0) [0|0] "" Vector__XXX
 SG_ VCFRONT_a474_ssl100Bank8Status m474 : 30|2@1+ (1,0) [0|0] "" Vector__XXX
 SG_ VCFRONT_a475_ssl100Bank8Status m475 : 30|2@1+ (1,0) [0|0] "" Vector__XXX
 SG_ VCFRONT_a476_transportMode m476 : 30|1@1+ (1,0) [0|0] "" Vector__XXX
 SG_ VCFRONT_a480_bypassSaturation m480 : 30|1@1+ (1,0) [0|0] "" Vector__XXX
 SG_ VCFRONT_a482_previousAimedPosition m482 : 30|10@1+ (1,0) [0|0] "" Vector__XXX
 SG_ VCFRONT_a485_previousAimedPosition m485 : 30|10@1+ (1,0) [0|0] "" Vector__XXX
 SG_ VCFRONT_a508_brickImpedanceNormalized m508 : 30|10@1+ (0.002,0.5) [0|0] "" Vector__XXX
 SG_ VCFRONT_a514_cell3Voltage m514 : 30|7@1+ (0.08,0) [0|0] "" Vector__XXX
 SG_ VCFRONT_a515_cell3Voltage m515 : 30|7@1+ (0.08,0) [0|0] "" Vector__XXX
 SG_ VCFRONT_a565_chargePortDoorOpen m565 : 30|1@1+ (1,0) [0|0] "" Vector__XXX
 SG_ VCFRONT_a583_switch1StuckReason m583 : 30|2@1+ (1,0) [0|0] "" Vector__XXX
 SG_ VCFRONT_a606_chillerLoadAtExit m606 : 30|7@1+ (50.38582677165354,0) [0|0] "" Vector__XXX
 SG_ VCFRONT_a611_tempAmbientRaw m611 : 30|6@1+ (1,20) [0|0] "" Vector__XXX
 SG_ VCFRONT_a614_battInletSensor m614 : 30|1@1+ (1,0) [0|0] "" Vector__XXX
 SG_ VCFRONT_a047_Ovdvccd m47 : 31|1@1+ (1,0) [0|0] "" Vector__XXX
 SG_ VCFRONT_a104_PARTY_integratedSafetyFront m104 : 31|1@1+ (1,0) [0|0] "" Vector__XXX
 SG_ VCFRONT_a109_CH_status m109 : 31|1@1+ (1,0) [0|0] "" Vector__XXX
 SG_ VCFRONT_a110_CH_chNm m110 : 31|1@1+ (1,0) [0|0] "" Vector__XXX
 SG_ VCFRONT_a113_VEH_ventCntlReg m113 : 31|1@1+ (1,0) [0|0] "" Vector__XXX
 SG_ VCFRONT_a114_BDY_wheelRotation m114 : 31|1@1+ (1,0) [0|0] "" Vector__XXX
 SG_ VCFRONT_a116_VEH_thermalCommand m116 : 31|1@1+ (1,0) [0|0] "" Vector__XXX
 SG_ VCFRONT_a117_VEH_intrusionSensorStatus m117 : 31|1@1+ (1,0) [0|0] "" Vector__XXX
 SG_ VCFRONT_a118_PARTY_sensors m118 : 31|1@1+ (1,0) [0|0] "" Vector__XXX
 SG_ VCFRONT_a120_VEH_systemPower m120 : 31|1@1+ (1,0) [0|0] "" Vector__XXX
 SG_ VCFRONT_a142_isCoilShortYPVbb m142 : 31|1@1+ (1,0) [0|0] "" Vector__XXX
 SG_ VCFRONT_a153_UIChargePortDoorRequest m153 : 31|1@1+ (1,0) [0|0] "" Vector__XXX
 SG_ VCFRONT_a161_inverterOpenCircuit m161 : 31|1@1+ (1,0) [0|0] "" Vector__XXX
 SG_ VCFRONT_a171_EPBL m171 : 31|1@1+ (1,0) [0|0] "" Vector__XXX
 SG_ VCFRONT_a180_contactorEFuseStable m180 : 31|1@1+ (1,0) [0|0] "" Vector__XXX
 SG_ VCFRONT_a182_instantPrechargeDCRTooHigh m182 : 31|1@1+ (1,0) [0|0] "" Vector__XXX
 SG_ VCFRONT_a183_instantPrechargeDCRTooHigh m183 : 31|1@1+ (1,0) [0|0] "" Vector__XXX
 SG_ VCFRONT_a192_LVBatteryCannotSupportVehicle m192 : 31|1@1+ (1,0) [0|0] "" Vector__XXX
 SG_ VCFRONT_a284_isCoilShortYPVbb m284 : 31|1@1+ (1,0) [0|0] "" Vector__XXX
 SG_ VCFRONT_a285_isCoilShortYPVbb m285 : 31|1@1+ (1,0) [0|0] "" Vector__XXX
 SG_ VCFRONT_a286_isCoilShortYPVbb m286 : 31|1@1+ (1,0) [0|0] "" Vector__XXX
 SG_ VCFRONT_a287_isCoilShortYPVbb m287 : 31|1@1+ (1,0) [0|0] "" Vector__XXX
 SG_ VCFRONT_a288_isCoilShortYPVbb m288 : 31|1@1+ (1,0) [0|0] "" Vector__XXX
 SG_ VCFRONT_a289_isCoilShortYPVbb m289 : 31|1@1+ (1,0) [0|0] "" Vector__XXX
 SG_ VCFRONT_a365_DIReportsUnavailable m365 : 31|1@1+ (1,0) [0|0] "" Vector__XXX
 SG_ VCFRONT_a366_BMSSOCInvalid m366 : 31|1@1+ (1,0) [0|0] "" Vector__XXX
 SG_ VCFRONT_a387_opportunisticTest m387 : 31|1@1+ (1,0) [0|0] "" Vector__XXX
 SG_ VCFRONT_a388_opportunisticTest m388 : 31|1@1+ (1,0) [0|0] "" Vector__XXX
 SG_ VCFRONT_a390_quietModeEnabled m390 : 31|1@1+ (1,0) [0|0] "" Vector__XXX
 SG_ VCFRONT_a394_droopDetectedStandstill m394 : 31|1@1+ (1,0) [0|0] "" Vector__XXX
 SG_ VCFRONT_a402_reverseBatteryFault m402 : 31|1@1+ (1,0) [0|0] "" Vector__XXX
 SG_ VCFRONT_a403_IBSAmpHours m403 : 31|14@1- (0.01,0) [0|0] "" Vector__XXX
 SG_ VCFRONT_a414_IBSCurrent m414 : 31|12@1- (0.1,0) [0|0] "" Vector__XXX
 SG_ VCFRONT_a446_hpCabinLoadType m446 : 31|2@1+ (1,0) [0|0] "" Vector__XXX
 SG_ VCFRONT_a447_refrigSuctionTempCompromised m447 : 31|1@1+ (1,0) [0|0] "" Vector__XXX
 SG_ VCFRONT_a462_KBValueLostFault m462 : 31|1@1+ (1,0) [0|0] "" Vector__XXX
 SG_ VCFRONT_a476_frunkOpen m476 : 31|1@1+ (1,0) [0|0] "" Vector__XXX
 SG_ VCFRONT_a480_fuseLatch m480 : 31|1@1+ (1,0) [0|0] "" Vector__XXX
 SG_ VCFRONT_a498_measuredCurrent m498 : 31|10@1- (0.25,0) [0|0] "" Vector__XXX
 SG_ VCFRONT_a565_UIChargePortDoorRequest m565 : 31|1@1+ (1,0) [0|0] "" Vector__XXX
 SG_ VCFRONT_a614_ptInletSensor m614 : 31|1@1+ (1,0) [0|0] "" Vector__XXX
 SG_ VCFRONT_a669_totalHvPowerBudget m669 : 31|6@1+ (0.5,0) [0|0] "" Vector__XXX
 SG_ VCFRONT_a000_alertDataW1 m0 : 32|16@1+ (1,0) [0|0] "" Vector__XXX
 SG_ VCFRONT_a003_LineNumber m3 : 32|16@1+ (1,0) [0|0] "" Vector__XXX
 SG_ VCFRONT_a005_busID1 m5 : 32|4@1+ (1,0) [0|0] "" Vector__XXX
 SG_ VCFRONT_a006_messageID m6 : 32|29@1+ (1,0) [0|0] "" Vector__XXX
 SG_ VCFRONT_a009_PsMin m9 : 32|6@1+ (0.1,0) [0|0] "" Vector__XXX
 SG_ VCFRONT_a016_NVMMRecordNotFound m16 : 32|1@1+ (1,0) [0|0] "" Vector__XXX
 SG_ VCFRONT_a022_TaskInitError1 m22 : 32|8@1+ (1,0) [0|0] "" Vector__XXX
 SG_ VCFRONT_a031_uds_bytes_2 m31 : 32|8@1+ (1,0) [0|0] "" Vector__XXX
 SG_ VCFRONT_a033_address m33 : 32|32@1+ (1,0) [0|0] "" Vector__XXX
 SG_ VCFRONT_a038_protectionContext m38 : 32|4@1+ (1,0) [0|0] "" Vector__XXX
 SG_ VCFRONT_a041_CPULoad10msTask m41 : 32|8@1+ (1,0) [0|0] "" Vector__XXX
 SG_ VCFRONT_a042_Usage100msTask m42 : 32|8@1+ (1,0) [0|0] "" Vector__XXX
 SG_ VCFRONT_a047_OcdActLinreg m47 : 32|1@1+ (1,0) [0|0] "" Vector__XXX
 SG_ VCFRONT_a063_ADCVoltage m63 : 32|8@1+ (0.025,0) [0|0] "" Vector__XXX
 SG_ VCFRONT_a104_PARTY_matrixBendAngleRequest m104 : 32|1@1+ (1,0) [0|0] "" Vector__XXX
 SG_ VCFRONT_a110_CH_epochTimeGtw m110 : 32|1@1+ (1,0) [0|0] "" Vector__XXX
 SG_ VCFRONT_a113_VEH_debugECU m113 : 32|1@1+ (1,0) [0|0] "" Vector__XXX
 SG_ VCFRONT_a114_BDY_wheelSpeeds m114 : 32|1@1+ (1,0) [0|0] "" Vector__XXX
 SG_ VCFRONT_a116_VEH_windowStatus m116 : 32|1@1+ (1,0) [0|0] "" Vector__XXX
 SG_ VCFRONT_a117_VEH_liftgateStatus m117 : 32|1@1+ (1,0) [0|0] "" Vector__XXX
 SG_ VCFRONT_a118_CH_sensors m118 : 32|1@1+ (1,0) [0|0] "" Vector__XXX
 SG_ VCFRONT_a120_PT_systemPower m120 : 32|1@1+ (1,0) [0|0] "" Vector__XXX
 SG_ VCFRONT_a127_vcleftEFuseVoltage m127 : 32|16@1+ (0.1,0) [0|0] "" Vector__XXX
 SG_ VCFRONT_a128_vcrightEFuseVoltage m128 : 32|16@1+ (0.1,0) [0|0] "" Vector__XXX
 SG_ VCFRONT_a129_pcsEFuseVoltage m129 : 32|16@1+ (0.1,0) [0|0] "" Vector__XXX
 SG_ VCFRONT_a130_epas3pEFuseVoltage m130 : 32|16@1+ (0.1,0) [0|0] "" Vector__XXX
 SG_ VCFRONT_a131_epas3sEFuseVoltage m131 : 32|16@1+ (0.1,0) [0|0] "" Vector__XXX
 SG_ VCFRONT_a132_iBoosterVoltage m132 : 32|16@1+ (0.1,0) [0|0] "" Vector__XXX
 SG_ VCFRONT_a133_espEFuseVoltage m133 : 32|16@1+ (0.1,0) [0|0] "" Vector__XXX
 SG_ VCFRONT_a134_fusedHighVoltage m134 : 32|16@1+ (0.1,0) [0|0] "" Vector__XXX
 SG_ VCFRONT_a142_isCoilShortYNGnd m142 : 32|1@1+ (1,0) [0|0] "" Vector__XXX
 SG_ VCFRONT_a153_UIUserActivity m153 : 32|1@1+ (1,0) [0|0] "" Vector__XXX
 SG_ VCFRONT_a160_compressorRpm m160 : 32|7@1+ (90,0) [0|0] "" Vector__XXX
 SG_ VCFRONT_a161_warnOverTemperature m161 : 32|1@1+ (1,0) [0|0] "" Vector__XXX
 SG_ VCFRONT_a163_powerIndexFiltered m163 : 32|7@1+ (1,0) [0|0] "" Vector__XXX
 SG_ VCFRONT_a171_IBST m171 : 32|1@1+ (1,0) [0|0] "" Vector__XXX
 SG_ VCFRONT_a180_hvcEFuseStable m180 : 32|1@1+ (1,0) [0|0] "" Vector__XXX
 SG_ VCFRONT_a182_ambientTemp m182 : 32|7@1+ (1,-40) [0|0] "" Vector__XXX
 SG_ VCFRONT_a183_ambientTemp m183 : 32|7@1+ (1,-40) [0|0] "" Vector__XXX
 SG_ VCFRONT_a184_evapInTemp m184 : 32|5@1+ (2,0) [0|0] "" Vector__XXX
 SG_ VCFRONT_a192_DI_gear m192 : 32|3@1+ (1,0) [0|0] "" Vector__XXX
 SG_ VCFRONT_a213_IBSAh m213 : 32|14@1- (0.01,0) [0|0] "" Vector__XXX
 SG_ VCFRONT_a219_IBSAh m219 : 32|14@1- (0.01,0) [0|0] "" Vector__XXX
 SG_ VCFRONT_a220_PCSCurrent m220 : 32|8@1+ (0.5,-127) [0|0] "" Vector__XXX
 SG_ VCFRONT_a243_IBSCurrent m243 : 32|16@1- (0.005,0) [0|0] "" Vector__XXX
 SG_ VCFRONT_a244_voltage m244 : 32|16@1+ (0.1,0) [0|0] "" Vector__XXX
 SG_ VCFRONT_a245_voltage m245 : 32|16@1+ (0.1,0) [0|0] "" Vector__XXX
 SG_ VCFRONT_a246_voltage m246 : 32|16@1+ (0.1,0) [0|0] "" Vector__XXX
 SG_ VCFRONT_a252_IBSAmpHours m252 : 32|14@1- (0.01,0) [0|0] "" Vector__XXX
 SG_ VCFRONT_a257_vcrightLockoutStatus m257 : 32|2@1+ (1,0) [0|0] "" Vector__XXX
 SG_ VCFRONT_a259_IBSTemp m259 : 32|16@1- (0.01,0) [0|0] "" Vector__XXX
 SG_ VCFRONT_a261_vbatProtVoltage m261 : 32|16@1+ (0.1,0) [0|0] "" Vector__XXX
 SG_ VCFRONT_a262_vbatProtVoltage m262 : 32|16@1+ (0.1,0) [0|0] "" Vector__XXX
 SG_ VCFRONT_a263_vbatProtVoltage m263 : 32|16@1+ (0.1,0) [0|0] "" Vector__XXX
 SG_ VCFRONT_a264_vbatProtVoltage m264 : 32|16@1+ (0.1,0) [0|0] "" Vector__XXX
 SG_ VCFRONT_a265_vbatProtVoltage m265 : 32|16@1+ (0.1,0) [0|0] "" Vector__XXX
 SG_ VCFRONT_a266_vbatProtVoltage m266 : 32|16@1+ (0.1,0) [0|0] "" Vector__XXX
 SG_ VCFRONT_a267_vbatProtVoltage m267 : 32|16@1+ (0.1,0) [0|0] "" Vector__XXX
 SG_ VCFRONT_a268_vbatProtVoltage m268 : 32|16@1+ (0.1,0) [0|0] "" Vector__XXX
 SG_ VCFRONT_a275_bmbChainBreakType m275 : 32|3@1+ (1,0) [0|0] "" Vector__XXX
 SG_ VCFRONT_a277_regErrorType m277 : 32|8@1+ (1,0) [0|0] "" Vector__XXX
 SG_ VCFRONT_a283_thmlFanDemandLimit m283 : 32|7@1+ (1,0) [0|0] "" Vector__XXX
 SG_ VCFRONT_a284_isCoilShortYNGnd m284 : 32|1@1+ (1,0) [0|0] "" Vector__XXX
 SG_ VCFRONT_a285_isCoilShortYNGnd m285 : 32|1@1+ (1,0) [0|0] "" Vector__XXX
 SG_ VCFRONT_a286_isCoilShortYNGnd m286 : 32|1@1+ (1,0) [0|0] "" Vector__XXX
 SG_ VCFRONT_a287_isCoilShortYNGnd m287 : 32|1@1+ (1,0) [0|0] "" Vector__XXX
 SG_ VCFRONT_a288_isCoilShortYNGnd m288 : 32|1@1+ (1,0) [0|0] "" Vector__XXX
 SG_ VCFRONT_a289_isCoilShortYNGnd m289 : 32|1@1+ (1,0) [0|0] "" Vector__XXX
 SG_ VCFRONT_a303_postVoltage m303 : 32|16@1+ (0.1,0) [0|0] "" Vector__XXX
 SG_ VCFRONT_a305_actuatorCurrent m305 : 32|8@1+ (0.1,0) [0|0] "" Vector__XXX
 SG_ VCFRONT_a306_actuatorCurrent m306 : 32|8@1+ (0.1,0) [0|0] "" Vector__XXX
 SG_ VCFRONT_a307_actuatorCurrent m307 : 32|8@1+ (0.1,0) [0|0] "" Vector__XXX
 SG_ VCFRONT_a308_actuatorCurrent m308 : 32|8@1+ (0.1,0) [0|0] "" Vector__XXX
 SG_ VCFRONT_a309_switchVoltage m309 : 32|16@1+ (0.1,0) [0|0] "" Vector__XXX
 SG_ VCFRONT_a326_maxCurrent m326 : 32|16@1+ (0.1,0) [0|0] "" Vector__XXX
 SG_ VCFRONT_a327_maxCurrent m327 : 32|16@1+ (0.1,0) [0|0] "" Vector__XXX
 SG_ VCFRONT_a328_maxCurrent m328 : 32|16@1+ (0.1,0) [0|0] "" Vector__XXX
 SG_ VCFRONT_a329_maxCurrent m329 : 32|16@1+ (0.1,0) [0|0] "" Vector__XXX
 SG_ VCFRONT_a330_maxCurrent m330 : 32|16@1+ (0.1,0) [0|0] "" Vector__XXX
 SG_ VCFRONT_a331_maxCurrent m331 : 32|16@1+ (0.1,0) [0|0] "" Vector__XXX
 SG_ VCFRONT_a332_maxCurrent m332 : 32|16@1+ (0.1,0) [0|0] "" Vector__XXX
 SG_ VCFRONT_a333_maxCurrent m333 : 32|16@1+ (0.1,0) [0|0] "" Vector__XXX
 SG_ VCFRONT_a353_ambientTemperature m353 : 32|8@1+ (0.5,-40) [0|0] "" Vector__XXX
 SG_ VCFRONT_a354_ambientTemperature m354 : 32|8@1+ (0.5,-40) [0|0] "" Vector__XXX
 SG_ VCFRONT_a363_avgBleedCharge m363 : 32|15@1+ (0.001,0) [0|0] "" Vector__XXX
 SG_ VCFRONT_a365_BMSSOCInvalid m365 : 32|1@1+ (1,0) [0|0] "" Vector__XXX
 SG_ VCFRONT_a366_BMSSOCTooLow m366 : 32|1@1+ (1,0) [0|0] "" Vector__XXX
 SG_ VCFRONT_a368_systemFaulted m368 : 32|1@1+ (1,0) [0|0] "" Vector__XXX
 SG_ VCFRONT_a369_wasteHeatPower m369 : 32|7@1+ (100,0) [0|0] "" Vector__XXX
 SG_ VCFRONT_a375_sampledADCValue m375 : 32|13@1+ (0.0002,0) [0|0] "" Vector__XXX
 SG_ VCFRONT_a376_IBSCurrentSampleAboveThresholdCount m376 : 32|16@1+ (1,0) [0|0] "" Vector__XXX
 SG_ VCFRONT_a387_IBSTemp m387 : 32|16@1- (0.01,0) [0|0] "" Vector__XXX
 SG_ VCFRONT_a388_IBSTemp m388 : 32|16@1- (0.01,0) [0|0] "" Vector__XXX
 SG_ VCFRONT_a389_temperature m389 : 32|8@1+ (0.5,-40) [0|0] "" Vector__XXX
 SG_ VCFRONT_a390_evaluateToFindDominantLoad m390 : 32|1@1+ (1,0) [0|0] "" Vector__XXX
 SG_ VCFRONT_a391_switch2Voltage m391 : 32|10@1+ (5,0) [0|0] "" Vector__XXX
 SG_ VCFRONT_a400_bmbDeviceId m400 : 32|4@1+ (1,1) [0|0] "" Vector__XXX
 SG_ VCFRONT_a402_MOSOpen m402 : 32|1@1+ (1,0) [0|0] "" Vector__XXX
 SG_ VCFRONT_a404_IBSTemp m404 : 32|16@1- (0.01,0) [0|0] "" Vector__XXX
 SG_ VCFRONT_a405_intervalVoltage2 m405 : 32|8@1+ (0.02,9) [0|0] "" Vector__XXX
 SG_ VCFRONT_a406_pulseCompareV m406 : 32|8@1+ (0.02,9) [0|0] "" Vector__XXX
 SG_ VCFRONT_a408_IBSAmpHours m408 : 32|14@1- (0.01,0) [0|0] "" Vector__XXX
 SG_ VCFRONT_a412_pulseVoltage2Shifted m412 : 32|8@1+ (0.02,9) [0|0] "" Vector__XXX
 SG_ VCFRONT_a413_bmbDeviceId m413 : 32|4@1+ (1,1) [0|0] "" Vector__XXX
 SG_ VCFRONT_a421_uartConditionBitfield m421 : 32|16@1+ (1,0) [0|0] "" Vector__XXX
 SG_ VCFRONT_a425_maxBusVoltageLimit m425 : 32|16@1+ (0.002,0) [0|0] "" Vector__XXX
 SG_ VCFRONT_a426_minBusVoltageLimit m426 : 32|16@1+ (0.002,0) [0|0] "" Vector__XXX
 SG_ VCFRONT_a430_maxChargeCurrentLimit m430 : 32|16@1- (0.1,0) [0|0] "" Vector__XXX
 SG_ VCFRONT_a431_maxChargeCurrentLimit m431 : 32|16@1- (0.1,0) [0|0] "" Vector__XXX
 SG_ VCFRONT_a432_packCurrent m432 : 32|16@1- (0.1,0) [0|0] "" Vector__XXX
 SG_ VCFRONT_a433_packTypeData m433 : 32|8@1+ (1,0) [0|0] "" Vector__XXX
 SG_ VCFRONT_a434_packTypeData m434 : 32|8@1+ (1,0) [0|0] "" Vector__XXX
 SG_ VCFRONT_a435_maxDischargeCurrentLimit m435 : 32|16@1- (0.1,0) [0|0] "" Vector__XXX
 SG_ VCFRONT_a436_maxDischargeCurrentLimit m436 : 32|16@1- (0.1,0) [0|0] "" Vector__XXX
 SG_ VCFRONT_a438_sensorId m438 : 32|6@1+ (1,1) [0|0] "" Vector__XXX
 SG_ VCFRONT_a439_sensorId m439 : 32|6@1+ (1,1) [0|0] "" Vector__XXX
 SG_ VCFRONT_a441_bmbModuleIdPrev m441 : 32|16@1+ (1,0) [0|0] "" Vector__XXX
 SG_ VCFRONT_a442_maxSocChangeBrickId m442 : 32|7@1+ (1,1) [0|0] "" Vector__XXX
 SG_ VCFRONT_a444_watchdog m444 : 32|1@1+ (1,0) [0|0] "" Vector__XXX
 SG_ VCFRONT_a445_expectedLSB m445 : 32|8@1+ (1,0) [0|0] "" Vector__XXX
 SG_ VCFRONT_a447_refrigLiquidPressCompromised m447 : 32|1@1+ (1,0) [0|0] "" Vector__XXX
 SG_ VCFRONT_a462_BalanceCircuitFault m462 : 32|1@1+ (1,0) [0|0] "" Vector__XXX
 SG_ VCFRONT_a463_switch2Voltage m463 : 32|10@1+ (5,0) [0|0] "" Vector__XXX
 SG_ VCFRONT_a464_subcool m464 : 32|7@1+ (0.4,-10) [0|0] "" Vector__XXX
 SG_ VCFRONT_a465_subcool m465 : 32|7@1+ (0.4,-10) [0|0] "" Vector__XXX
 SG_ VCFRONT_a466_subcool m466 : 32|7@1+ (0.4,-10) [0|0] "" Vector__XXX
 SG_ VCFRONT_a474_ssl100Bank9Status m474 : 32|2@1+ (1,0) [0|0] "" Vector__XXX
 SG_ VCFRONT_a475_ssl100Bank9Status m475 : 32|2@1+ (1,0) [0|0] "" Vector__XXX
 SG_ VCFRONT_a476_vehiclePowerState m476 : 32|2@1+ (1,0) [0|0] "" Vector__XXX
 SG_ VCFRONT_a478_dcdcLVSupportStatus m478 : 32|2@1+ (1,0) [0|0] "" Vector__XXX
 SG_ VCFRONT_a479_batterySMState m479 : 32|4@1+ (1,0) [0|0] "" Vector__XXX
 SG_ VCFRONT_a480_deviceOvertemperature m480 : 32|1@1+ (1,0) [0|0] "" Vector__XXX
 SG_ VCFRONT_a484_vehiclePitchWhenLastAimed m484 : 32|10@1- (0.0001,0) [0|0] "" Vector__XXX
 SG_ VCFRONT_a492_maxBrickSocId m492 : 32|7@1+ (1,1) [0|0] "" Vector__XXX
 SG_ VCFRONT_a493_maxBrickSocId m493 : 32|7@1+ (1,1) [0|0] "" Vector__XXX
 SG_ VCFRONT_a497_PackCurrent m497 : 32|12@1+ (0.2,-600) [0|0] "" Vector__XXX
 SG_ VCFRONT_a509_vcrightEFuseTemp m509 : 32|8@1+ (0.75,0) [0|0] "" Vector__XXX
 SG_ VCFRONT_a510_targetPCSVoltage m510 : 32|8@1+ (0.1,0) [0|0] "" Vector__XXX
 SG_ VCFRONT_a511_DCDCMaxOutputCurrentAllowed m511 : 32|16@1- (0.1,0) [0|0] "" Vector__XXX
 SG_ VCFRONT_a512_packTemperature m512 : 32|8@1+ (1,-40) [0|0] "" Vector__XXX
 SG_ VCFRONT_a513_packTemperature m513 : 32|8@1+ (1,-40) [0|0] "" Vector__XXX
 SG_ VCFRONT_a521_vcleftEFuseTemp m521 : 32|8@1+ (0.75,0) [0|0] "" Vector__XXX
 SG_ VCFRONT_a523_control2Byte2 m523 : 32|8@1+ (1,0) [0|0] "" Vector__XXX
 SG_ VCFRONT_a529_LVBatteryTemp m529 : 32|16@1- (0.01,0) [0|0] "" Vector__XXX
 SG_ VCFRONT_a530_IBSCurrent m530 : 32|16@1- (0.1,0) [0|0] "" Vector__XXX
 SG_ VCFRONT_a534_measuredOpenRange m534 : 32|8@1+ (7,0) [0|0] "" Vector__XXX
 SG_ VCFRONT_a535_measuredOpenRange m535 : 32|8@1+ (7,0) [0|0] "" Vector__XXX
 SG_ VCFRONT_a536_measuredOpenRange m536 : 32|8@1+ (7,0) [0|0] "" Vector__XXX
 SG_ VCFRONT_a537_measuredOpenRange m537 : 32|8@1+ (7,0) [0|0] "" Vector__XXX
 SG_ VCFRONT_a538_measuredOpenRange m538 : 32|8@1+ (7,0) [0|0] "" Vector__XXX
 SG_ VCFRONT_a539_measuredOpenRange m539 : 32|8@1+ (7,0) [0|0] "" Vector__XXX
 SG_ VCFRONT_a542_suctionPressure m542 : 32|6@1+ (0.5,0) [0|0] "" Vector__XXX
 SG_ VCFRONT_a548_BMS_MIA m548 : 32|1@1+ (1,0) [0|0] "" Vector__XXX
 SG_ VCFRONT_a561_cell1Voltage m561 : 32|7@1+ (0.04,0) [0|0] "" Vector__XXX
 SG_ VCFRONT_a562_cell1Voltage m562 : 32|7@1+ (0.04,0) [0|0] "" Vector__XXX
 SG_ VCFRONT_a565_UIUserActivity m565 : 32|1@1+ (1,0) [0|0] "" Vector__XXX
 SG_ VCFRONT_a572_hvacCompressorVoltage m572 : 32|16@1+ (0.1,0) [0|0] "" Vector__XXX
 SG_ VCFRONT_a573_radarVoltage m573 : 32|16@1+ (0.1,0) [0|0] "" Vector__XXX
 SG_ VCFRONT_a574_frontDriveInverterVoltage m574 : 32|16@1+ (0.1,0) [0|0] "" Vector__XXX
 SG_ VCFRONT_a575_frontOilPumpVoltage m575 : 32|16@1+ (0.1,0) [0|0] "" Vector__XXX
 SG_ VCFRONT_a576_mcuLogicVoltage m576 : 32|16@1+ (0.1,0) [0|0] "" Vector__XXX
 SG_ VCFRONT_a577_tasVoltage m577 : 32|16@1+ (0.1,0) [0|0] "" Vector__XXX
 SG_ VCFRONT_a578_vbatFusedLowCurrentFeedVoltage m578 : 32|16@1+ (0.1,0) [0|0] "" Vector__XXX
 SG_ VCFRONT_a579_leftHeadlightVoltage m579 : 32|16@1+ (0.1,0) [0|0] "" Vector__XXX
 SG_ VCFRONT_a580_rightHeadlightVoltage m580 : 32|16@1+ (0.1,0) [0|0] "" Vector__XXX
 SG_ VCFRONT_a581_windshieldWiperVoltage m581 : 32|16@1+ (0.1,0) [0|0] "" Vector__XXX
 SG_ VCFRONT_a582_LVBusVoltage m582 : 32|8@1+ (0.1,0) [0|0] "" Vector__XXX
 SG_ VCFRONT_a583_switch2StuckReason m583 : 32|2@1+ (1,0) [0|0] "" Vector__XXX
 SG_ VCFRONT_a589_vcleftTimingThresholdMs m589 : 32|16@1+ (1,0) [0|0] "" Vector__XXX
 SG_ VCFRONT_a591_vcrightTimingThresholdMs m591 : 32|16@1+ (1,0) [0|0] "" Vector__XXX
 SG_ VCFRONT_a593_vcleftCutoffTimingThresholdMs m593 : 32|16@1+ (1,0) [0|0] "" Vector__XXX
 SG_ VCFRONT_a594_virtualPitchLearnedCalibration m594 : 32|9@1- (0.0005,0) [0|0] "" Vector__XXX
 SG_ VCFRONT_a597_vcrightCutoffTimingThresholdMs m597 : 32|16@1+ (1,0) [0|0] "" Vector__XXX
 SG_ VCFRONT_a608_bleedFetFailureBrickId m608 : 32|5@1+ (1,1) [0|0] "" Vector__XXX
 SG_ VCFRONT_a610_temperature m610 : 32|8@1+ (0.5,-40) [0|0] "" Vector__XXX
 SG_ VCFRONT_a612_lvHealthStatus m612 : 32|3@1+ (1,0) [0|0] "" Vector__XXX
 SG_ VCFRONT_a614_coolantLevelSensorFault m614 : 32|1@1+ (1,0) [0|0] "" Vector__XXX
 SG_ VCFRONT_a618_evapOutTemp m618 : 32|6@1+ (1,0) [0|0] "" Vector__XXX
 SG_ VCFRONT_a619_temperature m619 : 32|8@1+ (0.5,-40) [0|0] "" Vector__XXX
 SG_ VCFRONT_a623_lvHealthStatus m623 : 32|3@1+ (1,0) [0|0] "" Vector__XXX
 SG_ VCFRONT_a628_lastMeasuredTemp m628 : 32|8@1+ (0.5,-20) [0|0] "" Vector__XXX
 SG_ VCFRONT_a635_requestSleepFailedBitmask m635 : 32|16@1+ (1,0) [0|0] "" Vector__XXX
 SG_ VCFRONT_a643_uartConditionBitfield m643 : 32|16@1+ (1,0) [0|0] "" Vector__XXX
 SG_ VCFRONT_a645_averagePrimedFluidCurrent m645 : 32|8@1- (0.0984251968503937,5.807086614173229) [0|0] "" Vector__XXX
 SG_ VCFRONT_a016_NVMMCRCMismatch m16 : 33|1@1+ (1,0) [0|0] "" Vector__XXX
 SG_ VCFRONT_a047_OcdDpslpLinreg m47 : 33|1@1+ (1,0) [0|0] "" Vector__XXX
 SG_ VCFRONT_a104_VEH_matrixHighBeamRequest m104 : 33|1@1+ (1,0) [0|0] "" Vector__XXX
 SG_ VCFRONT_a113_VEH_status m113 : 33|1@1+ (1,0) [0|0] "" Vector__XXX
 SG_ VCFRONT_a114_CH_party1 m114 : 33|1@1+ (1,0) [0|0] "" Vector__XXX
 SG_ VCFRONT_a116_PARTY_restraintStatus m116 : 33|1@1+ (1,0) [0|0] "" Vector__XXX
 SG_ VCFRONT_a117_VEH_seatStatus2 m117 : 33|1@1+ (1,0) [0|0] "" Vector__XXX
 SG_ VCFRONT_a118_VEH_interNodeResistance m118 : 33|1@1+ (1,0) [0|0] "" Vector__XXX
 SG_ VCFRONT_a120_PARTY_stalklessInterfaces m120 : 33|1@1+ (1,0) [0|0] "" Vector__XXX
 SG_ VCFRONT_a142_isCoilShortYNVbb m142 : 33|1@1+ (1,0) [0|0] "" Vector__XXX
 SG_ VCFRONT_a153_passengerPresent m153 : 33|1@1+ (1,0) [0|0] "" Vector__XXX
 SG_ VCFRONT_a161_failedStartRepeated m161 : 33|1@1+ (1,0) [0|0] "" Vector__XXX
 SG_ VCFRONT_a171_IBSTCAL m171 : 33|1@1+ (1,0) [0|0] "" Vector__XXX
 SG_ VCFRONT_a180_replaceLVBattery m180 : 33|1@1+ (1,0) [0|0] "" Vector__XXX
 SG_ VCFRONT_a191_a180_DCDCNotSupportingLVBus m191 : 33|1@1+ (1,0) [0|0] "" Vector__XXX
 SG_ VCFRONT_a284_isCoilShortYNVbb m284 : 33|1@1+ (1,0) [0|0] "" Vector__XXX
 SG_ VCFRONT_a285_isCoilShortYNVbb m285 : 33|1@1+ (1,0) [0|0] "" Vector__XXX
 SG_ VCFRONT_a286_isCoilShortYNVbb m286 : 33|1@1+ (1,0) [0|0] "" Vector__XXX
 SG_ VCFRONT_a287_isCoilShortYNVbb m287 : 33|1@1+ (1,0) [0|0] "" Vector__XXX
 SG_ VCFRONT_a288_isCoilShortYNVbb m288 : 33|1@1+ (1,0) [0|0] "" Vector__XXX
 SG_ VCFRONT_a289_isCoilShortYNVbb m289 : 33|1@1+ (1,0) [0|0] "" Vector__XXX
 SG_ VCFRONT_a365_BMSSOCTooLow m365 : 33|1@1+ (1,0) [0|0] "" Vector__XXX
 SG_ VCFRONT_a366_DIMIA m366 : 33|1@1+ (1,0) [0|0] "" Vector__XXX
 SG_ VCFRONT_a368_coolantTempSensorsFaulted m368 : 33|1@1+ (1,0) [0|0] "" Vector__XXX
 SG_ VCFRONT_a402_serviceMode m402 : 33|1@1+ (1,0) [0|0] "" Vector__XXX
 SG_ VCFRONT_a407_intervalCurrentVariance m407 : 33|6@1+ (0.1,0) [0|0] "" Vector__XXX
 SG_ VCFRONT_a444_gateDriver m444 : 33|1@1+ (1,0) [0|0] "" Vector__XXX
 SG_ VCFRONT_a446_hpBatteryLoadType m446 : 33|2@1+ (1,0) [0|0] "" Vector__XXX
 SG_ VCFRONT_a447_refrigLiquidTempCompromised m447 : 33|1@1+ (1,0) [0|0] "" Vector__XXX
 SG_ VCFRONT_a462_MOSOpenFault m462 : 33|1@1+ (1,0) [0|0] "" Vector__XXX
 SG_ VCFRONT_a480_ntcOvertemperature m480 : 33|1@1+ (1,0) [0|0] "" Vector__XXX
 SG_ VCFRONT_a518_targetPCSVoltage m518 : 33|8@1+ (0.1,0) [0|0] "" Vector__XXX
 SG_ VCFRONT_a548_PCS_MIA m548 : 33|1@1+ (1,0) [0|0] "" Vector__XXX
 SG_ VCFRONT_a565_passengerPresent m565 : 33|1@1+ (1,0) [0|0] "" Vector__XXX
 SG_ VCFRONT_a584_switch2Voltage m584 : 33|9@1+ (10,0) [0|0] "" Vector__XXX
 SG_ VCFRONT_a614_coolantLevelSensorLow m614 : 33|1@1+ (1,0) [0|0] "" Vector__XXX
 SG_ VCFRONT_a626_intervalCurrentVariance m626 : 33|6@1+ (0.1,0) [0|0] "" Vector__XXX
 SG_ VCFRONT_a016_NVMMVersionMismatch m16 : 34|1@1+ (1,0) [0|0] "" Vector__XXX
 SG_ VCFRONT_a047_OcdReghc m47 : 34|1@1+ (1,0) [0|0] "" Vector__XXX
 SG_ VCFRONT_a104_VEH_summonCommand m104 : 34|1@1+ (1,0) [0|0] "" Vector__XXX
 SG_ VCFRONT_a113_VEH_elevationStatus m113 : 34|1@1+ (1,0) [0|0] "" Vector__XXX
 SG_ VCFRONT_a114_CH_party3 m114 : 34|1@1+ (1,0) [0|0] "" Vector__XXX
 SG_ VCFRONT_a116_PARTY_doorStatus m116 : 34|1@1+ (1,0) [0|0] "" Vector__XXX
 SG_ VCFRONT_a117_PARTY_restraintStatus m117 : 34|1@1+ (1,0) [0|0] "" Vector__XXX
 SG_ VCFRONT_a118_CH_lighting m118 : 34|1@1+ (1,0) [0|0] "" Vector__XXX
 SG_ VCFRONT_a120_CH_speed m120 : 34|1@1+ (1,0) [0|0] "" Vector__XXX
 SG_ VCFRONT_a142_driverHasCommError m142 : 34|1@1+ (1,0) [0|0] "" Vector__XXX
 SG_ VCFRONT_a153_chargeStateTransitioned m153 : 34|1@1+ (1,0) [0|0] "" Vector__XXX
 SG_ VCFRONT_a161_overload m161 : 34|1@1+ (1,0) [0|0] "" Vector__XXX
 SG_ VCFRONT_a171_ESP m171 : 34|1@1+ (1,0) [0|0] "" Vector__XXX
 SG_ VCFRONT_a180_BMS_MIA m180 : 34|1@1+ (1,0) [0|0] "" Vector__XXX
 SG_ VCFRONT_a187_hvsBusRetryCount m187 : 34|9@1+ (1,0) [0|0] "" Vector__XXX
 SG_ VCFRONT_a191_MOSState m191 : 34|2@1+ (1,0) [0|0] "" Vector__XXX
 SG_ VCFRONT_a253_IBSAmpHours m253 : 34|14@1- (0.01,0) [0|0] "" Vector__XXX
 SG_ VCFRONT_a257_vcleftFault m257 : 34|1@1+ (1,0) [0|0] "" Vector__XXX
 SG_ VCFRONT_a284_driverHasCommError m284 : 34|1@1+ (1,0) [0|0] "" Vector__XXX
 SG_ VCFRONT_a285_driverHasCommError m285 : 34|1@1+ (1,0) [0|0] "" Vector__XXX
 SG_ VCFRONT_a286_driverHasCommError m286 : 34|1@1+ (1,0) [0|0] "" Vector__XXX
 SG_ VCFRONT_a287_driverHasCommError m287 : 34|1@1+ (1,0) [0|0] "" Vector__XXX
 SG_ VCFRONT_a288_driverHasCommError m288 : 34|1@1+ (1,0) [0|0] "" Vector__XXX
 SG_ VCFRONT_a289_driverHasCommError m289 : 34|1@1+ (1,0) [0|0] "" Vector__XXX
 SG_ VCFRONT_a352_prevFilteredCurrent m352 : 34|8@1+ (0.1,0) [0|0] "" Vector__XXX
 SG_ VCFRONT_a365_DIMIA m365 : 34|1@1+ (1,0) [0|0] "" Vector__XXX
 SG_ VCFRONT_a366_PCSMIA m366 : 34|1@1+ (1,0) [0|0] "" Vector__XXX
 SG_ VCFRONT_a368_coolantValveFaulted m368 : 34|1@1+ (1,0) [0|0] "" Vector__XXX
 SG_ VCFRONT_a402_frunkOpen m402 : 34|1@1+ (1,0) [0|0] "" Vector__XXX
 SG_ VCFRONT_a427_deltaAh m427 : 34|9@1+ (0.5,0) [0|0] "" Vector__XXX
 SG_ VCFRONT_a444_overcurrent m444 : 34|1@1+ (1,0) [0|0] "" Vector__XXX
 SG_ VCFRONT_a462_DeepDischarge m462 : 34|1@1+ (1,0) [0|0] "" Vector__XXX
 SG_ VCFRONT_a474_lowBeamPrefieldStatus m474 : 34|3@1+ (1,0) [0|0] "" Vector__XXX
 SG_ VCFRONT_a475_lowBeamPrefieldStatus m475 : 34|3@1+ (1,0) [0|0] "" Vector__XXX
 SG_ VCFRONT_a476_batterySMState m476 : 34|4@1+ (1,0) [0|0] "" Vector__XXX
 SG_ VCFRONT_a477_cell3Voltage m477 : 34|9@1+ (0.01,0) [0|0] "" Vector__XXX
 SG_ VCFRONT_a478_factoryMode m478 : 34|1@1+ (1,0) [0|0] "" Vector__XXX
 SG_ VCFRONT_a480_vgsLow m480 : 34|1@1+ (1,0) [0|0] "" Vector__XXX
 SG_ VCFRONT_a481_VDSFinished m481 : 34|1@1+ (1,0) [0|0] "" Vector__XXX
 SG_ VCFRONT_a516_contactorsPermanentlyClosed m516 : 34|1@1+ (1,0) [0|0] "" Vector__XXX
 SG_ VCFRONT_a522_contactorsPermanentlyClosed m522 : 34|1@1+ (1,0) [0|0] "" Vector__XXX
 SG_ VCFRONT_a548_ampHourBucketCount m548 : 34|6@1+ (0.01,0) [0|0] "" Vector__XXX
 SG_ VCFRONT_a565_chargeStateTransitioned m565 : 34|1@1+ (1,0) [0|0] "" Vector__XXX
 SG_ VCFRONT_a583_disagreementDurationMS m583 : 34|19@1+ (100,0) [0|0] "" Vector__XXX
 SG_ VCFRONT_a614_louverFault m614 : 34|1@1+ (1,0) [0|0] "" Vector__XXX
 SG_ VCFRONT_a627_cell3Voltage m627 : 34|9@1+ (0.01,0) [0|0] "" Vector__XXX
 SG_ VCFRONT_a663_hcmlGroupsHighWaterMarkPercent_IC500 m663 : 34|5@1+ (3.225806451612903,0) [0|0] "" Vector__XXX
 SG_ VCFRONT_a664_hcmrGroupsHighWaterMarkPercent_IC500 m664 : 34|5@1+ (3.225806451612903,0) [0|0] "" Vector__XXX
 SG_ VCFRONT_a016_NVMMRecordUpgraded m16 : 35|1@1+ (1,0) [0|0] "" Vector__XXX
 SG_ VCFRONT_a047_Pmic m47 : 35|1@1+ (1,0) [0|0] "" Vector__XXX
 SG_ VCFRONT_a104_VEH_status m104 : 35|1@1+ (1,0) [0|0] "" Vector__XXX
 SG_ VCFRONT_a113_VEH_LVControl m113 : 35|1@1+ (1,0) [0|0] "" Vector__XXX
 SG_ VCFRONT_a114_CH_status m114 : 35|1@1+ (1,0) [0|0] "" Vector__XXX
 SG_ VCFRONT_a116_BDY_epbmStatus m116 : 35|1@1+ (1,0) [0|0] "" Vector__XXX
 SG_ VCFRONT_a117_VEH_thermalStatus m117 : 35|1@1+ (1,0) [0|0] "" Vector__XXX
 SG_ VCFRONT_a118_VEH_lightStatus m118 : 35|1@1+ (1,0) [0|0] "" Vector__XXX
 SG_ VCFRONT_a120_VEH_estimatedBrakeTemp m120 : 35|1@1+ (1,0) [0|0] "" Vector__XXX
 SG_ VCFRONT_a153_mismatchDuration m153 : 35|26@1+ (1,0) [0|0] "" Vector__XXX
 SG_ VCFRONT_a155_minHVComingUpIBSCurrent m155 : 35|10@1+ (0.1,-102.3) [0|0] "" Vector__XXX
 SG_ VCFRONT_a171_ESPCAL m171 : 35|1@1+ (1,0) [0|0] "" Vector__XXX
 SG_ VCFRONT_a178_pressureSuction m178 : 35|4@1+ (1,0) [0|0] "" Vector__XXX
 SG_ VCFRONT_a180_PCS_MIA m180 : 35|1@1+ (1,0) [0|0] "" Vector__XXX
 SG_ VCFRONT_a192_GTW_factoryGated m192 : 35|1@1+ (1,0) [0|0] "" Vector__XXX
 SG_ VCFRONT_a257_vcrightFault m257 : 35|1@1+ (1,0) [0|0] "" Vector__XXX
 SG_ VCFRONT_a365_PCSMIA m365 : 35|1@1+ (1,0) [0|0] "" Vector__XXX
 SG_ VCFRONT_a366_pcsFlowRequest m366 : 35|1@1+ (1,0) [0|0] "" Vector__XXX
 SG_ VCFRONT_a368_louverFaulted m368 : 35|1@1+ (1,0) [0|0] "" Vector__XXX
 SG_ VCFRONT_a444_supplyUndervoltage m444 : 35|1@1+ (1,0) [0|0] "" Vector__XXX
 SG_ VCFRONT_a446_usingModeledPs m446 : 35|1@1+ (1,0) [0|0] "" Vector__XXX
 SG_ VCFRONT_a462_SamplingError m462 : 35|1@1+ (1,0) [0|0] "" Vector__XXX
 SG_ VCFRONT_a478_serviceMode m478 : 35|1@1+ (1,0) [0|0] "" Vector__XXX
 SG_ VCFRONT_a480_chargePumpLow m480 : 35|1@1+ (1,0) [0|0] "" Vector__XXX
 SG_ VCFRONT_a481_VDSFailure m481 : 35|1@1+ (1,0) [0|0] "" Vector__XXX
 SG_ VCFRONT_a516_LVBatteryDisconnected m516 : 35|1@1+ (1,0) [0|0] "" Vector__XXX
 SG_ VCFRONT_a522_LVBatteryDisconnected m522 : 35|1@1+ (1,0) [0|0] "" Vector__XXX
 SG_ VCFRONT_a541_PeakCurrent m541 : 35|10@1+ (0.05,0) [0|0] "" Vector__XXX
 SG_ VCFRONT_a565_lastUserPresenceUpdateEpochTime m565 : 35|26@1+ (64,0) [0|0] "" Vector__XXX
 SG_ VCFRONT_a623_unhealthyReason m623 : 35|5@1+ (1,0) [0|0] "" Vector__XXX
 SG_ VCFRONT_a005_faults1 m5 : 36|12@1+ (1,0) [0|0] "" Vector__XXX
 SG_ VCFRONT_a016_NVMMMemOverflow m16 : 36|1@1+ (1,0) [0|0] "" Vector__XXX
 SG_ VCFRONT_a038_violationType m38 : 36|3@1+ (1,0) [0|0] "" Vector__XXX
 SG_ VCFRONT_a047_Porvddd m47 : 36|1@1+ (1,0) [0|0] "" Vector__XXX
 SG_ VCFRONT_a104_CH_pscControl m104 : 36|1@1+ (1,0) [0|0] "" Vector__XXX
 SG_ VCFRONT_a113_CH_chassisControl m113 : 36|1@1+ (1,0) [0|0] "" Vector__XXX
 SG_ VCFRONT_a116_BDY_restraintStatus m116 : 36|1@1+ (1,0) [0|0] "" Vector__XXX
 SG_ VCFRONT_a117_PARTY_doorStatus m117 : 36|1@1+ (1,0) [0|0] "" Vector__XXX
 SG_ VCFRONT_a118_PARTY_vehNm m118 : 36|1@1+ (1,0) [0|0] "" Vector__XXX
 SG_ VCFRONT_a120_PARTY_prndControl m120 : 36|1@1+ (1,0) [0|0] "" Vector__XXX
 SG_ VCFRONT_a162_ccLeftExvFlow m162 : 36|7@1+ (1,0) [0|0] "" Vector__XXX
 SG_ VCFRONT_a171_OPC m171 : 36|1@1+ (1,0) [0|0] "" Vector__XXX
 SG_ VCFRONT_a180_HVBlockingMismatch m180 : 36|1@1+ (1,0) [0|0] "" Vector__XXX
 SG_ VCFRONT_a188_vehicleState m188 : 36|5@1+ (1,0) [0|0] "" Vector__XXX
 SG_ VCFRONT_a191_LVBMSVoltage m191 : 36|8@1+ (0.08741903380905883,0) [0|0] "" Vector__XXX
 SG_ VCFRONT_a192_GTW_updateStarted m192 : 36|1@1+ (1,0) [0|0] "" Vector__XXX
 SG_ VCFRONT_a242_IBSVoltage m242 : 36|11@1+ (0.01088735219,0) [0|0] "" Vector__XXX
 SG_ VCFRONT_a257_pcsFault m257 : 36|1@1+ (1,0) [0|0] "" Vector__XXX
 SG_ VCFRONT_a269_IBSVoltage m269 : 36|11@1+ (0.01088735219,0) [0|0] "" Vector__XXX
 SG_ VCFRONT_a365_pcsFlowRequest m365 : 36|1@1+ (1,0) [0|0] "" Vector__XXX
 SG_ VCFRONT_a366_showroomMode m366 : 36|1@1+ (1,0) [0|0] "" Vector__XXX
 SG_ VCFRONT_a368_fansFaulted m368 : 36|1@1+ (1,0) [0|0] "" Vector__XXX
 SG_ VCFRONT_a400_VrefStatus m400 : 36|2@1+ (1,0) [0|0] "" Vector__XXX
 SG_ VCFRONT_a401_IBSVoltage m401 : 36|11@1+ (0.01088735219,0) [0|0] "" Vector__XXX
 SG_ VCFRONT_a410_IBSVoltage m410 : 36|11@1+ (0.01088735219,0) [0|0] "" Vector__XXX
 SG_ VCFRONT_a411_IBSVoltage m411 : 36|11@1+ (0.01088735219,0) [0|0] "" Vector__XXX
 SG_ VCFRONT_a413_VrefStatus m413 : 36|2@1+ (1,0) [0|0] "" Vector__XXX
 SG_ VCFRONT_a416_packCurrent m416 : 36|10@1- (5,0) [0|0] "" Vector__XXX
 SG_ VCFRONT_a417_packCurrent m417 : 36|10@1- (5,0) [0|0] "" Vector__XXX
 SG_ VCFRONT_a418_packCurrent m418 : 36|10@1- (5,0) [0|0] "" Vector__XXX
 SG_ VCFRONT_a419_packCurrent m419 : 36|10@1- (5,0) [0|0] "" Vector__XXX
 SG_ VCFRONT_a423_packCurrent m423 : 36|10@1- (5,0) [0|0] "" Vector__XXX
 SG_ VCFRONT_a424_packCurrent m424 : 36|10@1- (5,0) [0|0] "" Vector__XXX
 SG_ VCFRONT_a444_cpUndervoltage m444 : 36|1@1+ (1,0) [0|0] "" Vector__XXX
 SG_ VCFRONT_a446_usingModeledPd m446 : 36|1@1+ (1,0) [0|0] "" Vector__XXX
 SG_ VCFRONT_a462_MOSFETStuckClose m462 : 36|1@1+ (1,0) [0|0] "" Vector__XXX
 SG_ VCFRONT_a472_rangeIndex m472 : 36|2@1+ (1,0) [0|0] "" Vector__XXX
 SG_ VCFRONT_a473_rangeIndex m473 : 36|2@1+ (1,0) [0|0] "" Vector__XXX
 SG_ VCFRONT_a478_transportMode m478 : 36|1@1+ (1,0) [0|0] "" Vector__XXX
 SG_ VCFRONT_a480_watchdog m480 : 36|1@1+ (1,0) [0|0] "" Vector__XXX
 SG_ VCFRONT_a481_stuckOnVDS m481 : 36|10@1+ (1,0) [0|0] "" Vector__XXX
 SG_ VCFRONT_a503_packCurrent m503 : 36|10@1- (5,0) [0|0] "" Vector__XXX
 SG_ VCFRONT_a516_reverseBatteryFault m516 : 36|1@1+ (1,0) [0|0] "" Vector__XXX
 SG_ VCFRONT_a522_reverseBatteryFault m522 : 36|1@1+ (1,0) [0|0] "" Vector__XXX
 SG_ VCFRONT_a527_cell3Voltage m527 : 36|10@1+ (0.01,0) [0|0] "" Vector__XXX
 SG_ VCFRONT_a555_cell3Voltage m555 : 36|10@1+ (0.01,0) [0|0] "" Vector__XXX
 SG_ VCFRONT_a558_worseCaseRequiredRange m558 : 36|10@1+ (1,0) [0|0] "" Vector__XXX
 SG_ VCFRONT_a559_vehiclePowerState m559 : 36|2@1+ (1,0) [0|0] "" Vector__XXX
 SG_ VCFRONT_a564_worseCaseRequiredRange m564 : 36|10@1+ (1,0) [0|0] "" Vector__XXX
 SG_ VCFRONT_a585_rightHeadlampInternalErrorMask m585 : 36|20@1+ (1,0) [0|0] "" Vector__XXX
 SG_ VCFRONT_a605_sleepBypassCurrent m605 : 36|10@1+ (0.1,0) [0|0] "" Vector__XXX
 SG_ VCFRONT_a611_radFanSpeed m611 : 36|5@1+ (150,0) [0|0] "" Vector__XXX
 SG_ VCFRONT_a634_ajar1ClosingDeltaV m634 : 36|10@1- (0.01,0) [0|0] "" Vector__XXX
 SG_ VCFRONT_a644_pumpPrimedEstimate m644 : 36|1@1+ (1,0) [0|0] "" Vector__XXX
 SG_ VCFRONT_a016_NVMMWriteFailed m16 : 37|1@1+ (1,0) [0|0] "" Vector__XXX
 SG_ VCFRONT_a104_BDY_gpsAccuracies m104 : 37|1@1+ (1,0) [0|0] "" Vector__XXX
 SG_ VCFRONT_a113_CH_powertrainControl m113 : 37|1@1+ (1,0) [0|0] "" Vector__XXX
 SG_ VCFRONT_a117_VEH_status m117 : 37|1@1+ (1,0) [0|0] "" Vector__XXX
 SG_ VCFRONT_a118_CH_12VBatteryStatus m118 : 37|1@1+ (1,0) [0|0] "" Vector__XXX
 SG_ VCFRONT_a120_PARTY_locStatus2 m120 : 37|1@1+ (1,0) [0|0] "" Vector__XXX
 SG_ VCFRONT_a171_OPCS m171 : 37|1@1+ (1,0) [0|0] "" Vector__XXX
 SG_ VCFRONT_a180_serviceMode m180 : 37|1@1+ (1,0) [0|0] "" Vector__XXX
 SG_ VCFRONT_a192_serviceMode m192 : 37|1@1+ (1,0) [0|0] "" Vector__XXX
 SG_ VCFRONT_a257_vbatFusedFault m257 : 37|1@1+ (1,0) [0|0] "" Vector__XXX
 SG_ VCFRONT_a365_showroomMode m365 : 37|1@1+ (1,0) [0|0] "" Vector__XXX
 SG_ VCFRONT_a366_TransportMode m366 : 37|1@1+ (1,0) [0|0] "" Vector__XXX
 SG_ VCFRONT_a368_coolantNotFilled m368 : 37|1@1+ (1,0) [0|0] "" Vector__XXX
 SG_ VCFRONT_a444_overTempShutdown m444 : 37|1@1+ (1,0) [0|0] "" Vector__XXX
 SG_ VCFRONT_a446_usingModeledPl m446 : 37|1@1+ (1,0) [0|0] "" Vector__XXX
 SG_ VCFRONT_a462_MOSFETStuckOpen m462 : 37|1@1+ (1,0) [0|0] "" Vector__XXX
 SG_ VCFRONT_a474_drl1Status m474 : 37|3@1+ (1,0) [0|0] "" Vector__XXX
 SG_ VCFRONT_a475_drl1Status m475 : 37|3@1+ (1,0) [0|0] "" Vector__XXX
 SG_ VCFRONT_a478_notEnoughPowerForSupport m478 : 37|1@1+ (1,0) [0|0] "" Vector__XXX
 SG_ VCFRONT_a480_spiNotDone m480 : 37|1@1+ (1,0) [0|0] "" Vector__XXX
 SG_ VCFRONT_a514_cell4Voltage m514 : 37|7@1+ (0.08,0) [0|0] "" Vector__XXX
 SG_ VCFRONT_a515_cell4Voltage m515 : 37|7@1+ (0.08,0) [0|0] "" Vector__XXX
 SG_ VCFRONT_a516_LVBatteryCannotSupportVehicle m516 : 37|1@1+ (1,0) [0|0] "" Vector__XXX
 SG_ VCFRONT_a522_LVBatteryCannotSupportVehicle m522 : 37|1@1+ (1,0) [0|0] "" Vector__XXX
 SG_ VCFRONT_a606_ccQdotTotalBeforeEntry m606 : 37|6@1+ (111.11111111111111,0) [0|0] "" Vector__XXX
 SG_ VCFRONT_a669_vehicleSpeed m669 : 37|7@1+ (2,0) [0|0] "" Vector__XXX
 SG_ VCFRONT_a104_BDY_control m104 : 38|1@1+ (1,0) [0|0] "" Vector__XXX
 SG_ VCFRONT_a113_VEH_tripPlanning m113 : 38|1@1+ (1,0) [0|0] "" Vector__XXX
 SG_ VCFRONT_a117_PARTY_prndStatus m117 : 38|1@1+ (1,0) [0|0] "" Vector__XXX
 SG_ VCFRONT_a118_CH_LVBMS_statusHigh m118 : 38|1@1+ (1,0) [0|0] "" Vector__XXX
 SG_ VCFRONT_a120_VEH_chassisCntl m120 : 38|1@1+ (1,0) [0|0] "" Vector__XXX
 SG_ VCFRONT_a171_SCCM m171 : 38|1@1+ (1,0) [0|0] "" Vector__XXX
 SG_ VCFRONT_a180_transportMode m180 : 38|1@1+ (1,0) [0|0] "" Vector__XXX
 SG_ VCFRONT_a192_frunkOpen m192 : 38|1@1+ (1,0) [0|0] "" Vector__XXX
 SG_ VCFRONT_a197_prechargeSuccessful m197 : 38|1@1+ (1,0) [0|0] "" Vector__XXX
 SG_ VCFRONT_a257_iBoosterFault m257 : 38|1@1+ (1,0) [0|0] "" Vector__XXX
 SG_ VCFRONT_a365_TransportMode m365 : 38|1@1+ (1,0) [0|0] "" Vector__XXX
 SG_ VCFRONT_a366_ScheduledDeparture m366 : 38|1@1+ (1,0) [0|0] "" Vector__XXX
 SG_ VCFRONT_a368_coolantPumpsFaulted m368 : 38|1@1+ (1,0) [0|0] "" Vector__XXX
 SG_ VCFRONT_a379_minUnfilteredVoltageReached m379 : 38|12@1+ (0.005443676098,0) [0|0] "" Vector__XXX
 SG_ VCFRONT_a400_VrefType m400 : 38|2@1+ (1,0) [0|0] "" Vector__XXX
 SG_ VCFRONT_a413_VrefType m413 : 38|2@1+ (1,0) [0|0] "" Vector__XXX
 SG_ VCFRONT_a415_IBSVoltage m415 : 38|9@1+ (0.04,0) [0|0] "" Vector__XXX
 SG_ VCFRONT_a444_overTempWarning m444 : 38|1@1+ (1,0) [0|0] "" Vector__XXX
 SG_ VCFRONT_a446_usingModeledTs m446 : 38|1@1+ (1,0) [0|0] "" Vector__XXX
 SG_ VCFRONT_a462_Imbalance m462 : 38|1@1+ (1,0) [0|0] "" Vector__XXX
 SG_ VCFRONT_a476_ECPAState m476 : 38|2@1+ (1,0) [0|0] "" Vector__XXX
 SG_ VCFRONT_a478_crashDetected m478 : 38|1@1+ (1,0) [0|0] "" Vector__XXX
 SG_ VCFRONT_a480_configIncorrect m480 : 38|1@1+ (1,0) [0|0] "" Vector__XXX
 SG_ VCFRONT_a595_IBSVoltage m595 : 38|10@1+ (0.1,-1) [0|0] "" Vector__XXX
 SG_ VCFRONT_a058_prevREstimate m58 : 39|12@1+ (0.00061,0) [0|0] "" Vector__XXX
 SG_ VCFRONT_a104_BDY_status m104 : 39|1@1+ (1,0) [0|0] "" Vector__XXX
 SG_ VCFRONT_a113_VEH_vehicleControl3 m113 : 39|1@1+ (1,0) [0|0] "" Vector__XXX
 SG_ VCFRONT_a117_PARTY_lightingSecondary m117 : 39|1@1+ (1,0) [0|0] "" Vector__XXX
 SG_ VCFRONT_a118_CH_alertMatrix m118 : 39|1@1+ (1,0) [0|0] "" Vector__XXX
 SG_ VCFRONT_a120_VEH_locStatus m120 : 39|1@1+ (1,0) [0|0] "" Vector__XXX
 SG_ VCFRONT_a171_LVBMS m171 : 39|1@1+ (1,0) [0|0] "" Vector__XXX
 SG_ VCFRONT_a178_inverterTemp m178 : 39|6@1+ (3,-40) [0|0] "" Vector__XXX
 SG_ VCFRONT_a180_frunkOpen m180 : 39|1@1+ (1,0) [0|0] "" Vector__XXX
 SG_ VCFRONT_a182_dischargedAmpHours m182 : 39|8@1+ (60,0) [0|0] "" Vector__XXX
 SG_ VCFRONT_a183_dischargedAmpHours m183 : 39|8@1+ (60,0) [0|0] "" Vector__XXX
 SG_ VCFRONT_a197_dcrMilliOhms m197 : 39|8@1+ (1,0) [0|0] "" Vector__XXX
 SG_ VCFRONT_a257_espFault m257 : 39|1@1+ (1,0) [0|0] "" Vector__XXX
 SG_ VCFRONT_a365_ScheduledDeparture m365 : 39|1@1+ (1,0) [0|0] "" Vector__XXX
 SG_ VCFRONT_a366_LowCoolant m366 : 39|1@1+ (1,0) [0|0] "" Vector__XXX
 SG_ VCFRONT_a368_preconditionsNotMet m368 : 39|1@1+ (1,0) [0|0] "" Vector__XXX
 SG_ VCFRONT_a407_avgPulseCurrent m407 : 39|7@1+ (1,-127) [0|0] "" Vector__XXX
 SG_ VCFRONT_a444_highSide2GateDriver m444 : 39|1@1+ (1,0) [0|0] "" Vector__XXX
 SG_ VCFRONT_a446_usingModeledTd m446 : 39|1@1+ (1,0) [0|0] "" Vector__XXX
 SG_ VCFRONT_a462_serviceMode m462 : 39|1@1+ (1,0) [0|0] "" Vector__XXX
 SG_ VCFRONT_a478_BMS_MIA m478 : 39|1@1+ (1,0) [0|0] "" Vector__XXX
 SG_ VCFRONT_a480_bufferFull m480 : 39|1@1+ (1,0) [0|0] "" Vector__XXX
 SG_ VCFRONT_a561_cell2Voltage m561 : 39|7@1+ (0.04,0) [0|0] "" Vector__XXX
 SG_ VCFRONT_a562_cell2Voltage m562 : 39|7@1+ (0.04,0) [0|0] "" Vector__XXX
 SG_ VCFRONT_a626_avgPulseCurrent m626 : 39|7@1+ (1,-127) [0|0] "" Vector__XXX
 SG_ VCFRONT_a663_hcmlValidatedGroupsHighWaterMarkPercent_IC500 m663 : 39|5@1+ (3.225806451612903,0) [0|0] "" Vector__XXX
 SG_ VCFRONT_a664_hcmrValidatedGroupsHighWaterMarkPercent_IC500 m664 : 39|5@1+ (3.225806451612903,0) [0|0] "" Vector__XXX
 SG_ VCFRONT_a009_PlAtExit m9 : 40|5@1+ (1,0) [0|0] "" Vector__XXX
 SG_ VCFRONT_a022_TaskInitError2 m22 : 40|8@1+ (1,0) [0|0] "" Vector__XXX
 SG_ VCFRONT_a031_uds_bytes_3 m31 : 40|8@1+ (1,0) [0|0] "" Vector__XXX
 SG_ VCFRONT_a038_faultSource m38 : 40|7@1+ (1,0) [0|0] "" Vector__XXX
 SG_ VCFRONT_a041_CPULoad100msTask m41 : 40|8@1+ (1,0) [0|0] "" Vector__XXX
 SG_ VCFRONT_a042_Usage1000msTask m42 : 40|8@1+ (1,0) [0|0] "" Vector__XXX
 SG_ VCFRONT_a043_CallTrace1 m43 : 40|24@1+ (1,0) [0|0] "" Vector__XXX
 SG_ VCFRONT_a044_CallTrace1 m44 : 40|24@1+ (1,0) [0|0] "" Vector__XXX
 SG_ VCFRONT_a045_CallTrace1 m45 : 40|24@1+ (1,0) [0|0] "" Vector__XXX
 SG_ VCFRONT_a046_CallTrace1 m46 : 40|24@1+ (1,0) [0|0] "" Vector__XXX
 SG_ VCFRONT_a047_CsvHf m47 : 40|16@1+ (1,0) [0|0] "" Vector__XXX
 SG_ VCFRONT_a059_current m59 : 40|12@1+ (0.05,0) [0|0] "" Vector__XXX
 SG_ VCFRONT_a063_disconnected m63 : 40|1@1+ (1,0) [0|0] "" Vector__XXX
 SG_ VCFRONT_a104_VEH_wirelessChargingStatus m104 : 40|1@1+ (1,0) [0|0] "" Vector__XXX
 SG_ VCFRONT_a113_VEH_vehicleControlThermal m113 : 40|1@1+ (1,0) [0|0] "" Vector__XXX
 SG_ VCFRONT_a118_BDY_outputPowerStatus m118 : 40|1@1+ (1,0) [0|0] "" Vector__XXX
 SG_ VCFRONT_a120_VEH_locStatus2 m120 : 40|1@1+ (1,0) [0|0] "" Vector__XXX
 SG_ VCFRONT_a154_lastSilentWakeIBSAmpHours m154 : 40|6@1+ (0.05,-3) [0|0] "" Vector__XXX
 SG_ VCFRONT_a171_IDB m171 : 40|1@1+ (1,0) [0|0] "" Vector__XXX
 SG_ VCFRONT_a180_dcdcLVSupportStatus m180 : 40|2@1+ (1,0) [0|0] "" Vector__XXX
 SG_ VCFRONT_a184_humidityRatio m184 : 40|4@1+ (4,0) [0|0] "" Vector__XXX
 SG_ VCFRONT_a192_IBSCurrent m192 : 40|8@1+ (0.5,-63) [0|0] "" Vector__XXX
 SG_ VCFRONT_a196_disconnectedBatteryTestVoltage m196 : 40|8@1+ (0.0392156862745098,6) [0|0] "" Vector__XXX
 SG_ VCFRONT_a220_serviceMode m220 : 40|1@1+ (1,0) [0|0] "" Vector__XXX
 SG_ VCFRONT_a228_measurementInterval m228 : 40|8@1+ (1,0) [0|0] "" Vector__XXX
 SG_ VCFRONT_a229_measurementInterval m229 : 40|8@1+ (1,0) [0|0] "" Vector__XXX
 SG_ VCFRONT_a230_measurementInterval m230 : 40|8@1+ (1,0) [0|0] "" Vector__XXX
 SG_ VCFRONT_a248_vbatMonitor m248 : 40|12@1+ (0.005443676098,0) [0|0] "" Vector__XXX
 SG_ VCFRONT_a250_calibratedHorizontalPositionHCML m250 : 40|10@1+ (1,0) [0|0] "" Vector__XXX
 SG_ VCFRONT_a257_epas3pFault m257 : 40|1@1+ (1,0) [0|0] "" Vector__XXX
 SG_ VCFRONT_a260_vehiclePowerState m260 : 40|2@1+ (1,0) [0|0] "" Vector__XXX
 SG_ VCFRONT_a283_thmlFanPhaseI m283 : 40|7@1+ (0.25,0) [0|0] "" Vector__XXX
 SG_ VCFRONT_a310_avgTemp m310 : 40|11@1+ (0.125,-40) [0|0] "" Vector__XXX
 SG_ VCFRONT_a311_avgTemp m311 : 40|11@1+ (0.125,-40) [0|0] "" Vector__XXX
 SG_ VCFRONT_a312_avgTemp m312 : 40|11@1+ (0.125,-40) [0|0] "" Vector__XXX
 SG_ VCFRONT_a313_avgTemp m313 : 40|11@1+ (0.125,-40) [0|0] "" Vector__XXX
 SG_ VCFRONT_a314_avgTemp m314 : 40|11@1+ (0.125,-40) [0|0] "" Vector__XXX
 SG_ VCFRONT_a315_avgTemp m315 : 40|11@1+ (0.125,-40) [0|0] "" Vector__XXX
 SG_ VCFRONT_a316_avgTemp m316 : 40|11@1+ (0.125,-40) [0|0] "" Vector__XXX
 SG_ VCFRONT_a317_avgTemp m317 : 40|11@1+ (0.125,-40) [0|0] "" Vector__XXX
 SG_ VCFRONT_a318_avgTemp m318 : 40|11@1+ (0.125,-40) [0|0] "" Vector__XXX
 SG_ VCFRONT_a319_avgTemp m319 : 40|11@1+ (0.125,-40) [0|0] "" Vector__XXX
 SG_ VCFRONT_a320_avgTemp m320 : 40|11@1+ (0.125,-40) [0|0] "" Vector__XXX
 SG_ VCFRONT_a321_avgTemp m321 : 40|11@1+ (0.125,-40) [0|0] "" Vector__XXX
 SG_ VCFRONT_a322_avgTemp m322 : 40|11@1+ (0.125,-40) [0|0] "" Vector__XXX
 SG_ VCFRONT_a323_avgTemp m323 : 40|11@1+ (0.125,-40) [0|0] "" Vector__XXX
 SG_ VCFRONT_a324_avgTemp m324 : 40|11@1+ (0.125,-40) [0|0] "" Vector__XXX
 SG_ VCFRONT_a325_avgTemp m325 : 40|11@1+ (0.125,-40) [0|0] "" Vector__XXX
 SG_ VCFRONT_a334_maxCurrent m334 : 40|12@1+ (0.1,0) [0|0] "" Vector__XXX
 SG_ VCFRONT_a335_maxCurrent m335 : 40|12@1+ (0.1,0) [0|0] "" Vector__XXX
 SG_ VCFRONT_a336_maxCurrent m336 : 40|12@1+ (0.1,0) [0|0] "" Vector__XXX
 SG_ VCFRONT_a337_maxCurrent m337 : 40|12@1+ (0.1,0) [0|0] "" Vector__XXX
 SG_ VCFRONT_a338_maxCurrent m338 : 40|12@1+ (0.1,0) [0|0] "" Vector__XXX
 SG_ VCFRONT_a339_maxCurrent m339 : 40|12@1+ (0.1,0) [0|0] "" Vector__XXX
 SG_ VCFRONT_a340_maxCurrent m340 : 40|12@1+ (0.1,0) [0|0] "" Vector__XXX
 SG_ VCFRONT_a341_maxCurrent m341 : 40|12@1+ (0.1,0) [0|0] "" Vector__XXX
 SG_ VCFRONT_a342_maxCurrent m342 : 40|12@1+ (0.1,0) [0|0] "" Vector__XXX
 SG_ VCFRONT_a343_maxCurrent m343 : 40|12@1+ (0.1,0) [0|0] "" Vector__XXX
 SG_ VCFRONT_a344_maxCurrent m344 : 40|12@1+ (0.1,0) [0|0] "" Vector__XXX
 SG_ VCFRONT_a345_maxCurrent m345 : 40|12@1+ (0.1,0) [0|0] "" Vector__XXX
 SG_ VCFRONT_a346_maxCurrent m346 : 40|12@1+ (0.1,0) [0|0] "" Vector__XXX
 SG_ VCFRONT_a347_maxCurrent m347 : 40|12@1+ (0.1,0) [0|0] "" Vector__XXX
 SG_ VCFRONT_a348_maxCurrent m348 : 40|12@1+ (0.1,0) [0|0] "" Vector__XXX
 SG_ VCFRONT_a349_maxCurrent m349 : 40|12@1+ (0.1,0) [0|0] "" Vector__XXX
 SG_ VCFRONT_a359_vehiclePowerState m359 : 40|2@1+ (1,0) [0|0] "" Vector__XXX
 SG_ VCFRONT_a365_LowCoolant m365 : 40|1@1+ (1,0) [0|0] "" Vector__XXX
 SG_ VCFRONT_a366_userChargeStatus m366 : 40|3@1+ (1,0) [0|0] "" Vector__XXX
 SG_ VCFRONT_a368_belowSocMin m368 : 40|1@1+ (1,0) [0|0] "" Vector__XXX
 SG_ VCFRONT_a370_notEnoughPowerForSupport m370 : 40|1@1+ (1,0) [0|0] "" Vector__XXX
 SG_ VCFRONT_a373_compDemandChiller m373 : 40|7@1+ (1,0) [0|0] "" Vector__XXX
 SG_ VCFRONT_a389_latchStatus m389 : 40|4@1+ (1,0) [0|0] "" Vector__XXX
 SG_ VCFRONT_a405_intervalCompareV m405 : 40|8@1+ (0.02,9) [0|0] "" Vector__XXX
 SG_ VCFRONT_a406_avgPulseCurrent m406 : 40|7@1+ (1,-127) [0|0] "" Vector__XXX
 SG_ VCFRONT_a412_pulseCompareVShifted m412 : 40|8@1+ (0.02,9) [0|0] "" Vector__XXX
 SG_ VCFRONT_a428_avgBrickCac m428 : 40|13@1+ (0.1,0) [0|0] "" Vector__XXX
 SG_ VCFRONT_a429_usableEnergy m429 : 40|10@1+ (0.2,-0.2) [0|0] "" Vector__XXX
 SG_ VCFRONT_a433_cellTypeData m433 : 40|8@1+ (1,0) [0|0] "" Vector__XXX
 SG_ VCFRONT_a434_cellTypeData m434 : 40|8@1+ (1,0) [0|0] "" Vector__XXX
 SG_ VCFRONT_a442_numBricksChanged m442 : 40|8@1+ (1,0) [0|0] "" Vector__XXX
 SG_ VCFRONT_a444_lowSide2GateDriver m444 : 40|1@1+ (1,0) [0|0] "" Vector__XXX
 SG_ VCFRONT_a445_actualMSB m445 : 40|8@1+ (1,0) [0|0] "" Vector__XXX
 SG_ VCFRONT_a446_usingModeledTl m446 : 40|1@1+ (1,0) [0|0] "" Vector__XXX
 SG_ VCFRONT_a461_maxSocAhErrorBrickId m461 : 40|7@1+ (1,1) [0|0] "" Vector__XXX
 SG_ VCFRONT_a462_frunkOpen m462 : 40|1@1+ (1,0) [0|0] "" Vector__XXX
 SG_ VCFRONT_a464_subcoolFiltered m464 : 40|7@1+ (0.4,-10) [0|0] "" Vector__XXX
 SG_ VCFRONT_a465_subcoolFiltered m465 : 40|7@1+ (0.4,-10) [0|0] "" Vector__XXX
 SG_ VCFRONT_a466_subcoolFiltered m466 : 40|7@1+ (0.4,-10) [0|0] "" Vector__XXX
 SG_ VCFRONT_a472_headlampTemperature_C m472 : 40|8@1+ (0.5,-40) [0|0] "" Vector__XXX
 SG_ VCFRONT_a473_headlampTemperature_C m473 : 40|8@1+ (0.5,-40) [0|0] "" Vector__XXX
 SG_ VCFRONT_a474_drl2Status m474 : 40|3@1+ (1,0) [0|0] "" Vector__XXX
 SG_ VCFRONT_a475_drl2Status m475 : 40|3@1+ (1,0) [0|0] "" Vector__XXX
 SG_ VCFRONT_a478_PCS_MIA m478 : 40|1@1+ (1,0) [0|0] "" Vector__XXX
 SG_ VCFRONT_a480_hitAlertRateLimit m480 : 40|1@1+ (1,0) [0|0] "" Vector__XXX
 SG_ VCFRONT_a482_desiredPositionRelative m482 : 40|16@1- (1,0) [0|0] "" Vector__XXX
 SG_ VCFRONT_a485_desiredPositionRelative m485 : 40|16@1- (1,0) [0|0] "" Vector__XXX
 SG_ VCFRONT_a492_maxBrickSoc m492 : 40|8@1+ (0.5,0) [0|0] "" Vector__XXX
 SG_ VCFRONT_a493_maxBrickSocByOcvMin m493 : 40|8@1+ (0.5,0) [0|0] "" Vector__XXX
 SG_ VCFRONT_a502_worstBrickV m502 : 40|12@1+ (0.002,0) [0|0] "" Vector__XXX
 SG_ VCFRONT_a508_brickImpedanceId m508 : 40|5@1+ (1,1) [0|0] "" Vector__XXX
 SG_ VCFRONT_a509_ambientTemp m509 : 40|8@1+ (0.5,-40) [0|0] "" Vector__XXX
 SG_ VCFRONT_a510_serviceMode m510 : 40|1@1+ (1,0) [0|0] "" Vector__XXX
 SG_ VCFRONT_a512_sumCellVoltage m512 : 40|8@1+ (0.1,0) [0|0] "" Vector__XXX
 SG_ VCFRONT_a513_packVoltage m513 : 40|8@1+ (0.1,0) [0|0] "" Vector__XXX
 SG_ VCFRONT_a521_ambientTemp m521 : 40|8@1+ (0.5,-40) [0|0] "" Vector__XXX
 SG_ VCFRONT_a523_control2Byte3 m523 : 40|8@1+ (1,0) [0|0] "" Vector__XXX
 SG_ VCFRONT_a534_measuredCloseRange m534 : 40|8@1+ (7,0) [0|0] "" Vector__XXX
 SG_ VCFRONT_a535_measuredCloseRange m535 : 40|8@1+ (7,0) [0|0] "" Vector__XXX
 SG_ VCFRONT_a536_measuredCloseRange m536 : 40|8@1+ (7,0) [0|0] "" Vector__XXX
 SG_ VCFRONT_a537_measuredCloseRange m537 : 40|8@1+ (7,0) [0|0] "" Vector__XXX
 SG_ VCFRONT_a538_measuredCloseRange m538 : 40|8@1+ (7,0) [0|0] "" Vector__XXX
 SG_ VCFRONT_a539_measuredCloseRange m539 : 40|8@1+ (7,0) [0|0] "" Vector__XXX
 SG_ VCFRONT_a542_ambientTempRaw m542 : 40|8@1+ (0.5,-40) [0|0] "" Vector__XXX
 SG_ VCFRONT_a548_LVBMSSOC m548 : 40|5@1+ (3,0) [0|0] "" Vector__XXX
 SG_ VCFRONT_a556_disconnectedBatteryTestVoltage m556 : 40|8@1+ (0.0392156862745098,6) [0|0] "" Vector__XXX
 SG_ VCFRONT_a559_batterySMState m559 : 40|4@1+ (1,0) [0|0] "" Vector__XXX
 SG_ VCFRONT_a582_LVBusVoltageSource m582 : 40|2@1+ (1,0) [0|0] "" Vector__XXX
 SG_ VCFRONT_a587_IBSCurrent m587 : 40|12@1- (0.1,0) [0|0] "" Vector__XXX
 SG_ VCFRONT_a588_vcleftBTerm m588 : 40|8@1- (1,-78) [0|0] "" Vector__XXX
 SG_ VCFRONT_a590_vcrightBTerm m590 : 40|8@1- (1,-78) [0|0] "" Vector__XXX
 SG_ VCFRONT_a592_vcleftCutoffBTerm m592 : 40|8@1- (1,-78) [0|0] "" Vector__XXX
 SG_ VCFRONT_a596_vcrightCutoffBTerm m596 : 40|8@1- (1,-78) [0|0] "" Vector__XXX
 SG_ VCFRONT_a600_IBSCurrent m600 : 40|12@1- (0.1,0) [0|0] "" Vector__XXX
 SG_ VCFRONT_a608_retryCount m608 : 40|4@1+ (1,0) [0|0] "" Vector__XXX
 SG_ VCFRONT_a618_ptInletTemp m618 : 40|6@1+ (2,0) [0|0] "" Vector__XXX
 SG_ VCFRONT_a623_failureLvBatteryEnergyActiveDecel m623 : 40|1@1+ (1,0) [0|0] "" Vector__XXX
 SG_ VCFRONT_a644_minCycleCurrent m644 : 40|8@1- (0.0984251968503937,5.807086614173229) [0|0] "" Vector__XXX
 SG_ VCFRONT_a645_fluidLevelSensorRawLowAnyPointOfCycle m645 : 40|1@1+ (1,0) [0|0] "" Vector__XXX
 SG_ VCFRONT_a646_timeSinceLastValidWash m646 : 40|14@1+ (1,0) [0|0] "" Vector__XXX
 SG_ VCFRONT_a667_homologationRegionOverride m667 : 40|2@1+ (1,0) [0|0] "" Vector__XXX
 SG_ VCFRONT_a668_homologationRegionOverride m668 : 40|2@1+ (1,0) [0|0] "" Vector__XXX
 SG_ VCFRONT_a063_indeterminate m63 : 41|1@1+ (1,0) [0|0] "" Vector__XXX
 SG_ VCFRONT_a104_VEH_control m104 : 41|1@1+ (1,0) [0|0] "" Vector__XXX
 SG_ VCFRONT_a113_CH_odo m113 : 41|1@1+ (1,0) [0|0] "" Vector__XXX
 SG_ VCFRONT_a118_BDY_vehicleTime m118 : 41|1@1+ (1,0) [0|0] "" Vector__XXX
 SG_ VCFRONT_a120_VEH_prndControl m120 : 41|1@1+ (1,0) [0|0] "" Vector__XXX
 SG_ VCFRONT_a171_IDB1 m171 : 41|1@1+ (1,0) [0|0] "" Vector__XXX
 SG_ VCFRONT_a188_timeNotSleeping m188 : 41|6@1+ (1,0) [0|0] "" Vector__XXX
 SG_ VCFRONT_a220_frunkOpen m220 : 41|1@1+ (1,0) [0|0] "" Vector__XXX
 SG_ VCFRONT_a257_epas3sFault m257 : 41|1@1+ (1,0) [0|0] "" Vector__XXX
 SG_ VCFRONT_a365_userChargeStatus m365 : 41|3@1+ (1,0) [0|0] "" Vector__XXX
 SG_ VCFRONT_a370_serviceMode m370 : 41|1@1+ (1,0) [0|0] "" Vector__XXX
 SG_ VCFRONT_a444_highSide1GateDriver m444 : 41|1@1+ (1,0) [0|0] "" Vector__XXX
 SG_ VCFRONT_a446_sensorHasOffsetTd m446 : 41|1@1+ (1,0) [0|0] "" Vector__XXX
 SG_ VCFRONT_a478_HVBlockingMismatch m478 : 41|1@1+ (1,0) [0|0] "" Vector__XXX
 SG_ VCFRONT_a480_hwlo m480 : 41|1@1+ (1,0) [0|0] "" Vector__XXX
 SG_ VCFRONT_a498_testAbortReason m498 : 41|3@1+ (1,0) [0|0] "" Vector__XXX
 SG_ VCFRONT_a510_frunkOpen m510 : 41|1@1+ (1,0) [0|0] "" Vector__XXX
 SG_ VCFRONT_a518_outputVoltageAtPCS m518 : 41|8@1+ (0.1,0) [0|0] "" Vector__XXX
 SG_ VCFRONT_a594_fusionSessionCalibration m594 : 41|9@1- (0.0005,0) [0|0] "" Vector__XXX
 SG_ VCFRONT_a611_coolantFlow m611 : 41|5@1+ (1,0) [0|0] "" Vector__XXX
 SG_ VCFRONT_a623_failureLvBatteryEnergyCritical m623 : 41|1@1+ (1,0) [0|0] "" Vector__XXX
 SG_ VCFRONT_a645_fluidLevelSensorFilteredLowEndOfCycle m645 : 41|1@1+ (1,0) [0|0] "" Vector__XXX
 SG_ VCFRONT_a063_stuckActive m63 : 42|1@1+ (1,0) [0|0] "" Vector__XXX
 SG_ VCFRONT_a104_BDY_bodyControls m104 : 42|1@1+ (1,0) [0|0] "" Vector__XXX
 SG_ VCFRONT_a113_VEH_locationStatus m113 : 42|1@1+ (1,0) [0|0] "" Vector__XXX
 SG_ VCFRONT_a118_PARTY_AP_vehicleState1HzMuxed m118 : 42|1@1+ (1,0) [0|0] "" Vector__XXX
 SG_ VCFRONT_a120_VEH_vehicleEstimates m120 : 42|1@1+ (1,0) [0|0] "" Vector__XXX
 SG_ VCFRONT_a171_IDBCAL m171 : 42|1@1+ (1,0) [0|0] "" Vector__XXX
 SG_ VCFRONT_a257_revBattFault m257 : 42|1@1+ (1,0) [0|0] "" Vector__XXX
 SG_ VCFRONT_a260_batterySMState m260 : 42|4@1+ (1,0) [0|0] "" Vector__XXX
 SG_ VCFRONT_a352_startTime m352 : 42|10@1+ (10,0) [0|0] "" Vector__XXX
 SG_ VCFRONT_a359_batterySMState m359 : 42|4@1+ (1,0) [0|0] "" Vector__XXX
 SG_ VCFRONT_a370_sleepCurrent m370 : 42|10@1+ (0.1,0) [0|0] "" Vector__XXX
 SG_ VCFRONT_a444_lowSide1GateDriver m444 : 42|1@1+ (1,0) [0|0] "" Vector__XXX
 SG_ VCFRONT_a446_sensorHasOffsetPd m446 : 42|1@1+ (1,0) [0|0] "" Vector__XXX
 SG_ VCFRONT_a478_HV_UP m478 : 42|1@1+ (1,0) [0|0] "" Vector__XXX
 SG_ VCFRONT_a480_enable m480 : 42|1@1+ (1,0) [0|0] "" Vector__XXX
 SG_ VCFRONT_a484_currentVehiclePitch m484 : 42|10@1- (0.0001,0) [0|0] "" Vector__XXX
 SG_ VCFRONT_a582_batteryType m582 : 42|3@1+ (1,0) [0|0] "" Vector__XXX
 SG_ VCFRONT_a584_switch1StuckReason m584 : 42|2@1+ (1,0) [0|0] "" Vector__XXX
 SG_ VCFRONT_a623_failureReverseBatteryEfuseOff m623 : 42|1@1+ (1,0) [0|0] "" Vector__XXX
 SG_ VCFRONT_a645_totalWashDuration m645 : 42|10@1+ (9.775171065493646,0) [0|0] "" Vector__XXX
 SG_ VCFRONT_a667_isRightHandDrive m667 : 42|1@1+ (1,0) [0|0] "" Vector__XXX
 SG_ VCFRONT_a668_isRightHandDrive m668 : 42|1@1+ (1,0) [0|0] "" Vector__XXX
 SG_ VCFRONT_a063_faulted m63 : 43|1@1+ (1,0) [0|0] "" Vector__XXX
 SG_ VCFRONT_a113_VEH_gpsTime m113 : 43|1@1+ (1,0) [0|0] "" Vector__XXX
 SG_ VCFRONT_a118_BDY_AP_vehicleState1HzMuxed m118 : 43|1@1+ (1,0) [0|0] "" Vector__XXX
 SG_ VCFRONT_a120_PARTY_motorStatus m120 : 43|1@1+ (1,0) [0|0] "" Vector__XXX
 SG_ VCFRONT_a162_ccRightExvFlow m162 : 43|7@1+ (1,0) [0|0] "" Vector__XXX
 SG_ VCFRONT_a171_RCU m171 : 43|1@1+ (1,0) [0|0] "" Vector__XXX
 SG_ VCFRONT_a187_ethBusRetryCount m187 : 43|9@1+ (1,0) [0|0] "" Vector__XXX
 SG_ VCFRONT_a257_vehicleState m257 : 43|5@1+ (1,0) [0|0] "" Vector__XXX
 SG_ VCFRONT_a366_chgNoFlowTetherStatus m366 : 43|2@1+ (1,0) [0|0] "" Vector__XXX
 SG_ VCFRONT_a414_IBSVoltage m414 : 43|11@1+ (0.01088735219,0) [0|0] "" Vector__XXX
 SG_ VCFRONT_a444_highSide2OverCurent m444 : 43|1@1+ (1,0) [0|0] "" Vector__XXX
 SG_ VCFRONT_a446_sensorDroopPd m446 : 43|1@1+ (1,0) [0|0] "" Vector__XXX
 SG_ VCFRONT_a474_drl3Status m474 : 43|3@1+ (1,0) [0|0] "" Vector__XXX
 SG_ VCFRONT_a475_drl3Status m475 : 43|3@1+ (1,0) [0|0] "" Vector__XXX
 SG_ VCFRONT_a477_cell4Voltage m477 : 43|9@1+ (0.01,0) [0|0] "" Vector__XXX
 SG_ VCFRONT_a478_pcsEFuseStable m478 : 43|1@1+ (1,0) [0|0] "" Vector__XXX
 SG_ VCFRONT_a606_ccQdotTotalAtExit m606 : 43|6@1+ (111.11111111111111,0) [0|0] "" Vector__XXX
 SG_ VCFRONT_a623_failureLvbmbEfuseOpen m623 : 43|1@1+ (1,0) [0|0] "" Vector__XXX
 SG_ VCFRONT_a627_cell4Voltage m627 : 43|9@1+ (0.01,0) [0|0] "" Vector__XXX
 SG_ VCFRONT_a113_VEH_gpsVehicleSpeed m113 : 44|1@1+ (1,0) [0|0] "" Vector__XXX
 SG_ VCFRONT_a118_PARTY_VCFRONT_cameraCleaningStatus m118 : 44|1@1+ (1,0) [0|0] "" Vector__XXX
 SG_ VCFRONT_a120_VEH_motorStatus m120 : 44|1@1+ (1,0) [0|0] "" Vector__XXX
 SG_ VCFRONT_a171_RCUCAL m171 : 44|1@1+ (1,0) [0|0] "" Vector__XXX
 SG_ VCFRONT_a184_evapOutTemp m184 : 44|5@1+ (1,0) [0|0] "" Vector__XXX
 SG_ VCFRONT_a190_maxResponseTime m190 : 44|8@1+ (0.1,0) [0|0] "" Vector__XXX
 SG_ VCFRONT_a191_ECPAState m191 : 44|2@1+ (1,0) [0|0] "" Vector__XXX
 SG_ VCFRONT_a258_maxCurrentReached m258 : 44|16@1- (0.005,0) [0|0] "" Vector__XXX
 SG_ VCFRONT_a365_chgNoFlowTetherStatus m365 : 44|2@1+ (1,0) [0|0] "" Vector__XXX
 SG_ VCFRONT_a444_lowSide2OverCurent m444 : 44|1@1+ (1,0) [0|0] "" Vector__XXX
 SG_ VCFRONT_a446_sensorHasOffsetTl m446 : 44|1@1+ (1,0) [0|0] "" Vector__XXX
 SG_ VCFRONT_a478_vcrightEFuseStable m478 : 44|1@1+ (1,0) [0|0] "" Vector__XXX
 SG_ VCFRONT_a498_targetVoltage m498 : 44|10@1+ (0.05,0) [0|0] "" Vector__XXX
 SG_ VCFRONT_a514_packVoltage m514 : 44|8@1+ (0.1,0) [0|0] "" Vector__XXX
 SG_ VCFRONT_a515_packVoltage m515 : 44|8@1+ (0.1,0) [0|0] "" Vector__XXX
 SG_ VCFRONT_a559_bmsState m559 : 44|4@1+ (1,0) [0|0] "" Vector__XXX
 SG_ VCFRONT_a584_switch2StuckReason m584 : 44|2@1+ (1,0) [0|0] "" Vector__XXX
 SG_ VCFRONT_a608_setFromNvm m608 : 44|1@1+ (1,0) [0|0] "" Vector__XXX
 SG_ VCFRONT_a623_failureLvBatteryComms m623 : 44|1@1+ (1,0) [0|0] "" Vector__XXX
 SG_ VCFRONT_a663_hcmlGroupsHighWaterMarkPercent_IC600 m663 : 44|5@1+ (3.225806451612903,0) [0|0] "" Vector__XXX
 SG_ VCFRONT_a664_hcmrGroupsHighWaterMarkPercent_IC600 m664 : 44|5@1+ (3.225806451612903,0) [0|0] "" Vector__XXX
 SG_ VCFRONT_a669_minPackSOC m669 : 44|9@1+ (0.2,0) [0|0] "" Vector__XXX
 SG_ VCFRONT_a113_VEH_status2 m113 : 45|1@1+ (1,0) [0|0] "" Vector__XXX
 SG_ VCFRONT_a120_BDY_speed m120 : 45|1@1+ (1,0) [0|0] "" Vector__XXX
 SG_ VCFRONT_a171_DPB m171 : 45|1@1+ (1,0) [0|0] "" Vector__XXX
 SG_ VCFRONT_a178_ambientTempFiltered m178 : 45|8@1+ (0.5,-40) [0|0] "" Vector__XXX
 SG_ VCFRONT_a366_updateInProgress m366 : 45|1@1+ (1,0) [0|0] "" Vector__XXX
 SG_ VCFRONT_a403_IBSTemp m403 : 45|7@1+ (1,-40) [0|0] "" Vector__XXX
 SG_ VCFRONT_a444_highSide1OverCurent m444 : 45|1@1+ (1,0) [0|0] "" Vector__XXX
 SG_ VCFRONT_a446_sensorIntermittentPs m446 : 45|1@1+ (1,0) [0|0] "" Vector__XXX
 SG_ VCFRONT_a478_contactorEFuseStable m478 : 45|1@1+ (1,0) [0|0] "" Vector__XXX
 SG_ VCFRONT_a541_AverageCurrent m541 : 45|10@1+ (0.05,0) [0|0] "" Vector__XXX
 SG_ VCFRONT_a548_serviceMode m548 : 45|1@1+ (1,0) [0|0] "" Vector__XXX
 SG_ VCFRONT_a582_inFactoryMode m582 : 45|1@1+ (1,0) [0|0] "" Vector__XXX
 SG_ VCFRONT_a623_failureLvBatterySensorIbsMia m623 : 45|1@1+ (1,0) [0|0] "" Vector__XXX
 SG_ VCFRONT_a113_VEH_autopilotControl m113 : 46|1@1+ (1,0) [0|0] "" Vector__XXX
 SG_ VCFRONT_a171_DPBCAL m171 : 46|1@1+ (1,0) [0|0] "" Vector__XXX
 SG_ VCFRONT_a191_LVBMSCurrentTargetValid m191 : 46|1@1+ (1,0) [0|0] "" Vector__XXX
 SG_ VCFRONT_a260_HV_UP m260 : 46|1@1+ (1,0) [0|0] "" Vector__XXX
 SG_ VCFRONT_a365_updateInProgress m365 : 46|1@1+ (1,0) [0|0] "" Vector__XXX
 SG_ VCFRONT_a366_dcCharging m366 : 46|1@1+ (1,0) [0|0] "" Vector__XXX
 SG_ VCFRONT_a407_pulseCurrentVarianceShifted m407 : 46|6@1+ (0.25,0) [0|0] "" Vector__XXX
 SG_ VCFRONT_a408_IBSTemp m408 : 46|7@1+ (1,-40) [0|0] "" Vector__XXX
 SG_ VCFRONT_a416_socMin m416 : 46|8@1+ (0.5,0) [0|0] "" Vector__XXX
 SG_ VCFRONT_a417_socMax m417 : 46|8@1+ (0.5,0) [0|0] "" Vector__XXX
 SG_ VCFRONT_a418_socMax m418 : 46|8@1+ (0.5,0) [0|0] "" Vector__XXX
 SG_ VCFRONT_a419_socMin m419 : 46|8@1+ (0.5,0) [0|0] "" Vector__XXX
 SG_ VCFRONT_a423_socMin m423 : 46|8@1+ (0.5,0) [0|0] "" Vector__XXX
 SG_ VCFRONT_a424_socMin m424 : 46|8@1+ (0.5,0) [0|0] "" Vector__XXX
 SG_ VCFRONT_a444_lowSide1OverCurent m444 : 46|1@1+ (1,0) [0|0] "" Vector__XXX
 SG_ VCFRONT_a446_sensorIntermittentPd m446 : 46|1@1+ (1,0) [0|0] "" Vector__XXX
 SG_ VCFRONT_a478_hvcEFuseStable m478 : 46|1@1+ (1,0) [0|0] "" Vector__XXX
 SG_ VCFRONT_a481_stuckOnFinished m481 : 46|1@1+ (1,0) [0|0] "" Vector__XXX
 SG_ VCFRONT_a503_socMax m503 : 46|8@1+ (0.5,0) [0|0] "" Vector__XXX
 SG_ VCFRONT_a527_cell4Voltage m527 : 46|10@1+ (0.01,0) [0|0] "" Vector__XXX
 SG_ VCFRONT_a548_frunkOpen m548 : 46|1@1+ (1,0) [0|0] "" Vector__XXX
 SG_ VCFRONT_a555_cell4Voltage m555 : 46|10@1+ (0.01,0) [0|0] "" Vector__XXX
 SG_ VCFRONT_a561_cell3Voltage m561 : 46|7@1+ (0.04,0) [0|0] "" Vector__XXX
 SG_ VCFRONT_a562_cell3Voltage m562 : 46|7@1+ (0.04,0) [0|0] "" Vector__XXX
 SG_ VCFRONT_a582_frunkOpen m582 : 46|1@1+ (1,0) [0|0] "" Vector__XXX
 SG_ VCFRONT_a584_firstFaultedSwitch m584 : 46|3@1+ (1,0) [0|0] "" Vector__XXX
 SG_ VCFRONT_a611_compressorPower m611 : 46|6@1+ (200,0) [0|0] "" Vector__XXX
 SG_ VCFRONT_a623_failureLvBatteryConnection m623 : 46|1@1+ (1,0) [0|0] "" Vector__XXX
 SG_ VCFRONT_a626_pulseCurrentVarianceShifted m626 : 46|6@1+ (0.25,0) [0|0] "" Vector__XXX
 SG_ VCFRONT_a634_ajar2ClosingDeltaV m634 : 46|10@1- (0.01,0) [0|0] "" Vector__XXX
 SG_ VCFRONT_a113_VEH_ambientLightingCtrls m113 : 47|1@1+ (1,0) [0|0] "" Vector__XXX
 SG_ VCFRONT_a171_serviceMode m171 : 47|1@1+ (1,0) [0|0] "" Vector__XXX
 SG_ VCFRONT_a182_chargedAmpHours m182 : 47|8@1+ (60,0) [0|0] "" Vector__XXX
 SG_ VCFRONT_a183_chargedAmpHours m183 : 47|8@1+ (60,0) [0|0] "" Vector__XXX
 SG_ VCFRONT_a188_chargeRequest m188 : 47|1@1+ (1,0) [0|0] "" Vector__XXX
 SG_ VCFRONT_a191_LVBMSVoltageTargetValid m191 : 47|1@1+ (1,0) [0|0] "" Vector__XXX
 SG_ VCFRONT_a197_validityStatus m197 : 47|7@1+ (1,0) [0|0] "" Vector__XXX
 SG_ VCFRONT_a260_notEnoughPowerForSupport m260 : 47|1@1+ (1,0) [0|0] "" Vector__XXX
 SG_ VCFRONT_a365_dcCharging m365 : 47|1@1+ (1,0) [0|0] "" Vector__XXX
 SG_ VCFRONT_a366_finishedSuccessfully m366 : 47|1@1+ (1,0) [0|0] "" Vector__XXX
 SG_ VCFRONT_a406_pulseCurrentVariance m406 : 47|6@1+ (0.25,0) [0|0] "" Vector__XXX
 SG_ VCFRONT_a415_IBSAmpHours m415 : 47|7@1+ (0.02,-2.55) [0|0] "" Vector__XXX
 SG_ VCFRONT_a444_spiInit m444 : 47|1@1+ (1,0) [0|0] "" Vector__XXX
 SG_ VCFRONT_a446_sensorIntermittentPl m446 : 47|1@1+ (1,0) [0|0] "" Vector__XXX
 SG_ VCFRONT_a465_flaggedAtSteadyState m465 : 47|1@1+ (1,0) [0|0] "" Vector__XXX
 SG_ VCFRONT_a478_frunkOpen m478 : 47|1@1+ (1,0) [0|0] "" Vector__XXX
 SG_ VCFRONT_a481_stuckOnFailure m481 : 47|1@1+ (1,0) [0|0] "" Vector__XXX
 SG_ VCFRONT_a623_failureLvBatteryConnectionUnknown m623 : 47|1@1+ (1,0) [0|0] "" Vector__XXX
 SG_ VCFRONT_a000_alertDataW2 m0 : 48|16@1+ (1,0) [0|0] "" Vector__XXX
 SG_ VCFRONT_a003_Data m3 : 48|16@1+ (1,0) [0|0] "" Vector__XXX
 SG_ VCFRONT_a009_subcoolAtExit m9 : 48|5@1- (1,6) [0|0] "" Vector__XXX
 SG_ VCFRONT_a022_TaskInitError3 m22 : 48|8@1+ (1,0) [0|0] "" Vector__XXX
 SG_ VCFRONT_a031_uds_bytes_4 m31 : 48|8@1+ (1,0) [0|0] "" Vector__XXX
 SG_ VCFRONT_a041_CPULoad1000msTask m41 : 48|8@1+ (1,0) [0|0] "" Vector__XXX
 SG_ VCFRONT_a042_UsageUDSTask m42 : 48|8@1+ (1,0) [0|0] "" Vector__XXX
 SG_ VCFRONT_a113_VEH_driverAssistMapData m113 : 48|1@1+ (1,0) [0|0] "" Vector__XXX
 SG_ VCFRONT_a127_vcleftEFuseTemp m127 : 48|11@1+ (0.125,-40) [0|0] "" Vector__XXX
 SG_ VCFRONT_a128_vcrightEFuseTemp m128 : 48|11@1+ (0.125,-40) [0|0] "" Vector__XXX
 SG_ VCFRONT_a129_pcsEFuseTemp m129 : 48|11@1+ (0.125,-40) [0|0] "" Vector__XXX
 SG_ VCFRONT_a130_epas3pEFuseTemp m130 : 48|11@1+ (0.125,-40) [0|0] "" Vector__XXX
 SG_ VCFRONT_a131_epas3sEFuseTemp m131 : 48|11@1+ (0.125,-40) [0|0] "" Vector__XXX
 SG_ VCFRONT_a132_iBoosterEFuseTemp m132 : 48|11@1+ (0.125,-40) [0|0] "" Vector__XXX
 SG_ VCFRONT_a133_espEFuseTemp m133 : 48|11@1+ (0.125,-40) [0|0] "" Vector__XXX
 SG_ VCFRONT_a134_fusedHighTemp m134 : 48|11@1+ (0.125,-40) [0|0] "" Vector__XXX
 SG_ VCFRONT_a154_lastSilentWakeTimeSlept m154 : 48|8@1+ (0.2,0) [0|0] "" Vector__XXX
 SG_ VCFRONT_a155_minHVComingUpIBSTemperature m155 : 48|7@1+ (1,-24) [0|0] "" Vector__XXX
 SG_ VCFRONT_a180_IBSVoltage m180 : 48|8@1+ (0.08741903380905883,0) [0|0] "" Vector__XXX
 SG_ VCFRONT_a188_12VSupport m188 : 48|1@1+ (1,0) [0|0] "" Vector__XXX
 SG_ VCFRONT_a191_serviceMode m191 : 48|1@1+ (1,0) [0|0] "" Vector__XXX
 SG_ VCFRONT_a192_PCSCurrent m192 : 48|8@1+ (0.5,-127) [0|0] "" Vector__XXX
 SG_ VCFRONT_a196_disconnectedBatteryTestPrevVoltage m196 : 48|8@1+ (0.0392156862745098,6) [0|0] "" Vector__XXX
 SG_ VCFRONT_a213_LVBatteryTemp m213 : 48|16@1- (0.01,0) [0|0] "" Vector__XXX
 SG_ VCFRONT_a219_IBSCurrent m219 : 48|16@1- (0.005,0) [0|0] "" Vector__XXX
 SG_ VCFRONT_a242_IBSAmpHours m242 : 48|8@1+ (0.01,-2.55) [0|0] "" Vector__XXX
 SG_ VCFRONT_a243_LVBatteryTemp m243 : 48|16@1- (0.01,0) [0|0] "" Vector__XXX
 SG_ VCFRONT_a244_vbatProtVoltage m244 : 48|16@1+ (0.1,0) [0|0] "" Vector__XXX
 SG_ VCFRONT_a245_eFuseRemainingRetries m245 : 48|4@1+ (1,0) [0|0] "" Vector__XXX
 SG_ VCFRONT_a246_eFuseRemainingRetries m246 : 48|4@1+ (1,0) [0|0] "" Vector__XXX
 SG_ VCFRONT_a252_IBSCurrent m252 : 48|16@1- (0.005,0) [0|0] "" Vector__XXX
 SG_ VCFRONT_a253_LVBatteryTemp m253 : 48|7@1+ (1,-40) [0|0] "" Vector__XXX
 SG_ VCFRONT_a259_maxCurrentReached m259 : 48|16@1- (0.005,0) [0|0] "" Vector__XXX
 SG_ VCFRONT_a260_coolantHasBeenFilled m260 : 48|1@1+ (1,0) [0|0] "" Vector__XXX
 SG_ VCFRONT_a269_IBSAmpHours m269 : 48|8@1+ (0.01,-2.55) [0|0] "" Vector__XXX
 SG_ VCFRONT_a283_thmlFanPhaseILimit m283 : 48|7@1+ (0.25,0) [0|0] "" Vector__XXX
 SG_ VCFRONT_a303_lockStatus m303 : 48|2@1+ (1,0) [0|0] "" Vector__XXX
 SG_ VCFRONT_a309_lockStatus m309 : 48|2@1+ (1,0) [0|0] "" Vector__XXX
 SG_ VCFRONT_a326_vehicleState m326 : 48|2@1+ (1,0) [0|0] "" Vector__XXX
 SG_ VCFRONT_a327_vehicleState m327 : 48|2@1+ (1,0) [0|0] "" Vector__XXX
 SG_ VCFRONT_a328_vehicleState m328 : 48|2@1+ (1,0) [0|0] "" Vector__XXX
 SG_ VCFRONT_a329_vehicleState m329 : 48|2@1+ (1,0) [0|0] "" Vector__XXX
 SG_ VCFRONT_a330_vehicleState m330 : 48|2@1+ (1,0) [0|0] "" Vector__XXX
 SG_ VCFRONT_a331_vehicleState m331 : 48|2@1+ (1,0) [0|0] "" Vector__XXX
 SG_ VCFRONT_a332_vehicleState m332 : 48|2@1+ (1,0) [0|0] "" Vector__XXX
 SG_ VCFRONT_a333_vehicleState m333 : 48|2@1+ (1,0) [0|0] "" Vector__XXX
 SG_ VCFRONT_a359_hvState m359 : 48|3@1+ (1,0) [0|0] "" Vector__XXX
 SG_ VCFRONT_a363_checkIntervalDays m363 : 48|5@1+ (1,0) [0|0] "" Vector__XXX
 SG_ VCFRONT_a365_pcsTooHot m365 : 48|1@1+ (1,0) [0|0] "" Vector__XXX
 SG_ VCFRONT_a366_pcsReportsUnavailable m366 : 48|1@1+ (1,0) [0|0] "" Vector__XXX
 SG_ VCFRONT_a387_maxCurrentReached m387 : 48|16@1- (0.005,0) [0|0] "" Vector__XXX
 SG_ VCFRONT_a388_maxCurrentReached m388 : 48|16@1- (0.005,0) [0|0] "" Vector__XXX
 SG_ VCFRONT_a401_IBSAmpHours m401 : 48|8@1+ (0.01,-2.55) [0|0] "" Vector__XXX
 SG_ VCFRONT_a404_maxCurrentReached m404 : 48|16@1- (0.005,0) [0|0] "" Vector__XXX
 SG_ VCFRONT_a405_avgIntervalCurrent m405 : 48|5@1+ (1,-31) [0|0] "" Vector__XXX
 SG_ VCFRONT_a410_IBSAmpHours m410 : 48|8@1+ (0.01,-2.55) [0|0] "" Vector__XXX
 SG_ VCFRONT_a411_IBSAmpHours m411 : 48|8@1+ (0.01,-2.55) [0|0] "" Vector__XXX
 SG_ VCFRONT_a412_avgPulseCurrentShifted m412 : 48|7@1+ (1,-127) [0|0] "" Vector__XXX
 SG_ VCFRONT_a421_hcmlTxBufferHighWaterMarkPercent m421 : 48|5@1+ (3.225806451612903,0) [0|0] "" Vector__XXX
 SG_ VCFRONT_a427_cacChangeBrickId m427 : 48|7@1+ (1,1) [0|0] "" Vector__XXX
 SG_ VCFRONT_a430_hvjbCurrentLimit m430 : 48|16@1- (0.1,0) [0|0] "" Vector__XXX
 SG_ VCFRONT_a431_hvjbCurrentLimit m431 : 48|16@1- (0.1,0) [0|0] "" Vector__XXX
 SG_ VCFRONT_a433_bmbModuleIdValid m433 : 48|1@1+ (1,0) [0|0] "" Vector__XXX
 SG_ VCFRONT_a434_bmbModuleIdValid m434 : 48|1@1+ (1,0) [0|0] "" Vector__XXX
 SG_ VCFRONT_a435_hvjbCurrentLimit m435 : 48|16@1- (0.1,0) [0|0] "" Vector__XXX
 SG_ VCFRONT_a436_hvjbCurrentLimit m436 : 48|16@1- (0.1,0) [0|0] "" Vector__XXX
 SG_ VCFRONT_a442_brickChangeHystRatio m442 : 48|10@1+ (0.001,0) [0|0] "" Vector__XXX
 SG_ VCFRONT_a444_spiPeriodicCheck m444 : 48|1@1+ (1,0) [0|0] "" Vector__XXX
 SG_ VCFRONT_a445_actualLSB m445 : 48|8@1+ (1,0) [0|0] "" Vector__XXX
 SG_ VCFRONT_a446_sensorIntermittentTs m446 : 48|1@1+ (1,0) [0|0] "" Vector__XXX
 SG_ VCFRONT_a461_numBricksHighSocAhError m461 : 48|8@1+ (1,0) [0|0] "" Vector__XXX
 SG_ VCFRONT_a465_flaggedAtUnsteadyState m465 : 48|1@1+ (1,0) [0|0] "" Vector__XXX
 SG_ VCFRONT_a474_turnStatus m474 : 48|3@1+ (1,0) [0|0] "" Vector__XXX
 SG_ VCFRONT_a475_turnStatus m475 : 48|3@1+ (1,0) [0|0] "" Vector__XXX
 SG_ VCFRONT_a481_hardShortThresholdReached m481 : 48|1@1+ (1,0) [0|0] "" Vector__XXX
 SG_ VCFRONT_a492_avgBrickSoc m492 : 48|8@1+ (0.5,0) [0|0] "" Vector__XXX
 SG_ VCFRONT_a493_maxBrickSoc m493 : 48|7@1+ (1,0) [0|0] "" Vector__XXX
 SG_ VCFRONT_a497_SumCellVoltage m497 : 48|8@1+ (0.1,0) [0|0] "" Vector__XXX
 SG_ VCFRONT_a509_serviceMode m509 : 48|1@1+ (1,0) [0|0] "" Vector__XXX
 SG_ VCFRONT_a511_hvState m511 : 48|3@1+ (1,0) [0|0] "" Vector__XXX
 SG_ VCFRONT_a512_overcurrentDirection m512 : 48|2@1+ (1,0) [0|0] "" Vector__XXX
 SG_ VCFRONT_a513_packSOC m513 : 48|10@1+ (0.1,0) [0|0] "" Vector__XXX
 SG_ VCFRONT_a521_serviceMode m521 : 48|1@1+ (1,0) [0|0] "" Vector__XXX
 SG_ VCFRONT_a523_control3Byte2 m523 : 48|8@1+ (1,0) [0|0] "" Vector__XXX
 SG_ VCFRONT_a529_externalPowerSupply m529 : 48|1@1+ (1,0) [0|0] "" Vector__XXX
 SG_ VCFRONT_a530_vehicleState m530 : 48|2@1+ (1,0) [0|0] "" Vector__XXX
 SG_ VCFRONT_a542_ambientTempFiltered m542 : 48|8@1+ (0.5,-40) [0|0] "" Vector__XXX
 SG_ VCFRONT_a548_PCSTargetVoltage m548 : 48|8@1+ (0.1,0) [0|0] "" Vector__XXX
 SG_ VCFRONT_a556_disconnectedBatteryTestPrevVoltage m556 : 48|8@1+ (0.0392156862745098,6) [0|0] "" Vector__XXX
 SG_ VCFRONT_a558_levelingOffsetPriorToAiming m558 : 48|8@1- (1,0) [0|0] "" Vector__XXX
 SG_ VCFRONT_a559_dcdcLVSupportStatus m559 : 48|2@1+ (1,0) [0|0] "" Vector__XXX
 SG_ VCFRONT_a564_levelingOffsetPriorToAiming m564 : 48|8@1- (1,0) [0|0] "" Vector__XXX
 SG_ VCFRONT_a579_leftHeadlightRemainingRetries m579 : 48|4@1+ (1,0) [0|0] "" Vector__XXX
 SG_ VCFRONT_a580_rightHeadlightRemainingRetries m580 : 48|4@1+ (1,0) [0|0] "" Vector__XXX
 SG_ VCFRONT_a588_vcleftCTerm m588 : 48|16@1- (50,0) [0|0] "" Vector__XXX
 SG_ VCFRONT_a589_vcleftMaxCount m589 : 48|5@1+ (1,0) [0|0] "" Vector__XXX
